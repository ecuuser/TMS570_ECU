AUTOSAR XML (schema 314)
package /ComponentType
  application software component type Ap_StabilityComp1
  internal behavior Ap_StabilityComp1_InternalBehavior: component=Ap_StabilityComp1
  swc implementation Ap_StabilityComp1_Implementation: behavior=Ap_StabilityComp1_InternalBehavior
    code-descriptors:
      code Code: type=SRC
