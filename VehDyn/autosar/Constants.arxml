AUTOSAR XML (schema 314)
package /Constant
  11 x constant specification:
    D_2MS_SEC_F32
      value:
        real literal D_2MS_SEC_F32: type=Float, value=0.002
    D_CCWEOTINIT_HWDEG_F32
      value:
        real literal D_CCWEOTINIT_HWDEG_F32: type=Float, value=-360
    D_CWEOTINIT_HWDEG_F32
      value:
        real literal D_CWEOTINIT_HWDEG_F32: type=Float, value=360
    D_FALSE_CNT_LGC
      value:
        boolean literal D_FALSE_CNT_LGC: type=Boolean, value=false
    D_FOUR_CNT_U08
      value:
        integer literal D_FOUR_CNT_U08: type=UInt8, value=4
    D_ONE_CNT_U8
      value:
        integer literal D_ONE_CNT_U8: type=UInt8, value=1
    D_ONE_ULS_F32
      value:
        real literal D_ONE_ULS_F32: type=Float, value=1
    D_THREE_CNT_U08
      value:
        integer literal D_THREE_CNT_U08: type=UInt8, value=3
    D_TRUE_CNT_LGC
      value:
        boolean literal D_TRUE_CNT_LGC: type=Boolean, value=true
    D_TWO_CNT_U08
      value:
        integer literal D_TWO_CNT_U08: type=UInt8, value=2
    D_ZERO_ULS_F32
      value:
        real literal D_ZERO_ULS_F32: type=Float, value=0
