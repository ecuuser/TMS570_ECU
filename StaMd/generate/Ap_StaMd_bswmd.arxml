AUTOSAR XML (schema 3.1.2)
package /NEXTEER_DEF
  ecu parameter definition AUTOSARParameterDefinition: module=StaMd
  module definition StaMd [0..1]: variants post-build/pre-compile  # Configuration of the Nexteer States and Modes module.
    container StaMdGeneral  # This container contains the configuration (parameters) of the Nexteer States and Modes
      integer TypeHDataSize: set at pre-compile, origin=Nexteer, default-value=0  # Size of all TypeH Data in Bytes
      string StaMdCPEnable [0..255]: origin=NEXTEER  # This container contains the configuaration (parameters) for the StaMd watchdog checkpoints.
      enumeration StaMdTODType [0..1]: {TOD_2msToggle, TOD_SteadyState, TOD_None}, origin=NEXTEER  # This container contains the configuaration for the type of TOD implementation used.
      string StaMdNvMWriteAllAPI: origin=NEXTEER  # This container defines the API to call to call the NvM Write All funciton
      string StaMdNvMGetErrorStatusAPI: origin=NEXTEER  # This container defines the API to call to call the NvM Get Error Status function
      reference StaMdTrnsDiagMgrShtDwnTaskActivation [0..1]: destination=OsTask  # If StaMdCoreOsAppRef matches the application referneced for DiagMgrDemIfOsAppRef in DiagMgr then the generated output will be a client/server call and this field is ignored. If they do not match, then a task activation call is created and the task defined in this field is activated.
      reference GenerateExcludeOsAppRef [0..255]: destination=OsApplication  # This defines the Applications which do not require a states and modes component.
      reference StaMdCoreOsAppRef: destination=OsApplication  # This defines the Application which is the master states and modes.
      reference StaMdSComOsAppRef: destination=OsApplication  # This defines the Application which interfaces with the serial communication functions
      reference StaMdSysCovOsAppRef: destination=OsApplication  # This defines the Application which performs the states and modes systematic converage
    container CommonPublishedInformation  # Common container, aggregated by all modules. It contains published information about vendor and versions.
      integer ArMajorVersion: set at published-information, origin=Nexteer, default-value=3  # Major version number of AUTOSAR specification on which the appropriate implementation is based on.
      integer ArMinorVersion: set at published-information, origin=Nexteer, default-value=2  # Minor version number of AUTOSAR specification on which the appropriate implementation is based on.
      integer ArPatchVersion: set at published-information, origin=Nexteer, default-value=0  # Patch level version number of AUTOSAR specification on which the appropriate implementation is based on.
      integer SwMajorVersion: set at published-information, origin=Nexteer, default-value=0  # Major version number of the vendor specific implementation of the module.
      integer SwMinorVersion: set at published-information, origin=BMW GroupNexteer, default-value=0  # Minor version number of the vendor specific implementation of the module. The numbering is vendor specific.
      integer SwPatchVersion: set at published-information, origin=Nexteer, default-value=0  # Patch level version number of the vendor specific implementation of the module. The numbering is vendor specific.
      integer ModuleId: set at published-information, origin=Nexteer, default-value=0  # Module ID of this module from Module List
      integer VendorId: set at published-information, origin=Nexteer, default-value=0  # Vendor ID of the dedicated implementation of this module according to the AUTOSAR vendor list
      string VendorApiInfix [0..1]: set at published-information, origin=Nexteer
