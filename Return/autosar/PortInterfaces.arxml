AUTOSAR XML (schema 314)
package /PortInterface
  client server interface FltInjection_SCom
    operation FltInjection
      arg SignalPath_Uls_f32: type=Float, direction=INOUT
      arg LocationKey_Cnt_enum: type=FltInjectionLocType, direction=IN
  10 x sender receiver interface:
    Authority
      data Uls_f32: sw-calibration-access=READ-ONLY, type=Float
    BoolStatusFlag
      data Cnt_lgc: sw-calibration-access=READ-ONLY, type=Boolean
    Enable
      data Cnt_lgc: sw-calibration-access=READ-ONLY, type=Boolean
    HwPos
      data HwDeg_f32: sw-calibration-access=READ-ONLY, type=Float
    HwTrq
      data HwNm_f32: sw-calibration-access=READ-ONLY, type=Float
    HwVel
      data HwRadpS_f32: sw-calibration-access=READ-ONLY, type=Float
    MtrTrq
      data MtrNm_f32: sw-calibration-access=READ-ONLY, type=Float
    Temperature
      data DegC_f32: sw-calibration-access=READ-ONLY, type=Float
    UnityScalar
      data Uls_f32: sw-calibration-access=READ-ONLY, type=Float
    VehSpd
      data Kph_f32: sw-calibration-access=READ-ONLY, type=Float
