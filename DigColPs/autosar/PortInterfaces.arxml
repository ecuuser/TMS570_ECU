AUTOSAR XML (schema 314)
package /PortInterface
  client server interface DigColPs_SCom
    4 x operation:
      CustClearTrim
      CustSetTrim: possible-error=ConditionsNotCorrect
      NxtClrTrim
      NxtSetTrim: possible-error=ConditionsNotCorrect
    error ConditionsNotCorrect: error-code=34
  client server interface NvM_AC3_SRBS_Srv: is-service=true  # Port Interface for NVRAM Blocks of Management Types "NATIVE" or "REDUNDANT" without default values.
    6 x operation:
      EraseBlock: possible-error=NvM_AC3_SRBS_Srv/E_NOT_OK
      GetErrorStatus
        arg ErrorStatus: type=NvM_RequestResultType, direction=OUT
      InvalidateNvBlock: possible-error=NvM_AC3_SRBS_Srv/E_NOT_OK
      ReadBlock: possible-error=NvM_AC3_SRBS_Srv/E_NOT_OK
        arg DstPtr: type=NvM_DestPtr, direction=OUT
      SetRamBlockStatus
        arg RamBlockStatus: type=Boolean, direction=IN
      WriteBlock: possible-error=NvM_AC3_SRBS_Srv/E_NOT_OK
        arg DstPtr: type=NvM_DestPtr, direction=IN
    error E_NOT_OK: error-code=1
  client server interface NxtrDiagMgr
    4 x operation, all with possible-error=NxtrDiagMgr/E_NOT_OK:
      GetNTCActive
        arg NTC_Cnt_T_enum: type=NTCNumber, direction=IN
        arg NTCActive_Ptr_T_lgc: type=Boolean, direction=OUT
      GetNTCFailed
        arg NTC_Cnt_T_enum: type=NTCNumber, direction=IN
        arg NTCFailed_Ptr_T_lgc: type=Boolean, direction=OUT
      GetNTCStatus
        arg NTC_Cnt_T_enum: type=NTCNumber, direction=IN
        arg Status_Ptr_T_u08: type=UInt8, direction=OUT
      SetNTCStatus
        arg NTC_Cnt_T_enum: type=NTCNumber, direction=IN
        arg Param_Cnt_T_u08: type=UInt8, direction=IN
        arg Status_Cnt_T_enum: type=NxtrDiagMgrStatus, direction=IN
    error E_NOT_OK: error-code=1
  sender receiver interface HwPos_HwDeg_f32
    data HwDeg_f32: sw-calibration-access=READ-ONLY, type=Float
  sender receiver interface ManufModes_Cnt_enum
    data Cnt_enum: sw-calibration-access=READ-ONLY, type=ManufModeType
  sender receiver interface Validity_Cnt_lgc
    data Cnt_lgc: sw-calibration-access=READ-ONLY, type=Boolean
