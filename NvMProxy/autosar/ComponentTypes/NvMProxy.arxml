AUTOSAR XML (schema 314)
package /ComponentType
  internal behavior NvMProxy_InternalBehavior: component=NvMProxy
    timing event TMT_NvMProxy_MainFunction: start-on-event=NvMProxy_MainFunction, period=0.01
    operation invoked event OIT_WriteBlock_PS_Rte_NvmBlock_MtrPos_MtrPosSnsr_EOLData_WriteBlock: start-on-event=WriteBlock, operation=PS_Rte_NvmBlock_MtrPos_MtrPosSnsr_EOLData.WriteBlock
    port-api-option enable-take-address=false, indirect-api=false, port=PAdmin_Rte_NvmBlock_MtrPos_MtrPosSnsr_EOLData:
      port-arg-values:
        integer literal NvM_AdminBlockId_0: type=UInt16, value=0
    port-api-option enable-take-address=false, indirect-api=false, port=PS_Rte_NvmBlock_MtrPos_MtrPosSnsr_EOLData:
      port-arg-values:
        integer literal NvM_ServiceBlockId_0: type=UInt16, value=0
    runnable NvMProxy_MainFunction: minimum-start-interval=0.01
    runnable WriteBlock: can-be-invoked-concurrently=true, symbol=NvMProxy_WriteBlock
  service component type NvMProxy: category=ServiceComponent  # Software Component description for NvM ASILD proxy based on generated file from Ecuc Package: ActiveEcuC
    provide port PAdmin_Rte_NvmBlock_MtrPos_MtrPosSnsr_EOLData: server-com-spec{operation=SetBlockProtection, queue-length=1}, provided-interface=NvM_Administration  # P-Port Prototype of NvM_Administration for NVRAM Block Rte_NvmBlock_MtrPos_MtrPosSnsr_EOLData
    provide port PS_Rte_NvmBlock_MtrPos_MtrPosSnsr_EOLData: provided-interface=NvM_AC3_SRBS_Srv  # P-Port Prototype of NvM_AC3_SRBS_Srv for NVRAM Block Rte_NvmBlock_MtrPos_MtrPosSnsr_EOLData
      provided-com-specs:
        operation=EraseBlock, queue-length=1
        operation=GetErrorStatus, queue-length=1
        operation=InvalidateNvBlock, queue-length=1
        operation=ReadBlock, queue-length=1
        operation=SetRamBlockStatus, queue-length=1
        operation=WriteBlock, queue-length=1
  swc implementation NvMProxy_Implementation: behavior=NvMProxy_InternalBehavior
    code-descriptors:
      code Code: type=SRC
