AUTOSAR XML (schema 314)
package /ModeDclrGroup
  mode declaration group StaMd_Mode: initial-mode=WARMINIT  # EPS System State mode declaration
    4 x mode:
      DISABLE
      OFF
      OPERATE
      WARMINIT
package /PortInterface
  27 x client server interface:
    AbsHwPos_SCom
      operation VehicleSystemStatus
        arg NCMAbsHwPos_HwDeg_s11p4: type=SInt16, direction=OUT
    ActivePull_SCom  # Serial communication port for setting and getting a sdoftware component parameter. The parameter is typically an EOL parameter.
      operation Reset: possible-error=[HwTrqConditionsNotCorrect, VehSpdConditionsNotCorrect]
      operation SetLTComp
        arg LTComp_HwNm_f32: type=Float, direction=IN
      operation SetSTComp
        arg STComp_HwNm_f32: type=Float, direction=IN
      error HwTrqConditionsNotCorrect: error-code=11
      error VehSpdConditionsNotCorrect: error-code=5
    DigitalIn
      operation OP_SET: possible-error=DigitalIn/E_NOT_OK
        arg signal: type=IoHwAb_BoolType, direction=IN
      error E_NOT_OK: error-code=1
    DigitalOut
      operation OP_SET: possible-error=DigitalOut/E_NOT_OK
        arg signal: type=IoHwAb_BoolType, direction=IN
      error E_NOT_OK: error-code=1
    FetDrvCntl
      operation OP_GET: possible-error=FetDrvCntl/E_NOT_OK
        arg signal: type=IoHwAb_BoolType, direction=OUT
      error E_NOT_OK: error-code=1
    FltInjection_SCom
      operation FltInjection
        arg SignalPath_Uls_f32: type=Float, direction=INOUT
        arg LocationKey_Cnt_enum: type=FltInjectionLocType, direction=IN
    GeneratePosTraj_SCom  # Serial communication port for setting and getting a sdoftware component parameter. The parameter is typically an EOL parameter.
      operation SetInputParam
        arg PosServHwAngle_HwDeg_f32: type=Float, direction=IN
        arg TargetVelocity_HwDegpSec_f32: type=Float, direction=IN
        arg TargetAcceleration_HwDegpSecSqr_f32: type=Float, direction=IN
    HwTrq_SCom
      7 x operation:
        ClrHwTrqScale: possible-error=HwTrq_SCom/ConditionsNotCorrect
        ClrHwTrqTrim: possible-error=HwTrq_SCom/ConditionsNotCorrect
        ManualSetHwTrqTrim: possible-error=HwTrq_SCom/ConditionsNotCorrect
          arg HwTrqTrimDataPtr: type=HwTrqTrim_Datatype, direction=IN
        ReadHwTrqScale
          arg HwTrqScaleDataPtr: type=HwTrqScale_Datatype, direction=OUT
        ReadHwTrqTrim
          arg HwTrqTrimDatPtr: type=HwTrqTrim_Datatype, direction=OUT
        SetHwTrqScale: possible-error=HwTrq_SCom/ConditionsNotCorrect
          arg ScaleValue: type=Float, direction=IN
        SetHwTrqTrim: possible-error=HwTrq_SCom/ConditionsNotCorrect
      error ConditionsNotCorrect: error-code=34
    LktoLkStr_SCom  # Serial communication port for setting and getting a sdoftware component parameter. The parameter is typically an EOL parameter.
      operation SetInputParam
        arg TargetVelocity_HwDegpSec_f32: type=Float, direction=IN
        arg TargetAcceleration_HwDegpSecSqr_f32: type=Float, direction=IN
    LrnEOT_Scom
      operation ResetEOT
      operation ResetRckCntrPrf
    MilestoneRequest
      operation WarmInitMilestoneComplete
        arg user: type=StaMd_Users, direction=IN
      operation WarmInitMilestoneNotComplete
        arg user: type=StaMd_Users, direction=IN
    NvM_AC3_SRBS_Srv: is-service=true  # Port Interface for NVRAM Blocks of Management Types "NATIVE" or "REDUNDANT" without default values.
      6 x operation:
        EraseBlock: possible-error=NvM_AC3_SRBS_Srv/E_NOT_OK
        GetErrorStatus
          arg ErrorStatus: type=NvM_RequestResultType, direction=OUT
        InvalidateNvBlock: possible-error=NvM_AC3_SRBS_Srv/E_NOT_OK
        ReadBlock: possible-error=NvM_AC3_SRBS_Srv/E_NOT_OK
          arg DstPtr: type=NvM_DestPtr, direction=OUT
        SetRamBlockStatus
          arg RamBlockStatus: type=Boolean, direction=IN
        WriteBlock: possible-error=NvM_AC3_SRBS_Srv/E_NOT_OK
          arg DstPtr: type=NvM_DestPtr, direction=IN
      error E_NOT_OK: error-code=1
    NxtrDiagMgr
      5 x operation, all with possible-error=NxtrDiagMgr/E_NOT_OK:
        GetNTCFailed
          arg NTC: type=NTCNumber, direction=IN
          arg EventFailed: type=Boolean, direction=OUT
        GetNTCStatus
          arg NTC: type=NTCNumber, direction=IN
          arg Status: type=UInt8, direction=OUT
        ResetEventStatus
        SetNTCStatus
          arg NTC: type=NTCNumber, direction=IN
          arg Param: type=UInt8, direction=IN
          arg Status: type=NxtrDiagMgrStatus, direction=IN
        SetOperationCycleState
          arg OperationCycle: type=NxtrOpCycle, direction=IN
          arg CycleState: type=NxtrOpCycleState, direction=IN
      error E_NOT_OK: error-code=1
    OscTraj_SCom  # Serial communication port for passing input parameters to and returning the status of "OscTraj".
      operation SetInputParams
        arg Amplitude_HwDeg_f32: type=Float, direction=IN
        arg Cycles_Cnt_u08: type=UInt8, direction=IN
        arg Frequency_Hz_f32: type=Float, direction=IN
    PwrSwitchEn
      operation OP_GET: possible-error=PwrSwitchEn/E_NOT_OK
        arg signal: type=IoHwAb_BoolType, direction=OUT
      error E_NOT_OK: error-code=1
    RacktoVehCntrOffset_Scom
      operation ClearRacktoVehCntrOffset
      operation SetRacktoVehCntrOffset
    SCom_ParEng  # Serial communication port for setting and getting a sdoftware component parameter. The parameter is typically an EOL parameter.
      operation Get
        arg Par_f32: type=Float, direction=OUT
      operation Set
        arg Par_f32: type=Float, direction=IN
      error ConditionsNotCorrect: error-code=34
      error RequestOutOfRange: error-code=49
    Scom_RtnAsync  # Serial communication port for activating a remote asynchronous routine
      operation Start: possible-error=Scom_RtnAsync/ConditionsNotCorrect
      operation Status: possible-error=Scom_RtnAsync/ConditionsNotCorrect
        arg status: type=RoutineStatus, direction=OUT
      operation Stop: possible-error=Scom_RtnAsync/ConditionsNotCorrect
      error ConditionsNotCorrect: error-code=34
      error RequestOutOfRange: error-code=49
    SCom_RtnSync  # Serial communication port for activating a remote synchronous routine
      operation Start: possible-error=SCom_RtnSync/ConditionsNotCorrect
      error ConditionsNotCorrect: error-code=34
      error RequestOutOfRange: error-code=49
    SysFault2
      operation OP_GET: possible-error=SysFault2/E_NOT_OK
        arg signal: type=IoHwAb_BoolType, direction=OUT
      operation OP_SET: possible-error=SysFault2/E_NOT_OK
        arg signal: type=IoHwAb_BoolType, direction=IN
      error E_NOT_OK: error-code=1
    SysFault3
      operation OP_GET: possible-error=SysFault3/E_NOT_OK
        arg signal: type=IoHwAb_BoolType, direction=OUT
      operation OP_SET: possible-error=SysFault3/E_NOT_OK
        arg signal: type=IoHwAb_BoolType, direction=IN
      error E_NOT_OK: error-code=1
    SystemTime: is-service=true
      6 x operation:
        DtrmnElapsedTime_mS_u16  # Nexteer SystemTime Service
          arg InitialTime: type=UInt32, direction=IN
          arg ElapsedTime: type=UInt16, direction=OUT
        DtrmnElapsedTime_mS_u32
          arg InitialTime: type=UInt32, direction=IN
          arg ElapsedTime: type=UInt32, direction=OUT
        DtrmnElapsedTime_uS_u16
          arg InitialTime: type=UInt32, direction=IN
          arg ElapsedTime: type=UInt16, direction=OUT
        DtrmnElapsedTime_uS_u32
          arg InitialTime: type=UInt32, direction=IN
          arg ElapsedTime: type=UInt32, direction=OUT
        GetSystemTime_mS_u32
          arg CurrentTime: type=UInt32, direction=OUT
        GetSystemTime_uS_u32
          arg CurrentTime: type=UInt32, direction=OUT
    TODReset
      operation OP_SET
        arg signal: type=IoHwAb_BoolType, direction=IN
    TurnsCounter_Scom
      operation ResetTC
    VehicleCenter_Scom
      operation ClearCenterPosition
      operation SetCenterPosition: possible-error=VehicleCenter_Scom/E_NOT_OK
        arg Offset_HwDeg_P_f32: type=Float, direction=IN
      error E_NOT_OK: error-code=1
    WdMonitor
      operation OP_SET: possible-error=WdMonitor/E_NOT_OK
        arg signal: type=IoHwAb_BoolType, direction=IN
      error E_NOT_OK: error-code=1
    WdReset
      operation OP_SET: possible-error=WdReset/E_NOT_OK
        arg signal: type=IoHwAb_BoolType, direction=IN
      error E_NOT_OK: error-code=1
  49 x sender receiver interface:
    Authority
      data Uls_f32: sw-calibration-access=READ-ONLY, type=Float
    BoolStatusFlag
      data Cnt_lgc: sw-calibration-access=READ-ONLY, type=Boolean
    Counter
      data Cnt_u08: sw-calibration-access=READ-ONLY, type=UInt8
    Counts32
      data Cnt_u32: sw-calibration-access=READ-ONLY, type=UInt32
    Current
      data Amp_f32: sw-calibration-access=READ-ONLY, type=Float
    Cycles
      data Cnt_u08: sw-calibration-access=READ-ONLY, type=UInt8
    Direction
      data Cnt_s08: sw-calibration-access=READ-ONLY, type=SInt8
    Enable
      data Cnt_lgc: sw-calibration-access=READ-ONLY, type=Boolean
    EnergyModeState
      data Cnt_enum: sw-calibration-access=READ-ONLY, type=EnergyModeStateType
    ForcekN
      data kN_f32: sw-calibration-access=READ-ONLY, type=Float
    Frequency
      data Hz_f32: sw-calibration-access=READ-ONLY, type=Float
    HwAccel
      data HwDegpSecSqr_f32: sw-calibration-access=READ-ONLY, type=Float
    HwPos
      data HwDeg_f32: sw-calibration-access=READ-ONLY, type=Float
    HwTrq
      data HwNm_f32: sw-calibration-access=READ-ONLY, type=Float
    HwVel
      data HwRadpS_f32: sw-calibration-access=READ-ONLY, type=Float
    HwVelDegpSec
      data HwDegpSec_f32: sw-calibration-access=READ-ONLY, type=Float
    Inductance
      data Henry_f32: sw-calibration-access=READ-ONLY, type=Float
    LktoLkStrState
      data Cnt_enum: sw-calibration-access=READ-ONLY, type=LktoLkStrStateType
    ManufModes
      data Cnt_enum: sw-calibration-access=READ-ONLY, type=ManufModeType
    MtrPosDeg
      data Deg_f32: sw-calibration-access=READ-ONLY, type=Float
    MtrPosRev
      data Rev_f32: sw-calibration-access=READ-ONLY, type=Float
    MtrQuad
      data Cnt_u08: sw-calibration-access=READ-ONLY, type=UInt8
    MtrTrq
      data MtrNm_f32: sw-calibration-access=READ-ONLY, type=Float
    MtrVel
      data MtrRadpS_f32: sw-calibration-access=READ-ONLY, type=Float
    MtrVltConstant
      data VpRadpS_f32: sw-calibration-access=READ-ONLY, type=Float
    OscTrajState
      data Cnt_enum: sw-calibration-access=READ-ONLY, type=OscTrajCmdStateType
    Personalization
      data Cnt_enum: sw-calibration-access=READ-ONLY, type=PersonalizationType
    PhsAdv
      data Cnt_s16: sw-calibration-access=READ-ONLY, type=SInt16
    PkCurr
      data AmpSq_f32: sw-calibration-access=READ-ONLY, type=Float
    Polarity
      data Cnt_s8: sw-calibration-access=READ-ONLY, type=SInt8
    RacktoVehCntrOffset
      data Cnt_u16: sw-calibration-access=READ-ONLY, type=UInt16
    RampRate
      data XpmS_f32: sw-calibration-access=READ-ONLY, type=Float
    Resistance
      data Ohm_f32: sw-calibration-access=READ-ONLY, type=Float
    RevOffsetState
      data Cnt_u08: sw-calibration-access=READ-ONLY, type=UInt8
    ScaleFactor
      data Uls_f32: sw-calibration-access=READ-ONLY, type=Float
    SrlComRevOffset
      data Rev_s16: sw-calibration-access=READ-ONLY, type=SInt16
    SrlComRevOffsetStatus
      data Cnt_u08: sw-calibration-access=READ-ONLY, type=ST_OFFS_QUAD_EPS
    SystemState
      mode declaration group prototype Mode: type=StaMd_Mode
    Temperature
      data DegC_f32: sw-calibration-access=READ-ONLY, type=Float
    TurnsCntrValState
      data Cnt_enum: sw-calibration-access=READ-ONLY, type=TurnsCntrValStateType
    UnityScalar
      data Uls_f32: sw-calibration-access=READ-ONLY, type=Float
    Validity
      data Cnt_lgc: sw-calibration-access=READ-ONLY, type=Boolean
    Vecu
      data Volt_f32: sw-calibration-access=READ-ONLY, range raw >5..<31, type=Float  # This port prototype is inteded to communicate voltage signals that represent the ecu supplied voltage. This signal has a lower limit, which is non-zero, to allow users of the signal to use it as a denominator in an expression without requiring a divide by 0 check.
    VehAccel
      data KphpS_f32: sw-calibration-access=READ-ONLY, type=Float
    VehSpd
      data Kph_f32: sw-calibration-access=READ-ONLY, type=Float
    VltgCtrlTerm
      data Uls_f32: sw-calibration-access=READ-ONLY, type=Float
    Voltage
      data Volt_f32: sw-calibration-access=READ-ONLY, range raw >0..<31, type=Float  # This signal is intended to communicate any type voltage signal measured by the ecu. This signal has a lower limit of 0 which reequires users of the signal to provide divide by 0 protection if it is used as a denominator in a calculation. See Vecu port prototype if a port with a lower limit is desired.
    WhlSpd
      data cRadPerSec_u16: sw-calibration-access=READ-ONLY, type=UInt16
    YawRate
      data DegpS_f32: sw-calibration-access=READ-ONLY, type=Float
