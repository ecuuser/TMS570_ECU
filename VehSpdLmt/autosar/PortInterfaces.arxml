AUTOSAR XML (schema 314)
package /PortInterface
  4 x sender receiver interface:
    Authority
      data Uls_f32: sw-calibration-access=READ-ONLY, type=Float
    HwPos
      data HwDeg_f32: sw-calibration-access=READ-ONLY, type=Float
    MtrTrq
      data MtrNm_f32: sw-calibration-access=READ-ONLY, type=Float
    VehSpd
      data Kph_f32: sw-calibration-access=READ-ONLY, type=Float
