AUTOSAR XML (schema 314)
package /Constant
  constant specification D_FALSE_CNT_LGC
    value:
      boolean literal D_FALSE_CNT_LGC: type=Boolean, value=false
  constant specification D_ZERO_CNT_U16
    value:
      integer literal D_ZERO_CNT_U16: type=UInt16, value=0
  constant specification D_ZERO_ULS_F32
    value:
      real literal D_ZERO_ULS_F32: type=Float, value=0
