AUTOSAR XML (schema 314)
package /Constant
  7 x constant specification:
    D_FALSE_CNT_LGC
      value:
        boolean literal D_FALSE_CNT_LGC: type=Boolean, value=false
    D_FETFAULTPHASEINIT_CNT_ENUM
      value:
        integer literal D_FETFAULTPHASEINIT_CNT_ENUM: type=FETPHASETYPE_ENUM, value=0
    D_FETFAULTTYPEINIT_CNT_ENUM
      value:
        integer literal D_FETFAULTTYPEINIT_CNT_ENUM: type=FETFAULTTYPE_ENUM, value=0
    D_ZERO_CNT_S16
      value:
        integer literal D_ZERO_CNT_S16: type=SInt16, value=0
    D_ZERO_CNT_S8
      value:
        integer literal D_ZERO_CNT_S8: type=SInt8, value=0
    D_ZERO_CNT_U32
      value:
        integer literal D_ZERO_CNT_U32: type=UInt32, value=0
    D_ZERO_ULS_F32
      value:
        real literal D_ZERO_ULS_F32: type=Float, value=0
