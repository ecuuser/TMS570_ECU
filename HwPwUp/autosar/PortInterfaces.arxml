AUTOSAR XML (schema 314)
package /ModeDclrGroup
  mode declaration group StaMd_Mode: initial-mode=WARMINIT  # EPS System State mode declaration
    4 x mode:
      DISABLE
      OFF
      OPERATE
      WARMINIT
package /PortInterface
  client server interface MilestoneRequest
    operation WarmInitMilestoneComplete
      arg user: type=StaMd_Users, direction=IN
    operation WarmInitMilestoneNotComplete
      arg user: type=StaMd_Users, direction=IN
  sender receiver interface BoolStatusFlag_Cnt_lgc
    data Cnt_lgc: sw-calibration-access=READ-ONLY, type=Boolean
  sender receiver interface Enable_Cnt_lgc
    data Cnt_lgc: sw-calibration-access=READ-ONLY, type=Boolean
  sender receiver interface SystemState
    mode declaration group prototype Mode: type=StaMd_Mode
