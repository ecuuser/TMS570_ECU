AUTOSAR XML (schema 321)
package /ComponentType
  internal behavior SpiNxt_InternalBehavior: component=SpiNxt
    operation invoked event OIT_AsyncTransmit_Spi_TcData_Seq_AsyncTransmit: start-on-event=AsyncTransmit, operation=Spi_TcData_Seq.AsyncTransmit
    operation invoked event OIT_GetSequenceResult_Spi_TcData_Seq_GetSequenceResult: start-on-event=GetSequenceResult, operation=Spi_TcData_Seq.GetSequenceResult
    operation invoked event OIT_SetupEB_Spi_TcData_Ch_SetupEB: start-on-event=SetupEB, operation=Spi_TcData_Ch.SetupEB
    timing event TMT_SpiNxt_MainFunction: start-on-event=SpiNxt_MainFunction, period=0.01
    exclusive area SPINXT_EXCLUSIVE_AREA_0  # This exclusive are covers the events that need to be synchronized to minimize jitter on the CS to SCLK delay specified by the TurnsCounter FDD 20C
    port-api-options port-api-option={enable-take-address=false, indirect-api=false, port=Spi_Notification}:
      port-api-option enable-take-address=false, indirect-api=false, port=Spi_TcData_Ch:
        port-arg-values:
          integer literal SPI_TCDATA_CH: type=Spi_ChannelType, value=0
      port-api-option enable-take-address=false, indirect-api=false, port=Spi_TcData_Seq:
        port-arg-values:
          integer literal SPI_TCDATA_SEQ: type=Spi_SequenceType, value=0
    4 x runnable:
      AsyncTransmit: can-enter-exclusive-area=SPINXT_EXCLUSIVE_AREA_0, symbol=SpiNxt_AsyncTransmit
      GetSequenceResult: symbol=SpiNxt_GetSequenceResult
      SetupEB: symbol=SpiNxt_SetupEB
      SpiNxt_MainFunction
  service component type SpiNxt: category=ServiceComponent
    provide port Spi_TcData_Ch: server-com-spec{operation=SetupEB, queue-length=1}, provided-interface=Spi_Ch
    provide port Spi_TcData_Seq: provided-com-specs=[{operation=AsyncTransmit, queue-length=1}, {operation=GetSequenceResult, queue-length=1}], provided-interface=Spi_Seq
    require port Spi_Notification: required-com-specs=[JobEnd, SequenceEnd], required-interface=Spi_Notification
  swc implementation SpiNxt_Implementation: behavior=SpiNxt_InternalBehavior
    code-descriptors:
      code Code: type=SRC
