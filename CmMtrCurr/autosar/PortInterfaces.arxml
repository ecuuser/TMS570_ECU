AUTOSAR XML (schema 314)
package /ModeDclrGroup
  mode declaration group StaMd_Mode: initial-mode=WARMINIT  # EPS System State mode declaration
    4 x mode:
      DISABLE
      OFF
      OPERATE
      WARMINIT
package /PortInterface
  4 x client server interface:
    CmMtrCurr_SCom
      5 x operation:
        CalGain: possible-error=[ConditionNotCorrect, CurrentOutOfRange, VehSpdOutofRange]
        CalOffset: possible-error=[ConditionNotCorrect, CurrentOutOfRange, VehSpdOutofRange]
        MtrCurrOffReadStatus
          arg CurrOffStatus: type=MtrCurrOffProcessFlag, direction=OUT
        ReadMtrCurrCals
          arg ShCurrCalPtr: type=PhaseCurrCal_DataType, direction=OUT
        SetMtrCurrCals
          arg ShCurrCalPtr: type=PhaseCurrCal_DataType, direction=IN
      error ConditionNotCorrect: error-code=34
      error CurrentOutOfRange: error-code=20
      error VehSpdOutofRange: error-code=21
    MtrCurrTempOffset_Scom
      operation Get
        arg CurrTempOffCal: type=CurrTempOffsetType, direction=OUT
      operation Set
        arg CurrTempOffCal: type=CurrTempOffsetType, direction=IN
    NvM_AC3_SRBS_Srv: is-service=true  # Port Interface for NVRAM Blocks of Management Types "NATIVE" or "REDUNDANT" without default values.
      6 x operation:
        EraseBlock: possible-error=NvM_AC3_SRBS_Srv/E_NOT_OK
        GetErrorStatus
          arg ErrorStatus: type=NvM_RequestResultType, direction=OUT
        InvalidateNvBlock: possible-error=NvM_AC3_SRBS_Srv/E_NOT_OK
        ReadBlock: possible-error=NvM_AC3_SRBS_Srv/E_NOT_OK
          arg DstPtr: type=NvM_DestPtr, direction=OUT
        SetRamBlockStatus
          arg RamBlockStatus: type=Boolean, direction=IN
        WriteBlock: possible-error=NvM_AC3_SRBS_Srv/E_NOT_OK
          arg DstPtr: type=NvM_DestPtr, direction=IN
      error E_NOT_OK: error-code=1
    NxtrDiagMgr
      4 x operation, all with possible-error=NxtrDiagMgr/E_NOT_OK:
        GetNTCActive
          arg NTC_Cnt_T_enum: type=NTCNumber, direction=IN
          arg NTCActive_Ptr_T_lgc: type=Boolean, direction=OUT
        GetNTCFailed
          arg NTC_Cnt_T_enum: type=NTCNumber, direction=IN
          arg NTCFailed_Ptr_T_lgc: type=Boolean, direction=OUT
        GetNTCStatus
          arg NTC_Cnt_T_enum: type=NTCNumber, direction=IN
          arg Status_Ptr_T_u08: type=UInt8, direction=OUT
        SetNTCStatus
          arg NTC_Cnt_T_enum: type=NTCNumber, direction=IN
          arg Param_Cnt_T_u08: type=UInt8, direction=IN
          arg Status_Cnt_T_enum: type=NxtrDiagMgrStatus, direction=IN
      error E_NOT_OK: error-code=1
  14 x sender receiver interface:
    Count_Cnt_u16
      data Cnt_u16: sw-calibration-access=READ-ONLY, type=UInt16
    Current_Amp_f32
      data Amp_f32: sw-calibration-access=READ-ONLY, type=Float
    Enable_Cnt_lgc
      data Cnt_lgc: sw-calibration-access=READ-ONLY, type=Boolean
    ManufModes_Cnt_enum
      data Cnt_enum: sw-calibration-access=READ-ONLY, type=ManufModeType
    MtrPos_Rev_f32
      data Rev_f32: sw-calibration-access=READ-ONLY, type=Float
    MtrVel_MtrRadpS_f32
      data MtrRadpS_f32: sw-calibration-access=READ-ONLY, type=Float
    PI_RawADCSig
      data Volts_f32: sw-calibration-access=READ-ONLY, type=Float
    SrlComSvcDft
      data Cnt_b32: sw-calibration-access=READ-ONLY, type=UInt32
    SystemState
      mode declaration group prototype Mode: type=StaMd_Mode
    Temperature_DegC_f32
      data DegC_f32: sw-calibration-access=READ-ONLY, type=Float
    Validity_Cnt_lgc
      data Cnt_lgc: sw-calibration-access=READ-ONLY, type=Boolean
    Vecu_Volt_f32
      data Volt_f32: sw-calibration-access=READ-ONLY, range raw >5..<31, type=Float  # This port prototype is inteded to communicate voltage signals that represent the ecu supplied voltage. This signal has a lower limit, which is non-zero, to allow users of the signal to use it as a denominator in an expression without requiring a divide by 0 check.
    VehSpd_Kph_f32
      data Kph_f32: sw-calibration-access=READ-ONLY, type=Float
    Voltage_Volt_f32
      data Volt_f32: sw-calibration-access=READ-ONLY, range raw >0..<31, type=Float  # This signal is intended to communicate any type voltage signal measured by the ecu. This signal has a lower limit of 0 which reequires users of the signal to provide divide by 0 protection if it is used as a denominator in a calculation. See Vecu port prototype if a port with a lower limit is desired.
