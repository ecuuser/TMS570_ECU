AUTOSAR XML (schema 314)
package /Constant
  6 x constant specification:
    D_2MS_SEC_F32
      value:
        real literal D_2MS_SEC_F32: type=Float, value=0.002
    D_FALSE_CNT_LGC
      value:
        boolean literal D_FALSE_CNT_LGC: type=Boolean, value=false
    D_MTRTRQCMDHILMT_MTRNM_F32
      value:
        real literal D_MTRTRQCMDHILMT_MTRNM_F32: type=Float, value=8.8
    D_MTRTRQCMDLOLMT_MTRNM_F32
      value:
        real literal D_MTRTRQCMDLOLMT_MTRNM_F32: type=Float, value=-8.8
    D_VECUMIN_VOLTS_F32
      value:
        real literal D_VECUMIN_VOLTS_F32: type=Float, value=5
    D_ZERO_ULS_F32
      value:
        real literal D_ZERO_ULS_F32: type=Float, value=0
