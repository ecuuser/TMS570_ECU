AUTOSAR XML (schema 314)
package /PortInterface
  client server interface AssistLmtFunc_Scom
    operation GetSteeringAssistDefeat
      arg SteeringAsstDefeat_Cnt_lgc: type=Boolean, direction=OUT
    operation ManualTrqCmd: possible-error=[RTE_E_MtrTrqLmt_SCom_VSTH, RTE_E_OK]
      arg EnableManualCtrl: type=Boolean, direction=IN
      arg MtrTrqCmd_MtrNm_f32: type=Float, direction=IN
    operation SetSteeringAssistDefeat
      arg SteeringAsstDefeat_Cnt_lgc: type=Boolean, direction=IN
    error RTE_E_MtrTrqLmt_SCom_VSTH: error-code=34
    error RTE_E_OK: error-code=1
  client server interface NvM_AC3_SRBS_Srv: is-service=true  # Port Interface for NVRAM Blocks of Management Types "NATIVE" or "REDUNDANT" without default values.
    6 x operation:
      EraseBlock: possible-error=E_NOT_OK
      GetErrorStatus
        arg ErrorStatus: type=NvM_RequestResultType, direction=OUT
      InvalidateNvBlock: possible-error=E_NOT_OK
      ReadBlock: possible-error=E_NOT_OK
        arg DstPtr: type=NvM_DestPtr, direction=OUT
      SetRamBlockStatus
        arg RamBlockStatus: type=Boolean, direction=IN
      WriteBlock: possible-error=E_NOT_OK
        arg DstPtr: type=NvM_DestPtr, direction=IN
    error E_NOT_OK: error-code=1
  5 x sender receiver interface:
    Enable_Cnt_lgc
      data Cnt_lgc: sw-calibration-access=READ-ONLY, type=Boolean
    MtrTrq_MtrNm_f32
      data MtrNm_f32: sw-calibration-access=READ-ONLY, type=Float
    ScaleFactor_Uls_f32
      data Uls_f32: sw-calibration-access=READ-ONLY, type=Float
    UnityScalar_Uls_f32
      data Uls_f32: sw-calibration-access=READ-ONLY, type=Float
    VehSpd_Kph_f32
      data Kph_f32: sw-calibration-access=READ-ONLY, type=Float
