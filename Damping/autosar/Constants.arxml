AUTOSAR XML (schema 314)
package /Constant
  35 x constant specification:
    D_180OVRPI_ULS_F32
      value:
        real literal D_180OVRPI_ULS_F32: type=Float, value=57.295779513082
    D_2MS_SEC_F32
      value:
        real literal D_2MS_SEC_F32: type=Float, value=0.002
    D_2PI_ULS_F32
      value:
        real literal D_2PI_ULS_F32: type=Float, value=6.2831853071796
    D_FALSE_CNT_LGC
      value:
        boolean literal D_FALSE_CNT_LGC: type=Boolean, value=false
    D_MSECPERSEC_ULS_F32
      value:
        real literal D_MSECPERSEC_ULS_F32: type=Float, value=1000
    D_MTRPOLESDIV2_CNT_U8
      value:
        integer literal D_MTRPOLESDIV2_CNT_U8: type=UInt8, value=3
    D_MTRTRQCMDHILMT_MTRNM_F32
      value:
        real literal D_MTRTRQCMDHILMT_MTRNM_F32: type=Float, value=8.8
    D_MTRTRQCMDLOLMT_MTRNM_F32
      value:
        real literal D_MTRTRQCMDLOLMT_MTRNM_F32: type=Float, value=-8.8
    D_NEGONE_CNT_S16
      value:
        integer literal D_NEGONE_CNT_S16: type=SInt16, value=-1
    D_NEGONE_CNT_S32
      value:
        integer literal D_NEGONE_CNT_S32: type=SInt32, value=-1
    D_NEGONE_CNT_S8
      value:
        integer literal D_NEGONE_CNT_S8: type=SInt8, value=-1
    D_ONE_CNT_S16
      value:
        integer literal D_ONE_CNT_S16: type=SInt16, value=1
    D_ONE_CNT_S32
      value:
        integer literal D_ONE_CNT_S32: type=SInt32, value=1
    D_ONE_CNT_S8
      value:
        integer literal D_ONE_CNT_S8: type=SInt8, value=1
    D_ONE_CNT_U16
      value:
        integer literal D_ONE_CNT_U16: type=UInt16, value=1
    D_ONE_CNT_U32
      value:
        integer literal D_ONE_CNT_U32: type=UInt32, value=1
    D_ONE_CNT_U8
      value:
        integer literal D_ONE_CNT_U8: type=UInt8, value=1
    D_ONE_ULS_F32
      value:
        real literal D_ONE_ULS_F32: type=Float, value=1
    D_PI_ULS_F32
      value:
        real literal D_PI_ULS_F32: type=Float, value=3.1415926535898
    D_PIOVR180_ULS_F32
      value:
        real literal D_PIOVR180_ULS_F32: type=Float, value=0.0174532925199
    D_QUADRANT1_CNT_U8
      value:
        integer literal D_QUADRANT1_CNT_U8: type=UInt8, value=1
    D_QUADRANT2_CNT_U8
      value:
        integer literal D_QUADRANT2_CNT_U8: type=UInt8, value=2
    D_QUADRANT3_CNT_U8
      value:
        integer literal D_QUADRANT3_CNT_U8: type=UInt8, value=3
    D_QUADRANT4_CNT_U8
      value:
        integer literal D_QUADRANT4_CNT_U8: type=UInt8, value=4
    D_RADPERREV_ULS_F32
      value:
        real literal D_RADPERREV_ULS_F32: type=Float, value=6.28318530718
    D_SFINVMILLI_ULS_F32
      value:
        real literal D_SFINVMILLI_ULS_F32: type=Double, value=1000
    D_TRUE_CNT_LGC
      value:
        boolean literal D_TRUE_CNT_LGC: type=Boolean, value=true
    D_VECUMIN_VOLTS_F32
      value:
        real literal D_VECUMIN_VOLTS_F32: type=Float, value=5
    D_ZERO_CNT_S16
      value:
        integer literal D_ZERO_CNT_S16: type=SInt16, value=0
    D_ZERO_CNT_S32
      value:
        integer literal D_ZERO_CNT_S32: type=SInt32, value=0
    D_ZERO_CNT_S8
      value:
        integer literal D_ZERO_CNT_S8: type=SInt8, value=0
    D_ZERO_CNT_U16
      value:
        integer literal D_ZERO_CNT_U16: type=UInt16, value=0
    D_ZERO_CNT_U32
      value:
        integer literal D_ZERO_CNT_U32: type=UInt32, value=0
    D_ZERO_CNT_U8
      value:
        integer literal D_ZERO_CNT_U8: type=UInt8, value=0
    D_ZERO_ULS_F32
      value:
        real literal D_ZERO_ULS_F32: type=Float, value=0
