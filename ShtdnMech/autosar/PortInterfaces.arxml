AUTOSAR XML (schema 314)
package /ModeDclrGroup
  mode declaration group StaMd_Mode: initial-mode=WARMINIT  # EPS System State mode declaration
    4 x mode:
      DISABLE
      OFF
      OPERATE
      WARMINIT
package /PortInterface
  client server interface FetDrvReset
    operation OP_GET: possible-error=FetDrvReset/E_NOT_OK
      arg signal: type=IoHwAb_BoolType, direction=OUT
    operation OP_SET: possible-error=FetDrvReset/E_NOT_OK
      arg signal: type=IoHwAb_BoolType, direction=IN
    error E_NOT_OK: error-code=1
  client server interface SysFault2
    operation OP_GET: possible-error=SysFault2/E_NOT_OK
      arg signal: type=IoHwAb_BoolType, direction=OUT
    operation OP_SET: possible-error=SysFault2/E_NOT_OK
      arg signal: type=IoHwAb_BoolType, direction=IN
    error E_NOT_OK: error-code=1
  client server interface SysFault3
    operation OP_GET: possible-error=SysFault3/E_NOT_OK
      arg signal: type=IoHwAb_BoolType, direction=OUT
    operation OP_SET: possible-error=SysFault3/E_NOT_OK
      arg signal: type=IoHwAb_BoolType, direction=IN
    error E_NOT_OK: error-code=1
  sender receiver interface SystemState
    mode declaration group prototype Mode: type=StaMd_Mode
