AUTOSAR XML (schema 314)
standard types defined: Boolean, SInt16, SInt32, SInt8, UInt16, UInt32, UInt8, Double, Float
package /DataType
  array type DT_SinTanLkpTbl_f32
    element DT_SinTanLkpTbl_f32: type=Float, max-number-of-elements=193
