AUTOSAR XML (schema 314)
package /ModeDclrGroup
  mode declaration group StaMd_Mode: initial-mode=WARMINIT  # EPS System State mode declaration
    4 x mode:
      DISABLE
      OFF
      OPERATE
      WARMINIT
package /PortInterface
  4 x client server interface:
    NvM_AC3_SRBS_Srv: is-service=true  # Port Interface for NVRAM Blocks of Management Types "NATIVE" or "REDUNDANT" without default values.
      6 x operation:
        EraseBlock: possible-error=E_NOT_OK
        GetErrorStatus
          arg ErrorStatus: type=NvM_RequestResultType, direction=OUT
        InvalidateNvBlock: possible-error=E_NOT_OK
        ReadBlock: possible-error=E_NOT_OK
          arg DstPtr: type=NvM_DestPtr, direction=OUT
        SetRamBlockStatus
          arg RamBlockStatus: type=Boolean, direction=IN
        WriteBlock: possible-error=E_NOT_OK
          arg DstPtr: type=NvM_DestPtr, direction=IN
      error E_NOT_OK: error-code=1
    SCom_EOLNomMtrParam  # Serial communication port for setting and getting a sdoftware component parameter. The parameter is typically an EOL parameter.
      operation Get
        arg NomKe_VpRadpS_f32: type=Float, direction=OUT
        arg NomRmtr_Ohm_f32: type=Float, direction=OUT
      operation Set
        arg NomKe_VpRadpS_f32: type=Float, direction=IN
        arg NomRmtr_Ohm_f32: type=Float, direction=IN
      error ConditionsNotCorrect: error-code=34
      error RequestOutOfRange: error-code=49
    SCom_ParEng  # Serial communication port for setting and getting a sdoftware component parameter. The parameter is typically an EOL parameter.
      operation Get
        arg Par_f32: type=Float, direction=OUT
      operation Set
        arg Par_f32: type=Float, direction=IN
      error ConditionsNotCorrect: error-code=34
      error RequestOutOfRange: error-code=49
    TrqCanc_Scom
      4 x operation:
        ReadCogTrqCal
          arg CogTrqCalPtr: type=CoggingCancTrq, direction=OUT
          arg ID: type=UInt16, direction=IN
        ReadCogTrqCalComp
          arg ID: type=UInt16, direction=IN
          arg CogTrqCalPtr: type=CoggingCancTrq, direction=OUT
        SetCogTrqCal
          arg CogTrqCalPtr: type=CoggingCancTrq, direction=IN
          arg ID: type=UInt16, direction=IN
        SetCogTrqCalComp
          arg ID: type=UInt16, direction=IN
          arg CogTrqCalPtr: type=CoggingCancTrq, direction=OUT
  18 x sender receiver interface:
    BoolStatusFlag_Cnt_lgc
      data Cnt_lgc: sw-calibration-access=READ-ONLY, type=Boolean
    Count_Cnt_s16
      data Cnt_s16: sw-calibration-access=READ-ONLY, type=SInt16
    Current_Amp_f32
      data Amp_f32: sw-calibration-access=READ-ONLY, type=Float
    Direction_Cnt_s08
      data Cnt_s08: sw-calibration-access=READ-ONLY, type=SInt8
    Inductance_Henry_f32
      data Henry_f32: sw-calibration-access=READ-ONLY, type=Float
    MtrPos_Deg_f32
      data Deg_f32: sw-calibration-access=READ-ONLY, type=Float
    MtrPos_Rev_f32
      data Rev_f32: sw-calibration-access=READ-ONLY, type=Float
    MtrQuad_Cnt_u08
      data Cnt_u08: sw-calibration-access=READ-ONLY, type=UInt8
    MtrTrq_MtrNm_f32
      data MtrNm_f32: sw-calibration-access=READ-ONLY, type=Float
    MtrVel_MtrRadpS_f32
      data MtrRadpS_f32: sw-calibration-access=READ-ONLY, type=Float
    MtrVltConstant_VpRadpS_f32
      data VpRadpS_f32: sw-calibration-access=READ-ONLY, type=Float
    PkCurr_AmpSq_f32
      data AmpSq_f32: sw-calibration-access=READ-ONLY, type=Float
    Resistance_Ohm_f32
      data Ohm_f32: sw-calibration-access=READ-ONLY, type=Float
    SystemState
      mode declaration group prototype Mode: type=StaMd_Mode
    Temperature_DegC_f32
      data DegC_f32: sw-calibration-access=READ-ONLY, type=Float
    Vecu_Volt_f32
      data Volt_f32: sw-calibration-access=READ-ONLY, range raw >5..<31, type=Float  # This port prototype is inteded to communicate voltage signals that represent the ecu supplied voltage. This signal has a lower limit, which is non-zero, to allow users of the signal to use it as a denominator in an expression without requiring a divide by 0 check.
    VehSpd_Kph_f32
      data Kph_f32: sw-calibration-access=READ-ONLY, type=Float
    Voltage_Volt_f32
      data Volt_f32: sw-calibration-access=READ-ONLY, range raw >0..<31, type=Float  # This signal is intended to communicate any type voltage signal measured by the ecu. This signal has a lower limit of 0 which reequires users of the signal to provide divide by 0 protection if it is used as a denominator in a calculation. See Vecu port prototype if a port with a lower limit is desired.
