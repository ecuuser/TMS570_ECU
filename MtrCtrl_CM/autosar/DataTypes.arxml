AUTOSAR XML (schema 314)
standard types defined: Boolean, SInt16, SInt8, UInt16, UInt8, Float
package /DataType
  array type CoggingCancTrq
    element CoggingCancTrq: type=UInt16, max-number-of-elements=512
  array type CoggingCancTrqRplComp
    element CoggingCancTrqRplComp: type=UInt16, max-number-of-elements=9
  array type NvM_DestPtr  # DataPtr Type to be used by WriteBlock, ReadBlock and RestoreBlockDefaults operations. This type is used for all NVRAM blocks
    element NvM_DestPtr: type=UInt8, max-number-of-elements=65535
  integer type NvM_RequestResultType: compu {0=NVM_REQ_OK, 1=NVM_REQ_NOT_OK, 2=NVM_REQ_PENDING, 3=NVM_REQ_INTEGRITY_FAILED, 4=NVM_REQ_BLOCK_SKIPPED, 5=NVM_REQ_NV_INVALIDATED}, lower-limit=0, upper-limit=5
  record type EOLNomMtrParamType
    record element NomKe_VpRadpS_f32: type=Float
    record element NomRmtr_Ohm_f32: type=Float
