AUTOSAR XML (schema 3.1.2)
package /NEXTEER_DEF
  ecu parameter definition AUTOSARParameterDefinition: module=uDiag
  module definition uDiag [0..1]: variants pre-compile  # Configuration of the Microprocessor diagnostics module
    container uDiagRegChkConfigSet [0..1]  # This container defines the register checks performed.
      container uDiagRegCheck [0..32767]: multiple-configuration-container=true  # This container specifies configuration parameters for an individual register test.
        integer uDiagRegAddress: 0..4294967295, set at pre-compile in variant pre-compile+link-time / post-build in variant post-build, origin=Nexteer  # Address of the Register check.
        integer uDiagRegValue: 0..4294967295, set at pre-compile in variant pre-compile+link-time / post-build in variant post-build, origin=Nexteer  # The expected static value of the register after initialization.
      container uDiagRegCheckLnk [0..32767]  # This container specifies configuration parameters for an individual register test using symbolic value references resolved at link time.
        integer uDiagRegAddress: 0..4294967295, set at pre-compile in variant pre-compile+link-time / post-build in variant post-build, origin=Nexteer  # Address of the Register check.
        string uDiagRegValueLnk: set at pre-compile in variant pre-compile+link-time / post-build in variant post-build, origin=Nexteer, symbolic-name-value=true  # This symbolic name defines an address that is used in conjunction with offset parameter to define the expected static value of the register after initialization.
        boolean uDiagRegUseSizeofInOffset: set at pre-compile in variant pre-compile+link-time / post-build in variant post-build, origin=Nexteer, default-value=false  # Use sizeof(symbolic name used in uDiagRegValueLnk) in offset true: add sizeof(symbolic name used in uDiagRegValueLnk) to offset value given in uDiagRegValueLnkOffset false: do not use sizeof -- use only offset value given in uDiagRegValueLnkOffset
        integer uDiagRegValueLnkOffset: -8..4294967295, set at pre-compile in variant pre-compile+link-time / post-build in variant post-build, origin=Nexteer, default-value=0  # Integer offset added to symbolic address to compute static register value .
    container CommonPublishedInformation  # Common container, aggregated by all modules. It contains published information about vendor and versions.
      integer ArMajorVersion: set at published-information, origin=Nexteer, default-value=1  # Major version number of AUTOSAR specification on which the appropriate implementation is based on.
      integer ArMinorVersion: set at published-information, origin=Nexteer, default-value=2  # Minor version number of AUTOSAR specification on which the appropriate implementation is based on.
      integer ArPatchVersion: set at published-information, origin=Nexteer, default-value=0  # Patch level version number of AUTOSAR specification on which the appropriate implementation is based on.
      integer SwMajorVersion: set at published-information, origin=Nexteer, default-value=1  # Major version number of the vendor specific implementation of the module.
      integer SwMinorVersion: set at published-information, origin=Nexteer, default-value=0  # Minor version number of the vendor specific implementation of the module. The numbering is vendor specific.
      integer SwPatchVersion: set at published-information, origin=Nexteer, default-value=0  # Patch level version number of the vendor specific implementation of the module. The numbering is vendor specific.
      integer ModuleId: set at published-information, origin=Nexteer, default-value=104  # Module ID of this module from Module List
      integer VendorId: set at published-information, origin=Nexteer, default-value=0  # Vendor ID of the dedicated implementation of this module according to the AUTOSAR vendor list
      string VendorApiInfix [0..1]: set at published-information, origin=Nexteer
    container uDiagGeneral  # This container contains the configuration (parameters) of Nexteer uDiag
      integer uDiagVCLK_kHz: 0..4294967295, set at pre-compile in variant pre-compile+link-time / post-build in variant post-build, origin=Nexteer  # The frequency of the VCLK in KHz.
      enumeration uDiagEnableFPUDiag: {STD_ON, STD_OFF}, origin=NEXTEER  # Enables the floating point exception diagnostic
      enumeration uDiagGladiatorCompatible: {STD_ON, STD_OFF}, origin=NEXTEER  # Select STD_ON if code compatibility is required between Gladiator and Champion parts; Select STD_OFF for Champion-only
      enumeration uDiagVIMPerTrusted: {STD_ON, STD_OFF}, origin=NEXTEER  # uDiagVIM_Per is called from a trusted task (STD_ON) or not (STD_OFF)
      enumeration uDiagECCPerTrusted: {STD_ON, STD_OFF}, origin=NEXTEER  # uDiagECC_Per is called from a trusted task (STD_ON) or not (STD_OFF)
      string uDiagVimTableName: origin=NEXTEER, symbolic-name-value=true  # This parameter specifes the name of the VIM value constant table to be used for the diagnostic check. The table is generally defined in the Os configuration, but has no standardized name.
      enumeration uDiagCPEnable [0..255]: {uDiagLossOfExec_Per2_CP0, uDiagLossOfExec_Per2_CP1, uDiagLossOfExec_Per3_CP0, uDiagLossOfExec_Per3_CP1, uDiagStaticRegs_Per_CP0, uDiagStaticRegs_Per_CP1, uDiagVIM_Per_CP0, uDiagVIM_Per_CP1, uDiagECC_Per_CP0, uDiagECC_Per_CP1}, origin=NEXTEER  # This container contains the configuaration (parameters) for the uDiag watchdog checkpoints.
      enumeration WdgMVersion: {TTTech_v2.0.3, None}, origin=NEXTEER  # This contains the version of WdgM used for determining watchdog reset source
      string uDiagIncludes [0..100]: origin=NEXTEER, symbolic-name-value=true  # This parameter specifes the include files that contain the defintions of any symbols referenced in the RegCheckConfigSet containers.
