AUTOSAR XML (schema 3.2.1)
# Copyright © Vector Informatik GmbH 2014
package /InitialEcuC
  ecu configuration InitialEcuC: ecu-extract=System, module=[Can, CanIf, CanSM, CanTp, Com, CanNm, Nm, EcuC, PduR, ComM]
  module config Can
    CanGeneral: CanIndex=0
    CanConfigSet
      CCAN (CanController): CanControllerActivation=true, CanControllerBaudRate=500
  module config CanIf
    CanIfPublicConfiguration
    CanIfPrivateConfiguration
    CanIfInitConfiguration: CanIfConfigSet=initConfiguration
      CanIfInitHohConfig: CanIfRefConfigSet=CanConfigSet
      CT_CCAN (CanIfInitControllerConfig)
      3 x CanIfRxPduConfig:
        BCM_COMMAND__CCAN: CanIfCanRxPduCanId=250, CanIfCanRxPduDlc=5, CanIfRxPduIdCanIdType=STANDARD_CAN, PduIdRef=PduCollection/BCM_COMMAND__CCAN
        BSM1__CCAN: CanIfCanRxPduCanId=242, CanIfCanRxPduDlc=8, CanIfRxPduIdCanIdType=STANDARD_CAN, PduIdRef=PduCollection/BSM1__CCAN
        CFG_DATA_CODE_REQUEST__CCAN: CanIfCanRxPduCanId=504446976, CanIfCanRxPduDlc=6, CanIfRxPduIdCanIdType=EXTENDED_CAN, PduIdRef=PduCollection/CFG_DATA_CODE_REQUEST__CCAN
      CFG_DATA_CODE_RSP_EPS__CCAN (CanIfTxPduConfig):
        CanIfCanTxPduIdCanId = 504446978
        CanIfCanTxPduIdDlc = 6
        CanIfCanTxPduType = STATIC
        CanIfTxPduIdCanIdType = EXTENDED_CAN
        PduIdRef = PduCollection/CFG_DATA_CODE_RSP_EPS__CCAN
      DIAGNOSTIC_REQUEST_EPS_Tp__CCAN (CanIfRxPduConfig): CanIfCanRxPduCanId=416952564, CanIfCanRxPduDlc=8, CanIfRxPduIdCanIdType=EXTENDED_CAN, PduIdRef=PduCollection/DIAGNOSTIC_REQUEST_EPS_Tp__CCAN_Rx
      DIAGNOSTIC_REQUEST_FUNCTIONAL_Tp__CCAN (CanIfRxPduConfig):
        CanIfCanRxPduCanId = 417070836
        CanIfCanRxPduDlc = 8
        CanIfRxPduIdCanIdType = EXTENDED_CAN
        PduIdRef = PduCollection/DIAGNOSTIC_REQUEST_FUNCTIONAL_Tp__CCAN_Rx
      DIAGNOSTIC_RESPONSE_EPS_Tp__CCAN (CanIfTxPduConfig):
        CanIfCanTxPduIdCanId = 417002544
        CanIfCanTxPduIdDlc = 8
        CanIfCanTxPduType = STATIC
        CanIfTxPduIdCanIdType = EXTENDED_CAN
        PduIdRef = DIAGNOSTIC_RESPONSE_EPS_Tp__CCAN_Rx
      GE__CCAN (CanIfTxPduConfig): CanIfCanTxPduIdCanId=222, CanIfCanTxPduIdDlc=6, CanIfCanTxPduType=STATIC, CanIfTxPduIdCanIdType=STANDARD_CAN, PduIdRef=PduCollection/GE__CCAN
      GliwaMaster__CCAN (CanIfRxPduConfig): CanIfCanRxPduCanId=2032, CanIfCanRxPduDlc=8, CanIfRxPduIdCanIdType=STANDARD_CAN, PduIdRef=PduCollection/GliwaMaster__CCAN
      GliwaSlave__CCAN (CanIfTxPduConfig):
        CanIfCanTxPduIdCanId = 2033
        CanIfCanTxPduIdDlc = 8
        CanIfCanTxPduType = STATIC
        CanIfTxPduIdCanIdType = STANDARD_CAN
        PduIdRef = PduCollection/GliwaSlave__CCAN
      5 x CanIfRxPduConfig:
        MOT1__CCAN: CanIfCanRxPduCanId=230, CanIfCanRxPduDlc=8, CanIfRxPduIdCanIdType=STANDARD_CAN, PduIdRef=PduCollection/MOT1__CCAN
        MOT3__CCAN: CanIfCanRxPduCanId=750, CanIfCanRxPduDlc=8, CanIfRxPduIdCanIdType=STANDARD_CAN, PduIdRef=PduCollection/MOT3__CCAN
        NM_BCM__CCAN: CanIfCanRxPduCanId=506724352, CanIfCanRxPduDlc=2, CanIfRxPduIdCanIdType=EXTENDED_CAN, PduIdRef=PduCollection/NM_BCM__CCAN
        NM_BSM__CCAN: CanIfCanRxPduCanId=506724358, CanIfCanRxPduDlc=2, CanIfRxPduIdCanIdType=EXTENDED_CAN, PduIdRef=PduCollection/NM_BSM__CCAN
        NM_ECM__CCAN: CanIfCanRxPduCanId=506724353, CanIfCanRxPduDlc=2, CanIfRxPduIdCanIdType=EXTENDED_CAN, PduIdRef=PduCollection/NM_ECM__CCAN
      NM_EPS__CCAN (CanIfTxPduConfig):
        CanIfCanTxPduIdCanId = 506724354
        CanIfCanTxPduIdDlc = 2
        CanIfCanTxPduType = STATIC
        CanIfTxPduIdCanIdType = EXTENDED_CAN
        PduIdRef = PduCollection/NM_EPS__CCAN
      NM_IPC__CCAN (CanIfRxPduConfig): CanIfCanRxPduCanId=506724355, CanIfCanRxPduDlc=2, CanIfRxPduIdCanIdType=EXTENDED_CAN, PduIdRef=PduCollection/NM_IPC__CCAN
      NM_TRANSMISSION__CCAN (CanIfRxPduConfig): CanIfCanRxPduCanId=506724363, CanIfCanRxPduDlc=2, CanIfRxPduIdCanIdType=EXTENDED_CAN, PduIdRef=PduCollection/NM_TRANSMISSION__CCAN
      PDC_INFO_EPS__CCAN (CanIfTxPduConfig):
        CanIfCanTxPduIdCanId = 506855426
        CanIfCanTxPduIdDlc = 3
        CanIfCanTxPduType = STATIC
        CanIfTxPduIdCanIdType = EXTENDED_CAN
        PduIdRef = PduCollection/PDC_INFO_EPS__CCAN
      3 x CanIfRxPduConfig, all with CanIfRxPduIdCanIdType=STANDARD_CAN:
        STATUS_C_BCM2__CCAN: CanIfCanRxPduCanId=1204, CanIfCanRxPduDlc=5, PduIdRef=PduCollection/STATUS_C_BCM2__CCAN
        STATUS_C_IPC__CCAN: CanIfCanRxPduCanId=1049, CanIfCanRxPduDlc=8, PduIdRef=PduCollection/STATUS_C_IPC__CCAN
        XcpMaster__CCAN: CanIfCanRxPduCanId=1685, CanIfCanRxPduDlc=8, PduIdRef=PduCollection/XcpMaster__CCAN
      XcpSlave__CCAN (CanIfTxPduConfig): CanIfCanTxPduIdCanId=1765, CanIfCanTxPduIdDlc=8, CanIfCanTxPduType=STATIC, CanIfTxPduIdCanIdType=STANDARD_CAN, PduIdRef=PduCollection/XcpSlave__CCAN
    CanIfDriverConfig: CanIfDriverNameRef=CanGeneral, CanIfInitHohConfigRef=CanIfInitHohConfig
    CT_CCAN (CanIfControllerConfig): CanIfDriverNameRef=CanIfDriverConfig, CanIfInitControllerRef=CanIfInitConfiguration/CT_CCAN
  module config CanSM
    CanStateManagerConfiguration
      CCAN (CanStateManagerNetworks): CanSMNetworkHandle=ComM/CCAN
        CT_CCAN (CanStateManagerControllers): CanSMControllerId=CanConfigSet/CCAN
  module config CanTp
    CanTpGeneral
    DIAGNOSTIC_REQUEST_FUNCTIONAL__CCAN (CanTpRxNSdu): CanTpAddressingFormat=CANTP_STANDARD, CanTpRxTaType=CANTP_FUNCTIONAL, CanTpRxNSduRef=PduCollection/DIAGNOSTIC_REQUEST_FUNCTIONAL__CCAN
      DIAGNOSTIC_REQUEST_FUNCTIONAL_Tp__CCAN_Rx (CanTpRxNPdu): CanTpRxNPduRef=PduCollection/DIAGNOSTIC_REQUEST_FUNCTIONAL_Tp__CCAN_Rx
    DIAGNOSTIC_RESPONSE_EPS__CCAN (CanTpTxNSdu): CanTpAddressingMode=CANTP_STANDARD, CanTpTxTaType=CANTP_PHYSICAL, CanTpTxNSduRef=PduCollection/DIAGNOSTIC_RESPONSE_EPS__CCAN
      DIAGNOSTIC_RESPONSE_EPS_Tp__CCAN_0 (CanTpTxNPdu): CanTpTxNPduRef=DIAGNOSTIC_RESPONSE_EPS_Tp__CCAN_Rx
      DIAGNOSTIC_REQUEST_EPS_Tp__CCAN_Rx (CanTpRxFcNPdu): CanTpRxFcNPduRef=PduCollection/DIAGNOSTIC_REQUEST_EPS_Tp__CCAN_Rx
    DIAGNOSTIC_REQUEST_EPS__CCAN_EPS (CanTpRxNSdu): CanTpAddressingFormat=CANTP_STANDARD, CanTpRxTaType=CANTP_PHYSICAL, CanTpRxNSduRef=DIAGNOSTIC_REQUEST_EPS__CCAN
      DIAGNOSTIC_REQUEST_EPS_Tp__CCAN_Rx_1 (CanTpRxNPdu): CanTpRxNPduRef=PduCollection/DIAGNOSTIC_REQUEST_EPS_Tp__CCAN_Rx
      DIAGNOSTIC_REQUEST_EPS_Tp__CCAN_1 (CanTpTxFcNPdu): CanTpTxFcNPduRef=DIAGNOSTIC_RESPONSE_EPS_Tp__CCAN_Rx
  module config Com
    ComGeneral: ComConfigurationTimeBase=0.001
    ComConfig
      PduGrp_EPS__CCAN_Rx (ComIPduGroup)
      PduGrp_EPS__CCAN_Tx (ComIPduGroup)
      10 x ComIPdu:
        Pdu_BCM_COMMAND__CCAN: ComIpduDirection=RECEIVE, ComIPduSize=5, ComIPduGroupRef=PduGrp_EPS__CCAN_Rx, ComIPduSignalRef=Com_OperationalModeSts__BCM_COMMAND__CCAN, PduIdRef=PduCollection/BCM_COMMAND__CCAN
        Pdu_BSM1__CCAN: ComIpduDirection=RECEIVE, ComIPduSize=8, ComIPduGroupRef=PduGrp_EPS__CCAN_Rx, ComIPduSignalRef=Com_VehicleSpeedVSOSig__BSM1__CCAN, ComIPduSignalRef=Com_VehicleSpeedVSOSigFailSts__BSM1__CCAN, ComIPduSignalRef=Com_MessageCounter_B1__BSM1__CCAN, ComIPduSignalRef=Com_CRC_B1__BSM1__CCAN, PduIdRef=PduCollection/BSM1__CCAN
        Pdu_CFG_DATA_CODE_REQUEST__CCAN: ComIpduDirection=RECEIVE, ComIPduSize=6, ComIPduGroupRef=PduGrp_EPS__CCAN_Rx, ComIPduSignalRef=Com_Digit_10__CFG_DATA_CODE_REQUEST__CCAN, ComIPduSignalRef=Com_Digit_11__CFG_DATA_CODE_REQUEST__CCAN, ComIPduSignalRef=Com_Digit_08__CFG_DATA_CODE_REQUEST__CCAN, ComIPduSignalRef=Com_Digit_09__CFG_DATA_CODE_REQUEST__CCAN, ComIPduSignalRef=Com_Digit_06__CFG_DATA_CODE_REQUEST__CCAN, ComIPduSignalRef=Com_Digit_07__CFG_DATA_CODE_REQUEST__CCAN, ComIPduSignalRef=Com_Digit_04__CFG_DATA_CODE_REQUEST__CCAN, ComIPduSignalRef=Com_Digit_05__CFG_DATA_CODE_REQUEST__CCAN, ComIPduSignalRef=Com_Digit_02__CFG_DATA_CODE_REQUEST__CCAN, ComIPduSignalRef=Com_Digit_03__CFG_DATA_CODE_REQUEST__CCAN, ComIPduSignalRef=Com_Digit_01__CFG_DATA_CODE_REQUEST__CCAN, PduIdRef=PduCollection/CFG_DATA_CODE_REQUEST__CCAN
        Pdu_CFG_DATA_CODE_RSP_EPS__CCAN: ComIpduDirection=SEND, ComIPduSize=6, ComIPduGroupRef=PduGrp_EPS__CCAN_Tx, ComIPduSignalRef=Com_Digit_10_EPS__CFG_DATA_CODE_RSP_EPS__CCAN, ComIPduSignalRef=Com_Digit_11_EPS__CFG_DATA_CODE_RSP_EPS__CCAN, ComIPduSignalRef=Com_Digit_08_EPS__CFG_DATA_CODE_RSP_EPS__CCAN, ComIPduSignalRef=Com_Digit_09_EPS__CFG_DATA_CODE_RSP_EPS__CCAN, ComIPduSignalRef=Com_Digit_06_EPS__CFG_DATA_CODE_RSP_EPS__CCAN, ComIPduSignalRef=Com_Digit_07_EPS__CFG_DATA_CODE_RSP_EPS__CCAN, ComIPduSignalRef=Com_Digit_04_EPS__CFG_DATA_CODE_RSP_EPS__CCAN, ComIPduSignalRef=Com_Digit_05_EPS__CFG_DATA_CODE_RSP_EPS__CCAN, ComIPduSignalRef=Com_Digit_02_EPS__CFG_DATA_CODE_RSP_EPS__CCAN, ComIPduSignalRef=Com_Digit_03_EPS__CFG_DATA_CODE_RSP_EPS__CCAN, ComIPduSignalRef=Com_Digit_01_EPS__CFG_DATA_CODE_RSP_EPS__CCAN, PduIdRef=PduCollection/CFG_DATA_CODE_RSP_EPS__CCAN
          ComTxIPdu: ComTxIPduMinimumDelayTimeFactor=0
            ComTxModeTrue
              ComTxModeTrueTrue (ComTxMode): ComTxModeMode=DIRECT, ComTxModeNumberOfRepetitions=0, ComTxModeRepetitionPeriodFactor=0
            ComTxModeFalse
              ComTxModeFalseFalse (ComTxMode): ComTxModeMode=DIRECT, ComTxModeNumberOfRepetitions=0, ComTxModeRepetitionPeriodFactor=0
        Pdu_GE__CCAN: ComIpduDirection=SEND, ComIPduSize=6, ComIPduGroupRef=PduGrp_EPS__CCAN_Tx, ComIPduSignalRef=Com_LwsAngle__GE__CCAN, ComIPduSignalRef=Com_LwsSpeed__GE__CCAN, ComIPduSignalRef=Com_SteeringLoad__GE__CCAN, ComIPduSignalRef=Com_LwsAngleType__GE__CCAN, ComIPduSignalRef=Com_LwsCalibration__GE__CCAN, ComIPduSignalRef=Com_LWSFailSts__GE__CCAN, ComIPduSignalRef=Com_ElectricSteeringFailSts__GE__CCAN, PduIdRef=PduCollection/GE__CCAN
          ComTxIPdu: ComTxIPduMinimumDelayTimeFactor=0
            ComTxModeTrue
              ComTxModeTrueTrue (ComTxMode): ComTxModeMode=PERIODIC, ComTxModeTimeOffsetFactor=0, ComTxModeTimePeriodFactor=10
            ComTxModeFalse
              ComTxModeFalseFalse (ComTxMode): ComTxModeMode=PERIODIC, ComTxModeTimeOffsetFactor=0, ComTxModeTimePeriodFactor=10
        Pdu_MOT1__CCAN: ComIpduDirection=RECEIVE, ComIPduSize=8, ComIPduGroupRef=PduGrp_EPS__CCAN_Rx, ComIPduSignalRef=Com_EngineSts__MOT1__CCAN, PduIdRef=PduCollection/MOT1__CCAN
        Pdu_MOT3__CCAN: ComIpduDirection=RECEIVE, ComIPduSize=8, ComIPduGroupRef=PduGrp_EPS__CCAN_Rx, ComIPduSignalRef=Com_EngineStopStartSts__MOT3__CCAN, ComIPduSignalRef=Com_StopStartSts__MOT3__CCAN, PduIdRef=PduCollection/MOT3__CCAN
        Pdu_PDC_INFO_EPS__CCAN: ComIpduDirection=SEND, ComIPduSize=3, ComIPduGroupRef=PduGrp_EPS__CCAN_Tx, ComIPduSignalRef=Com_Reserved_for_PDC_EPS__PDC_INFO_EPS__CCAN, ComIPduSignalRef=Com_DES_EPS__PDC_INFO_EPS__CCAN, ComIPduSignalRef=Com_GenericFailSts_EPS__PDC_INFO_EPS__CCAN, ComIPduSignalRef=Com_CurrentFailSts_EPS__PDC_INFO_EPS__CCAN, ComIPduSignalRef=Com_EOL_EPS__PDC_INFO_EPS__CCAN, ComIPduSignalRef=Com_StayActiveSource_EPS_7__PDC_INFO_EPS__CCAN, ComIPduSignalRef=Com_StayActiveSource_EPS_6__PDC_INFO_EPS__CCAN, ComIPduSignalRef=Com_StayActiveSource_EPS_5__PDC_INFO_EPS__CCAN, ComIPduSignalRef=Com_StayActiveSource_EPS_4__PDC_INFO_EPS__CCAN, ComIPduSignalRef=Com_StayActiveSource_EPS_3__PDC_INFO_EPS__CCAN, ComIPduSignalRef=Com_StayActiveSource_EPS_2__PDC_INFO_EPS__CCAN, ComIPduSignalRef=Com_StayActiveSource_EPS_1__PDC_INFO_EPS__CCAN, ComIPduSignalRef=Com_StayActiveSource_EPS_0__PDC_INFO_EPS__CCAN, ComIPduSignalRef=Com_StayActiveSource_EPS_15__PDC_INFO_EPS__CCAN, ComIPduSignalRef=Com_StayActiveSource_EPS_14__PDC_INFO_EPS__CCAN, ComIPduSignalRef=Com_StayActiveSource_EPS_13__PDC_INFO_EPS__CCAN, ComIPduSignalRef=Com_StayActiveSource_EPS_12__PDC_INFO_EPS__CCAN, ComIPduSignalRef=Com_StayActiveSource_EPS_11__PDC_INFO_EPS__CCAN, ComIPduSignalRef=Com_StayActiveSource_EPS_10__PDC_INFO_EPS__CCAN, ComIPduSignalRef=Com_StayActiveSource_EPS_9__PDC_INFO_EPS__CCAN, ComIPduSignalRef=Com_StayActiveSource_EPS_8__PDC_INFO_EPS__CCAN, PduIdRef=PduCollection/PDC_INFO_EPS__CCAN
          ComTxIPdu: ComTxIPduMinimumDelayTimeFactor=0
            ComTxModeTrue
              ComTxModeTrueTrue (ComTxMode): ComTxModeMode=PERIODIC, ComTxModeTimeOffsetFactor=0, ComTxModeTimePeriodFactor=1000
            ComTxModeFalse
              ComTxModeFalseFalse (ComTxMode): ComTxModeMode=PERIODIC, ComTxModeTimeOffsetFactor=0, ComTxModeTimePeriodFactor=1000
        Pdu_STATUS_C_BCM2__CCAN: ComIpduDirection=RECEIVE, ComIPduSize=5, ComIPduGroupRef=PduGrp_EPS__CCAN_Rx, ComIPduSignalRef=Com_CmdIgn_FailSts__STATUS_C_BCM2__CCAN, ComIPduSignalRef=Com_CmdIgnSts__STATUS_C_BCM2__CCAN, ComIPduSignalRef=Com_CityModeSts__STATUS_C_BCM2__CCAN, PduIdRef=PduCollection/STATUS_C_BCM2__CCAN
        Pdu_STATUS_C_IPC__CCAN: ComIpduDirection=RECEIVE, ComIPduSize=8, ComIPduGroupRef=PduGrp_EPS__CCAN_Rx, ComIPduSignalRef=Com_ElectricSteeringLamp_FailSts__STATUS_C_IPC__CCAN, ComIPduSignalRef=Com_TotalOdometer__STATUS_C_IPC__CCAN, PduIdRef=PduCollection/STATUS_C_IPC__CCAN
      63 x ComSignal, all with ComSignalEndianess=BIG_ENDIAN:
        Com_OperationalModeSts__BCM_COMMAND__CCAN: ComBitPosition=7, ComBitSize=4, ComSignalDataInvalidValue=15, ComSignalInitValue=0, ComTimeoutFactor=2500, ComTransferProperty=PENDING, SystemTemplateSystemSignalRef=OperationalModeSts
        Com_VehicleSpeedVSOSig__BSM1__CCAN: ComBitPosition=7, ComBitSize=13, ComSignalDataInvalidValue=8191, ComSignalInitValue=0, ComTimeoutFactor=2500, ComTransferProperty=PENDING, SystemTemplateSystemSignalRef=VehicleSpeedVSOSig
        Com_VehicleSpeedVSOSigFailSts__BSM1__CCAN: ComBitPosition=10, ComBitSize=1, ComSignalInitValue=0, ComTimeoutFactor=2500, ComTransferProperty=PENDING, SystemTemplateSystemSignalRef=VehicleSpeedVSOSigFailSts
        Com_MessageCounter_B1__BSM1__CCAN: ComBitPosition=51, ComBitSize=4, ComSignalInitValue=0, ComTimeoutFactor=2500, ComTransferProperty=PENDING, SystemTemplateSystemSignalRef=MessageCounter_B1
        Com_CRC_B1__BSM1__CCAN: ComBitPosition=63, ComBitSize=8, ComSignalInitValue=0, ComTimeoutFactor=2500, ComTransferProperty=PENDING, SystemTemplateSystemSignalRef=CRC_B1
        Com_Digit_10__CFG_DATA_CODE_REQUEST__CCAN: ComBitPosition=3, ComBitSize=4, ComSignalInitValue=0, ComTimeoutFactor=2500, ComTransferProperty=PENDING, SystemTemplateSystemSignalRef=Digit_10
        Com_Digit_11__CFG_DATA_CODE_REQUEST__CCAN: ComBitPosition=7, ComBitSize=4, ComSignalInitValue=0, ComTimeoutFactor=2500, ComTransferProperty=PENDING, SystemTemplateSystemSignalRef=Digit_11
        Com_Digit_08__CFG_DATA_CODE_REQUEST__CCAN: ComBitPosition=11, ComBitSize=4, ComSignalInitValue=0, ComTimeoutFactor=2500, ComTransferProperty=PENDING, SystemTemplateSystemSignalRef=Digit_08
        Com_Digit_09__CFG_DATA_CODE_REQUEST__CCAN: ComBitPosition=15, ComBitSize=4, ComSignalInitValue=0, ComTimeoutFactor=2500, ComTransferProperty=PENDING, SystemTemplateSystemSignalRef=Digit_09
        Com_Digit_06__CFG_DATA_CODE_REQUEST__CCAN: ComBitPosition=19, ComBitSize=4, ComSignalInitValue=0, ComTimeoutFactor=2500, ComTransferProperty=PENDING, SystemTemplateSystemSignalRef=Digit_06
        Com_Digit_07__CFG_DATA_CODE_REQUEST__CCAN: ComBitPosition=23, ComBitSize=4, ComSignalInitValue=0, ComTimeoutFactor=2500, ComTransferProperty=PENDING, SystemTemplateSystemSignalRef=Digit_07
        Com_Digit_04__CFG_DATA_CODE_REQUEST__CCAN: ComBitPosition=27, ComBitSize=4, ComSignalInitValue=0, ComTimeoutFactor=2500, ComTransferProperty=PENDING, SystemTemplateSystemSignalRef=Digit_04
        Com_Digit_05__CFG_DATA_CODE_REQUEST__CCAN: ComBitPosition=31, ComBitSize=4, ComSignalInitValue=0, ComTimeoutFactor=2500, ComTransferProperty=PENDING, SystemTemplateSystemSignalRef=Digit_05
        Com_Digit_02__CFG_DATA_CODE_REQUEST__CCAN: ComBitPosition=35, ComBitSize=4, ComSignalInitValue=0, ComTimeoutFactor=2500, ComTransferProperty=PENDING, SystemTemplateSystemSignalRef=Digit_02
        Com_Digit_03__CFG_DATA_CODE_REQUEST__CCAN: ComBitPosition=39, ComBitSize=4, ComSignalInitValue=0, ComTimeoutFactor=2500, ComTransferProperty=PENDING, SystemTemplateSystemSignalRef=Digit_03
        Com_Digit_01__CFG_DATA_CODE_REQUEST__CCAN: ComBitPosition=47, ComBitSize=4, ComSignalInitValue=0, ComTimeoutFactor=2500, ComTransferProperty=TRIGGERED_WITHOUT_REPETITION, SystemTemplateSystemSignalRef=Digit_01
        Com_Digit_10_EPS__CFG_DATA_CODE_RSP_EPS__CCAN: ComBitPosition=3, ComBitSize=4, ComSignalInitValue=0, ComTransferProperty=PENDING, SystemTemplateSystemSignalRef=Digit_10_EPS
        Com_Digit_11_EPS__CFG_DATA_CODE_RSP_EPS__CCAN: ComBitPosition=7, ComBitSize=4, ComSignalInitValue=0, ComTransferProperty=PENDING, SystemTemplateSystemSignalRef=Digit_11_EPS
        Com_Digit_08_EPS__CFG_DATA_CODE_RSP_EPS__CCAN: ComBitPosition=11, ComBitSize=4, ComSignalInitValue=0, ComTransferProperty=PENDING, SystemTemplateSystemSignalRef=Digit_08_EPS
        Com_Digit_09_EPS__CFG_DATA_CODE_RSP_EPS__CCAN: ComBitPosition=15, ComBitSize=4, ComSignalInitValue=0, ComTransferProperty=PENDING, SystemTemplateSystemSignalRef=Digit_09_EPS
        Com_Digit_06_EPS__CFG_DATA_CODE_RSP_EPS__CCAN: ComBitPosition=19, ComBitSize=4, ComSignalInitValue=0, ComTransferProperty=PENDING, SystemTemplateSystemSignalRef=Digit_06_EPS
        Com_Digit_07_EPS__CFG_DATA_CODE_RSP_EPS__CCAN: ComBitPosition=23, ComBitSize=4, ComSignalInitValue=0, ComTransferProperty=PENDING, SystemTemplateSystemSignalRef=Digit_07_EPS
        Com_Digit_04_EPS__CFG_DATA_CODE_RSP_EPS__CCAN: ComBitPosition=27, ComBitSize=4, ComSignalInitValue=0, ComTransferProperty=PENDING, SystemTemplateSystemSignalRef=Digit_04_EPS
        Com_Digit_05_EPS__CFG_DATA_CODE_RSP_EPS__CCAN: ComBitPosition=31, ComBitSize=4, ComSignalInitValue=0, ComTransferProperty=PENDING, SystemTemplateSystemSignalRef=Digit_05_EPS
        Com_Digit_02_EPS__CFG_DATA_CODE_RSP_EPS__CCAN: ComBitPosition=35, ComBitSize=4, ComSignalInitValue=0, ComTransferProperty=PENDING, SystemTemplateSystemSignalRef=Digit_02_EPS
        Com_Digit_03_EPS__CFG_DATA_CODE_RSP_EPS__CCAN: ComBitPosition=39, ComBitSize=4, ComSignalInitValue=0, ComTransferProperty=PENDING, SystemTemplateSystemSignalRef=Digit_03_EPS
        Com_Digit_01_EPS__CFG_DATA_CODE_RSP_EPS__CCAN: ComBitPosition=47, ComBitSize=4, ComSignalInitValue=0, ComTransferProperty=TRIGGERED_WITHOUT_REPETITION, SystemTemplateSystemSignalRef=Digit_01_EPS
        Com_LwsAngle__GE__CCAN: ComBitPosition=7, ComBitSize=16, ComSignalDataInvalidValue=65535, ComSignalInitValue=0, ComTransferProperty=PENDING, SystemTemplateSystemSignalRef=LwsAngle
        Com_LwsSpeed__GE__CCAN: ComBitPosition=19, ComBitSize=12, ComSignalDataInvalidValue=4095, ComSignalInitValue=0, ComTransferProperty=PENDING, SystemTemplateSystemSignalRef=LwsSpeed
        Com_SteeringLoad__GE__CCAN: ComBitPosition=20, ComBitSize=1, ComSignalInitValue=1, ComTransferProperty=PENDING, SystemTemplateSystemSignalRef=SteeringLoad
        Com_LwsAngleType__GE__CCAN: ComBitPosition=22, ComBitSize=2, ComSignalDataInvalidValue=3, ComSignalInitValue=0, ComTransferProperty=PENDING, SystemTemplateSystemSignalRef=LwsAngleType
        Com_LwsCalibration__GE__CCAN: ComBitPosition=23, ComBitSize=1, ComSignalInitValue=0, ComTransferProperty=PENDING, SystemTemplateSystemSignalRef=LwsCalibration
        Com_LWSFailSts__GE__CCAN: ComBitPosition=38, ComBitSize=2, ComSignalInitValue=0, ComTransferProperty=PENDING, SystemTemplateSystemSignalRef=LWSFailSts
        Com_ElectricSteeringFailSts__GE__CCAN: ComBitPosition=39, ComBitSize=1, ComSignalInitValue=0, ComTransferProperty=PENDING, SystemTemplateSystemSignalRef=ElectricSteeringFailSts
        Com_EngineSts__MOT1__CCAN: ComBitPosition=9, ComBitSize=2, ComSignalDataInvalidValue=3, ComSignalInitValue=3, ComTimeoutFactor=2500, ComTransferProperty=PENDING, SystemTemplateSystemSignalRef=EngineSts
        Com_EngineStopStartSts__MOT3__CCAN: ComBitPosition=54, ComBitSize=2, ComSignalInitValue=1, ComTimeoutFactor=2500, ComTransferProperty=PENDING, SystemTemplateSystemSignalRef=EngineStopStartSts
        Com_StopStartSts__MOT3__CCAN: ComBitPosition=59, ComBitSize=2, ComSignalInitValue=0, ComTimeoutFactor=2500, ComTransferProperty=PENDING, SystemTemplateSystemSignalRef=StopStartSts
        Com_Reserved_for_PDC_EPS__PDC_INFO_EPS__CCAN: ComBitPosition=3, ComBitSize=4, ComSignalInitValue=0, ComTransferProperty=PENDING, SystemTemplateSystemSignalRef=Reserved_for_PDC_EPS
        Com_DES_EPS__PDC_INFO_EPS__CCAN: ComBitPosition=4, ComBitSize=1, ComSignalInitValue=0, ComTransferProperty=PENDING, SystemTemplateSystemSignalRef=DES_EPS
        Com_GenericFailSts_EPS__PDC_INFO_EPS__CCAN: ComBitPosition=5, ComBitSize=1, ComSignalInitValue=0, ComTransferProperty=PENDING, SystemTemplateSystemSignalRef=GenericFailSts_EPS
        Com_CurrentFailSts_EPS__PDC_INFO_EPS__CCAN: ComBitPosition=6, ComBitSize=1, ComSignalInitValue=0, ComTransferProperty=PENDING, SystemTemplateSystemSignalRef=CurrentFailSts_EPS
        Com_EOL_EPS__PDC_INFO_EPS__CCAN: ComBitPosition=7, ComBitSize=1, ComSignalInitValue=0, ComTransferProperty=PENDING, SystemTemplateSystemSignalRef=EOL_EPS
        Com_StayActiveSource_EPS_7__PDC_INFO_EPS__CCAN: ComBitPosition=8, ComBitSize=1, ComSignalInitValue=0, ComTransferProperty=PENDING, SystemTemplateSystemSignalRef=StayActiveSource_EPS_7
        Com_StayActiveSource_EPS_6__PDC_INFO_EPS__CCAN: ComBitPosition=9, ComBitSize=1, ComSignalInitValue=0, ComTransferProperty=PENDING, SystemTemplateSystemSignalRef=StayActiveSource_EPS_6
        Com_StayActiveSource_EPS_5__PDC_INFO_EPS__CCAN: ComBitPosition=10, ComBitSize=1, ComSignalInitValue=0, ComTransferProperty=PENDING, SystemTemplateSystemSignalRef=StayActiveSource_EPS_5
        Com_StayActiveSource_EPS_4__PDC_INFO_EPS__CCAN: ComBitPosition=11, ComBitSize=1, ComSignalInitValue=0, ComTransferProperty=PENDING, SystemTemplateSystemSignalRef=StayActiveSource_EPS_4
        Com_StayActiveSource_EPS_3__PDC_INFO_EPS__CCAN: ComBitPosition=12, ComBitSize=1, ComSignalInitValue=0, ComTransferProperty=PENDING, SystemTemplateSystemSignalRef=StayActiveSource_EPS_3
        Com_StayActiveSource_EPS_2__PDC_INFO_EPS__CCAN: ComBitPosition=13, ComBitSize=1, ComSignalInitValue=0, ComTransferProperty=PENDING, SystemTemplateSystemSignalRef=StayActiveSource_EPS_2
        Com_StayActiveSource_EPS_1__PDC_INFO_EPS__CCAN: ComBitPosition=14, ComBitSize=1, ComSignalInitValue=0, ComTransferProperty=PENDING, SystemTemplateSystemSignalRef=StayActiveSource_EPS_1
        Com_StayActiveSource_EPS_0__PDC_INFO_EPS__CCAN: ComBitPosition=15, ComBitSize=1, ComSignalInitValue=0, ComTransferProperty=PENDING, SystemTemplateSystemSignalRef=StayActiveSource_EPS_0
        Com_StayActiveSource_EPS_15__PDC_INFO_EPS__CCAN: ComBitPosition=16, ComBitSize=1, ComSignalInitValue=0, ComTransferProperty=PENDING, SystemTemplateSystemSignalRef=StayActiveSource_EPS_15
        Com_StayActiveSource_EPS_14__PDC_INFO_EPS__CCAN: ComBitPosition=17, ComBitSize=1, ComSignalInitValue=0, ComTransferProperty=PENDING, SystemTemplateSystemSignalRef=StayActiveSource_EPS_14
        Com_StayActiveSource_EPS_13__PDC_INFO_EPS__CCAN: ComBitPosition=18, ComBitSize=1, ComSignalInitValue=0, ComTransferProperty=PENDING, SystemTemplateSystemSignalRef=StayActiveSource_EPS_13
        Com_StayActiveSource_EPS_12__PDC_INFO_EPS__CCAN: ComBitPosition=19, ComBitSize=1, ComSignalInitValue=0, ComTransferProperty=PENDING, SystemTemplateSystemSignalRef=StayActiveSource_EPS_12
        Com_StayActiveSource_EPS_11__PDC_INFO_EPS__CCAN: ComBitPosition=20, ComBitSize=1, ComSignalInitValue=0, ComTransferProperty=PENDING, SystemTemplateSystemSignalRef=StayActiveSource_EPS_11
        Com_StayActiveSource_EPS_10__PDC_INFO_EPS__CCAN: ComBitPosition=21, ComBitSize=1, ComSignalInitValue=0, ComTransferProperty=PENDING, SystemTemplateSystemSignalRef=StayActiveSource_EPS_10
        Com_StayActiveSource_EPS_9__PDC_INFO_EPS__CCAN: ComBitPosition=22, ComBitSize=1, ComSignalInitValue=0, ComTransferProperty=PENDING, SystemTemplateSystemSignalRef=StayActiveSource_EPS_9
        Com_StayActiveSource_EPS_8__PDC_INFO_EPS__CCAN: ComBitPosition=23, ComBitSize=1, ComSignalInitValue=0, ComTransferProperty=PENDING, SystemTemplateSystemSignalRef=StayActiveSource_EPS_8
        Com_CmdIgn_FailSts__STATUS_C_BCM2__CCAN: ComBitPosition=7, ComBitSize=2, ComSignalDataInvalidValue=3, ComSignalInitValue=0, ComTimeoutFactor=2500, ComTransferProperty=TRIGGERED_ON_CHANGE, SystemTemplateSystemSignalRef=CmdIgn_FailSts
        Com_CmdIgnSts__STATUS_C_BCM2__CCAN: ComBitPosition=15, ComBitSize=3, ComSignalDataInvalidValue=7, ComSignalInitValue=0, ComTimeoutFactor=2500, ComTransferProperty=TRIGGERED_ON_CHANGE, SystemTemplateSystemSignalRef=CmdIgnSts
        Com_CityModeSts__STATUS_C_BCM2__CCAN: ComBitPosition=31, ComBitSize=1, ComSignalInitValue=0, ComTimeoutFactor=2500, ComTransferProperty=TRIGGERED_ON_CHANGE, SystemTemplateSystemSignalRef=CityModeSts
        Com_ElectricSteeringLamp_FailSts__STATUS_C_IPC__CCAN: ComBitPosition=1, ComBitSize=2, ComSignalInitValue=0, ComTimeoutFactor=2500, ComTransferProperty=PENDING, SystemTemplateSystemSignalRef=ElectricSteeringLamp_FailSts
        Com_TotalOdometer__STATUS_C_IPC__CCAN: ComBitPosition=31, ComBitSize=20, ComSignalInitValue=0, ComTimeoutFactor=0, ComTransferProperty=PENDING, SystemTemplateSystemSignalRef=TotalOdometer
  module config CanNm
    CanNmGlobalConfig: CanNmComUserDataEnabled=false, CanNmPassiveModeEnabled=false
      CCAN (CanNmChannelConfig):
        CanNmBaseAddress = 506724352
        CanNmMessageCount = 256
        CanNmMsgCycleOffset = 0.06
        CanNmMsgCycleTime = 1
        CanNmMsgReducedtime = 0.85
        CanNmNodeId = 2
        CanNmPduLength = 2
        CanNmRepeatMessageTime = 4.5
        CanNmTimeoutTime = 8
        CanNmWaitBusSleepTime = 1
        CanNmChannelIdRef = NmGlobalConfig/CCAN
        CanNmNetworkHandle = CanStateManagerConfiguration/CCAN
        NM_EPS__CCAN (CanNmTxPdu): CanNmTxPduRef=PduCollection/NM_EPS__CCAN
  module config Nm
    NmGlobalConfig: NmComUserDataEnabled=false, NmOsekSupportEnabled=false, NmPassiveModeEnabled=false
      CCAN (NmChannelConfig): NmComMChannelRef=ComM/CCAN
  module config EcuC
    PduCollection
      29 x Pdu:
        BCM_COMMAND__CCAN: PduLength=40
        BSM1__CCAN: PduLength=64
        CFG_DATA_CODE_REQUEST__CCAN: PduLength=48
        CFG_DATA_CODE_RSP_EPS__CCAN: PduLength=48
        DIAGNOSTIC_REQUEST_EPS_Tp__CCAN_Rx
        DIAGNOSTIC_REQUEST_EPS_Tp__CCAN_Tx
        DIAGNOSTIC_REQUEST_FUNCTIONAL_Tp__CCAN_Rx
        DIAGNOSTIC_REQUEST_FUNCTIONAL_Tp__CCAN_Tx
        DIAGNOSTIC_RESPONSE_EPS_Tp__CCAN_Rx
        DIAGNOSTIC_RESPONSE_EPS_Tp__CCAN_Tx
        GE__CCAN: PduLength=48
        GliwaMaster__CCAN: PduLength=64
        GliwaSlave__CCAN: PduLength=64
        MOT1__CCAN: PduLength=64
        MOT3__CCAN: PduLength=64
        NM_BCM__CCAN: PduLength=16
        NM_BSM__CCAN: PduLength=16
        NM_ECM__CCAN: PduLength=16
        NM_EPS__CCAN: PduLength=16
        NM_IPC__CCAN: PduLength=16
        NM_TRANSMISSION__CCAN: PduLength=16
        PDC_INFO_EPS__CCAN: PduLength=24
        STATUS_C_BCM2__CCAN: PduLength=40
        STATUS_C_IPC__CCAN: PduLength=64
        XcpMaster__CCAN: PduLength=64
        XcpSlave__CCAN: PduLength=64
        DIAGNOSTIC_REQUEST_EPS__CCAN: PduLength=64
        DIAGNOSTIC_REQUEST_FUNCTIONAL__CCAN: PduLength=56
        DIAGNOSTIC_RESPONSE_EPS__CCAN: PduLength=64
  module config PduR
    PduRGeneral
    PduRGlobalConfig
      PduRRoutingTable
  module config ComM
    ComMGeneral: ComMPncSupport=false
    ComMConfig
      CCAN (ComMNetworks): ComMNetworkHandle=ComM/CCAN
    CCAN (ComMChannel): ComMBusType=COMM_BUS_TYPE_CAN, ComMChannelId=0
