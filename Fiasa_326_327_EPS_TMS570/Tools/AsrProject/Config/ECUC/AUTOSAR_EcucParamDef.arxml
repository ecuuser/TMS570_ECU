[part 2 of 3: package /AUTOSAR]
AUTOSAR XML (schema 3.1.4)
package /AUTOSAR  (continued)
  module definition Dcm [0..1]: variants pre-compile/link-time/post-build  # Configuration of the Dcm (Diagnostic Communications Manager) module.
    container DcmDsd  # These parameters apply to Diagnostic Service Dispatcher. All parameters for all service dispatchers are included in this one configuration container. upperMultiplicity: Service dispatcher is multiple times configurable in this one configuration container. lowerMultiplicity: There must always be one service dispatcher in a DCM.
      container DcmDsdServiceTable [1..256]  # This container contains the configuration (DSD parameters) for Service Identifier Table.
        integer DcmDsdSidTabId: 0..255, set at pre-compile in variant post-build+pre-compile / link in variant link-time  # Due the fact of using one or more service tables the member of the Service Identifier Table includes a unique id for the Service Identifier Table.
        container DcmDsdService [1..*]  # This container contains the configuration (DSD parameters) for Service.
          integer DcmDsdSidTabServiceId: 0..255, set at pre-compile in variant post-build+pre-compile / link in variant link-time  # Id of the Service identifier in hex. The possible Service identifier are predefined in the ISO 14229-1 and ISO 15031-5 and in Table 5 and Table 6.
          boolean DcmDsdSidTabSubfuncAvial: set at pre-compile in variant post-build+pre-compile / link in variant link-time  # Information whether the DcmDsdSidTabServiceId includes Sub functions or not. Used for the Handling of "suppressPosRspMsgIndicationBit" ISO14229-1 can be referenced here, as this specification gives fix definition, if an SID includes Subfunction or not. true = sub-function available false = sub-function not available
          reference DcmDsdSidTabSecurityLevelRef [1..*]: set at pre-compile in variant post-build+pre-compile / link in variant link-time, origin=AUTOSAR_ECUC V1.0.0, destination=DcmDspSecurityRow  # Link to the Security Access Levels needed for execution of the DcmDsdService. Please refer to the ISO 14229-1, ISO 15031-5 and "Verification of the Security Access levels". Please note, that it shall be provided to configure several DcmDsdSidTabSecurityLevelRef per DcmDsdService.
          reference DcmDsdSidTabSessionLevelRef [1..*]: set at pre-compile in variant post-build+pre-compile / link in variant link-time, origin=AUTOSAR_ECUC V1.0.0, destination=DcmDspSessionRow  # Link to the Session Control needed for execution of the DcmDsdService. Please refer to the ISO 14229-1, ISO 15031-5 and "Verification of the Diagnostic Session". Please note, that it shall be provided to configure several DcmDsdSidTabSessionLevelRef per DcmDsdService.
    container DcmDsl  # These parameters apply to a Diagnostic Session Layer. There may be a parameter set (DSL Configuration) per protocol. upperMultiplicity: Each DCM configuration must have exactly one DSL configuration. lowerMultiplicity: Each DCM configuration must have exactly one DSL configuration.
      container DcmDslBuffer [1..256]  # This container contains the configuration (parameters) for the diagnostic buffer.
        integer DcmDslBufferID: 0..255, set at post-build in variant post-build / link in variant link-time / pre-compile in variant pre-compile  # Identifier of Buffer.
        integer DcmDslBufferSize: 8..4095, set at pre-compile  # Size of Diagnostic Buffer (in Bytes) For a linear buffer: size of the buffer shall be as large as the longest message (request or response) For a paged buffer (only Tx possible): size has impacts on the application performance Please note: max. range is the valid range for a CAN network. We assume a FlexRay (or other networks) implementation will work with this range (and the page buffer mechanism) without any problems.
      container DcmDslCallbackDCMRequestService [1..*]  # The name of this container is the name of the R-Port through which the DCM requires the interface CallBackDCMRequestServices. This name should adhere to the naming convention defined in the DCM SWS.
      container DcmDslDiagResp  # This container contains the configuration (parameters) for the ResponsePending handling
        boolean DcmDslDiagRespForceRespPendEn: set at pre-compile in variant post-build+pre-compile / link in variant link-time, origin=AUTOSAR_ECUC V1.0.0  # Allow to enable (TRUE) or disable (FALSE) the mechanism of directly triggering of ResponsePending by application.
        integer DcmDslDiagRespMaxNumRespPend: 0..255, set at post-build in variant post-build / link in variant link-time / pre-compile in variant pre-compile, origin=AUTOSAR_ECUC V1.0.0  # Maximum number of negative responses with response code 0x78 (requestCorrectlyReceived-ResponsePending) allowed per request DCM will send a negative response with response code 0x10 (generalReject), in case the limit value gets reached.
      container DcmDslProtocol  # This container contains the configuration (parameters) for the protocol configuration (for each protocol) The following parameters needs to be configured per protocol.
        container DcmDslProtocolRow [1..*]  # Definition of a single Row of configuration for the protocol configuration (for each protocol)
          integer DcmDslProtocolID: 0..255, set at post-build in variant post-build / link in variant link-time / pre-compile in variant pre-compile, symbolic-name-value=true  # The SWS for DCM defines this as enum type of maxsize uint8 with values {OBD, UDS, ...}. It is effectively the name of the diagnostic protocol type for the DCM DSL protocol that is being configured. 0x00 : DCM_OBD_ON_CAN OBD on CAN (ISO15765-4; ISO15031-5) 0x01 : DCM_UDS_ON_CAN UDS on CAN (ISO15765-3; ISO14229-1) 0x02 : DCM_UDS_ON_FLEXRAY UDS on FlexRay (Manufacturer specific; ISO14229-1) 0x03 : DCM_ROE_ON_CAN 0x04 : DCM_ROE_ON_FLEXRAY 0x05 : DCM_PERIODIC_ON_CAN 0x06 : DCM_PERIODIC_ON_FLEXRAY Implementation Type: Dcm_ProtocolType 0x07..0xEF : Reserved for further AUTOSAR implementation 0xF0..0xFF : Reserved for SW supplier specific
          boolean DcmDslProtocolIsParallelExecutab: set at pre-compile in variant post-build+pre-compile / link in variant link-time, origin=AUTOSAR_ECUC V1.0.0  # Enables the parallel processing of ROE or Periodic Transmission protocol. Only these both protocols are allowed to run in parallel to normal protocol (UDS, OBD).
          float DcmDslProtocolPreemptTimeout: 0.., set at post-build in variant post-build / link in variant link-time / pre-compile in variant pre-compile  # This is the value for the timeout (in milliseconds) of preempting protocol until protocol needs to be started. This is defined in the AUTOSAR SWS for DCM as a uint16. The AUTOSAR configuration standard is to use SI units, so this parameter is defined as a float value in seconds. DCM configuration tools must convert this float value to the appropriate value format for the use in the software implementation of DCM. min: A negative value is not allowed. upperMultiplicity: Exactly one DcmDslProtocolPreemptTimeout value per DSL protocol timing structure. lowerMultiplicity: Exactly one DcmDslProtocolPreemptTimeout value per DSL timing structure. origin: Standard AUTOSAR configuration parameter.
          integer DcmDslProtocolPriority: 0..255, set at post-build in variant post-build / link in variant link-time / pre-compile in variant pre-compile  # The SWS for DCM defines this item as uint8. This is the protocol priority that is used during protocol preemption handling. 0 = Highest priority (protocol may not be preempted by other protocols) 1, 2, 3... = Reducing priority. Protocol may be preempted by other protocols with lower priority value. upperMultiplicity: Exactly one priority must be provided per Tx Protocol. lowerMultiplicity: Exactly one priority must be provided per Tx Protocol. origin: Standard AUTOSAR configuration parameter.
          enumeration DcmDslProtocolTransType: {Type1, Type2}, set at post-build in variant post-build / link in variant link-time / pre-compile in variant pre-compile, origin=AUTOSAR_ECUC V1.0.0  # Selects the transmission type for protocol.
          reference DcmDslProtocolRxBufferID: set at post-build in variant post-build / link in variant link-time / pre-compile in variant pre-compile, destination=DcmDslBuffer  # Link to buffer configuration (DcmDslBufferID) for configuration of protocol buffer used for Rx actions. upperMultiplicity / lowerMultiplicity:: Exactly one Rx buffer is required for protocol reception
          reference DcmDslProtocolSIDTable: set at post-build in variant post-build / link in variant link-time / pre-compile in variant pre-compile, destination=DcmDsdServiceTable  # Link to the used diagnostic service table for this protocol. upperMultiplicity: Must have exactly one service table for the protocol. lowerMultiplicity: Must have exactly one service table for the protocol.
          reference DcmDslProtocolTimeLimit [0..1]: destination=DcmDslProtocolTimingRow  # Link to the extended / limit timing structure. Note: limits are checked when using AccessTimingParameter service. upperMultiplicity: Exactly one extended timing structure must be provided. lowerMultiplicity: Exactly one extended timing structure must be provided.
          reference DcmDslProtocolTxBufferID: set at post-build in variant post-build / link in variant link-time / pre-compile in variant pre-compile, destination=DcmDslBuffer  # Link to buffer configuration (DcmDslBufferID) for configuration of protocol buffer used for Tx actions. upperMultiplicity / lowerMultiplicity:: Exactly one Tx buffer is required for protocol transmission.
          choice container DcmDslConnection [1..*]  # This container contains links between Diagnostic Protocol (=DcmDslProtocolRow) and the according Rx or Tx channel. Because of the usecase to allow more then one diagnostic tester (using different CAN channels) it is necessary to allow configuration of multiple DcmDslConnections.
            container DcmDslMainConnection  # This container contains configuration for Diagnostic Main Connection (DcmDslProtocolTx, DcmDslProtocolRx). In addition it contains links to the ROE connection (DcmDslROEConnectionRef) and the Periodic Transmission Connection (DcmDslPeriodicTranmissionConRef) relevant for protocols with DcmDslProtocolTransType = TYPE2.
              reference DcmDslPeriodicTranmissionConRef [0..1]: set at post-build in variant post-build / link in variant link-time / pre-compile in variant pre-compile, origin=AUTOSAR_ECUC V1.0.0, destination=DcmDslPeriodicTransmission  # Configures the link to the connection of PeriodicTransmission protocol for the processing of the PeriodicTransmission events.
              reference DcmDslROEConnectionRef [0..1]: set at post-build in variant post-build / link in variant link-time / pre-compile in variant pre-compile, origin=AUTOSAR_ECUC V1.0.0, destination=DcmDslResponseOnEvent  # Configures the link to the connection of ROE protocol for processing of the ROE events.
              container DcmDslProtocolRx [1..*]  # This container contains the configuration (parameters) for the protocol configuration of RX channel (for each protocol) The following parameters needs to be configured per protocol. Please keep in mind, that the parameter DcmDslProtocolRxPduId can be given several times per protocol and that the combination from DcmDslProtocolRxPduId and DcmDslProtocolRxAddrType is unique. Only one physical protocol is allowed per connection. upperMultiplicity: More than one receive PDU ID may be configured for reception (e.g. one for func requests, one for phys requests). lowerMultiplicity: At least one receive PDU ID configuration must be provided per protocol.
                enumeration DcmDslProtocolRxAddrType: {DCM_FUNCTIONAL_TYPE, DCM_PHYSICAL_TYPE, FUNCTIONAL_TYPE, PHYSICAL_TYPE}, set at post-build in variant post-build+post-build / link in variant link-time+link-time / pre-compile in variant pre-compile+pre-compile  # Declares the communication type of this DCM_PROTOCOL_DCMRXPDUID. PHYSICAL is used for 1 to 1 communication FUNCTIONAL is used for 1 to n communication
                reference DcmDslProtocolRxPduRef: set at post-build in variant post-build / link in variant link-time / pre-compile in variant pre-compile, destination=Pdu  # DcmRxPduId reference for reception of requests / Multiple links shall be allowed. (e.g. one DcmRxPduId to receive func requests, one DcmRxPduId to receive phys requests)
              container DcmDslProtocolTx  # This container contains the configuration (parameters) for the protocol configuration of TX channel (for each protocol) The included parameters needs to be configured per protocol.
                reference DcmDslProtocolTxPduRef: set at post-build in variant post-build / link in variant link-time / pre-compile in variant pre-compile, destination=Pdu  # DcmRxPduId reference for transmission of responses
            container DcmDslPeriodicTransmission [0..1]  # This container contains the configuration (parameters) for Periodic Transmission service. Hint: Periodic Transmission request comes via DcmDslMainConnection and PeriodicTransmission Event response is given via DcmDslPeriodicTransmission.
              reference DcmDslPeriodicTxPduRef [0..*]: set at post-build in variant post-build / link in variant link-time / pre-compile in variant pre-compile, destination=Pdu  # This is the reference to the PDU ID to be used by this DCM when sending Periodic Transmissions. It is only needed for Type2 Periodic Transmissions configurations. upperMultiplicity: Exactly one DcmDslPeriodicTxPduRef must be defined if Periodic Transmission is enabled and TYPE2 Periodic Transmissions is configured. lowerMultiplicity: DcmDslPeriodicTxPduRef does not need to be defined if Periodic Transmission is not enabled or TYPE1 Periodic Transmissions is configured..
            container DcmDslResponseOnEvent [0..1]  # This container contains the configuration (parameters) for ResponseOnEvent service. Hint: ROE service request is recept via DcmDslMainConnection and that Event response is given via DcmDslResposeOnEvent
              reference DcmDslRoeTxPduRef [0..1]: set at post-build in variant post-build / link in variant link-time / pre-compile in variant pre-compile, destination=Pdu  # Reference to the PDU for transmission of ROE response (only needed for ROE Transmission Type is TYPE2) upperMultiplicity: One PDU required if ROE Transmission Type is TYPE2. lowerMultiplicity: No PDU required if ROE Transmission Type is TYPE1.
      container DcmDslProtocolTiming  # This container contains the configuration (parameters) for Protocol timing. This container contains rows of DcmDslProtocolTimingRow containers. Hint: DcmDslProtocolTiming is only relevant in case of using the UDS service AccessTimingParameter.
        container DcmDslProtocolTimingRow [0..*]  # Definition of a single row of configuration for protocol timing
          float DcmTimStrP2ServerMax: 0.., set at post-build in variant post-build / link in variant link-time / pre-compile in variant pre-compile  # This is the value for P2ServerMax in milliseconds. This is defined in the AUTOSAR SWS for DCM as a uint16. The AUTOSAR configuration standard is to use SI units, so this parameter is defined as a float value in seconds. DCM configuration tools must convert this float value to the appropriate value format for the use in the software implementation of DCM.
          float DcmTimStrP2ServerMin: 0.., set at post-build in variant post-build / link in variant link-time / pre-compile in variant pre-compile  # This is the value for P2ServerMin in milliseconds. This is defined in the AUTOSAR SWS for DCM as a uint16. The AUTOSAR configuration standard is to use SI units, so this parameter is defined as a float value in seconds. DCM configuration tools must convert this float value to the appropriate value format for the use in the software implementation of DCM.
          float DcmTimStrP2StarServerMax: 0.., set at post-build in variant post-build / link in variant link-time / pre-compile in variant pre-compile  # This is the value for P2*ServerMax in milliseconds. This is defined in the AUTOSAR SWS for DCM as a uint16. The AUTOSAR configuration standard is to use SI units, so this parameter is defined as a float value in seconds. DCM configuration tools must convert this float value to the appropriate value format for the use in the software implementation of DCM.
          float DcmTimStrP2StarServerMin: 0.., set at post-build in variant post-build / link in variant link-time / pre-compile in variant pre-compile  # This is the value for P2*ServerMin in milliseconds. This is defined in the AUTOSAR SWS for DCM as a uint16. The AUTOSAR configuration standard is to use SI units, so this parameter is defined as a float value in seconds. DCM configuration tools must convert this float value to the appropriate value format for the use in the software implementation of DCM.
          float DcmTimStrS3Server: 0.., set at post-build in variant post-build / link in variant link-time / pre-compile in variant pre-compile  # This is the value for S3Server in milliseconds. This is defined in the AUTOSAR SWS for DCM as a uint16. The AUTOSAR configuration standard is to use SI units, so this parameter is defined as a float value in seconds. DCM configuration tools must convert this float value to the appropriate value format for the use in the software implementation of DCM.
      container DcmDslServiceRequestIndication [0..*]  # The name of this container is the name of the port through which the DCM requires the port-interface ServiceRequestIndication. The lowerMultiplicity is 0: If DcmRequestIndicationEnabled = false the Indication API is not available.
      container DcmDslSessionControl [1..*]  # The name of this container is the name of the R-port through which the DCM requires the PortInterface SessionControl
    container DcmDsp  # These parameters apply to Diagnostic Service Processing. There will always be one set of these parameters per DCM.
      integer DcmDspMaxDidToRead [0..1]: 0..255, set at pre-compile in variant post-build+pre-compile / link in variant link-time  # Indicates the maximum allowed DIDs in a single "ReadDataByIdentifier" request. If set to 0, then no limitation is applied.
      container DcmDspDid [0..*]  # This container contains the configuration (parameters) of the DID.
        function name DcmDspDidConditionCheckReadFnc [0..1]: set at pre-compile  # Function name to demand application if the conditions (e.g. System state) to read the DID are correct. (ConditionCheckRead-function). Multiplicity shall be equal to parameter DcmDspDidReadFnc. Only relevant if DcmDspDidUsePort==FALSE.
        function name DcmDspDidConditionCheckWriteFnc [0..1]: set at pre-compile  # Function name to demand application if the conditions (e.g. System state) to write the DID are correct. (ConditionCheckWrite-function). Only relevant if DcmDspDidUsePort==FALSE.
        function name DcmDspDidFreezeCurrentStateFnc [0..1]: set at pre-compile  # Function name to request to application to freeze the current state of an IOControl. (FreezeCurrentState-function). Only relevant if DcmDspDidUsePort==FALSE.
        function name DcmDspDidGetScalingInfoFnc [0..1]: set at pre-compile  # Function name to request to application the scaling information of the DID. (GetScalingInformation-function). Only relevant if DcmDspDidUsePort==FALSE.
        integer DcmDspDidIdentifier: 0..65535, set at pre-compile in variant post-build+pre-compile / link in variant link-time  # 2 byte Identifier of the DID
        function name DcmDspDidReadDataLengthFnc [0..1]: set at pre-compile  # Function name to request from application the data length of a DID. (ReadDataLength-function). Only relevant if DcmDspDidUsePort==FALSE.
        function name DcmDspDidReadFnc [0..1]: set at pre-compile  # Function name to request from application the data value of a DID. (ReadData-function). Multiplicity shall be equal to parameter DcmDspDidConditionCheckReadFnc. Only relevant if DcmDspDidUsePort==FALSE.
        function name DcmDspDidResetToDefaultFnc [0..1]: set at pre-compile  # Function name to request to application to reset an IOControl to default value. (ResetToDefault-function). Only relevant if DcmDspDidUsePort==FALSE.
        function name DcmDspDidReturnControlToEcuFnc [0..1]: set at pre-compile  # Function name to request to application to return control to ECU of an IOControl. (ReturnControlToECU-function). Only relevant if DcmDspDidUsePort==FALSE.
        function name DcmDspDidShortTermAdjustmentFnc [0..1]: set at pre-compile  # Function name to request to application to adjuste the IO signal. (ShortTermAdjustment-function). Only relevant if DcmDspDidUsePort==FALSE.
        integer DcmDspDidSize: 0..65535, set at pre-compile in variant post-build+pre-compile / link in variant link-time  # Length of data associated to the DID. If DID has variable datalength, that corresponds to the maximum datalength.
        boolean DcmDspDidUsePort: set at pre-compile  # If this parameter is TRUE, the DCM will access the DID using an R-Port requiring a PortInteface DidServices_&lt;DID&gt;. The name of this R-Port is the name of the container DcmDspDid. If this parameter is FALSE, the DCM will access the DID using the functions that are defined in parameters of type FunctionNameDef in the DcmDspDid container.
        function name DcmDspDidWriteFnc [0..1]: set at pre-compile  # Function name to request application to write the data value of a DID. (WriteData-function). Multiplicity shall be equal to parameter DcmDspDidConditionCheckWriteFnc. Only relevant if DcmDspDidUsePort==FALSE.
        reference DcmDspDidInfoRef: set at pre-compile in variant post-build+pre-compile / link in variant link-time, destination=DcmDspDidInfo  # Reference to DcmDspDidInfo containing information on this DID.
        reference DcmDspDidRef [0..*]: set at pre-compile in variant post-build+pre-compile / link in variant link-time, destination=DcmDspDid  # Reference to DcmDspDid in case this DID refer to one or serveral other DID's
        container DcmDspDidControlRecordSizes [0..*]  # This container defines the sizes of the data sent and received with the DID control functions
          integer DcmDspDidControlEnableMaskRecord: 0..255, set at pre-compile  # This defines the size of the controlEnableMaskRecord as defined in ISO14229-1 for UDS Service 0x2F
          integer DcmDspDidControlOptionRecordSize: 0..255, set at pre-compile  # This defines the size of the controlOptionRecord (as defined in ISO14229-1 for service UDS 0x2F) without the InputOutputControlParameter
          integer DcmDspDidControlStatusRecordSize: 0..255, set at pre-compile  # This defines the size of the controlStatusRecord (as defined in ISO14229-1 for UDS Service 0x2F) WITHOUT the InputOutputControlParameter
      container DcmDspDidInfo [0..*]  # This container contains the configuration (parameters) of the DID's Info
        boolean DcmDspDidDynamicallyDefined: set at pre-compile in variant post-build+pre-compile / link in variant link-time  # Indicates if this DID can be dynamically defined true = DID can be dynamically defined false = DID can not be dynamically defined
        boolean DcmDspDidFixedLength: set at pre-compile in variant post-build+pre-compile / link in variant link-time  # Indicates if the datalength of the DID is fixed true = datalength of the DID is fixed false = datalength of the DID is variable
        integer DcmDspDidScalingInfoSize [0..1]: 0..255, set at pre-compile in variant post-build+pre-compile / link in variant link-time  # If Scaling information service is available for this DID, it provides the size of the scaling information.
        container DcmDspDidAccess  # This container contains the configuration (parameters) of the DID access
          container DcmDspDidControl [0..1]  # This container contains the configuration (parameters) of the DID control.
            reference DcmDspDidControlSecurityLevelRef [1..*]: set at pre-compile in variant post-build+pre-compile / link in variant link-time, destination=DcmDspSecurityRow  # Reference to DcmDspSecurityRow Security levels allowed to control this DID.
            reference DcmDspDidControlSessionRef [1..*]: set at pre-compile in variant post-build+pre-compile / link in variant link-time, destination=DcmDspSessionRow  # Reference to DcmDspSessionRow Sessions allowed to control this DID.
            reference DcmDspDidFreezeCurrentState [0..1]: set at pre-compile, destination=DcmDspDidControlRecordSizes  # This indicates the presence of "FreezeCurrentState" and refers to a container defining the sizes of the parameters
            reference DcmDspDidResetToDefault [0..1]: set at pre-compile, destination=DcmDspDidControlRecordSizes  # This indicates the presence of "ResetToDefault" and refers to a container defining the sizes of the parameters
            reference DcmDspDidReturnControlToEcu [0..1]: set at pre-compile, destination=DcmDspDidControlRecordSizes  # This indicates the presence of "ReturnControlToEcu" and refers to a container defining the sizes of the parameters
            reference DcmDspDidShortTermAdjustement [0..1]: set at pre-compile, destination=DcmDspDidControlRecordSizes  # This indicates the presence of "ShortTermAdjustment" and refers to a container defining the sizes of the parameters
          container DcmDspDidRead [0..1]  # This container contains the configuration (parameters) of the DID read.
            reference DcmDspDidReadSecurityLevelRef [1..*]: set at pre-compile in variant post-build+pre-compile / link in variant link-time, destination=DcmDspSecurityRow  # Reference to DcmDspSecurityRow Security levels allowed to read this DID.
            reference DcmDspDidReadSessionRef [1..*]: set at pre-compile in variant post-build+pre-compile / link in variant link-time, destination=DcmDspSessionRow  # Reference to DcmDspSessionRow Sessions allowed to read this DID.
          container DcmDspDidWrite [0..1]  # This container contains the configuration (parameters) of the DID write.
            reference DcmDspDidWriteSecurityLevelRef [1..*]: set at pre-compile in variant post-build+pre-compile / link in variant link-time, destination=DcmDspSecurityRow  # Reference to DcmDspSecurityRow Security levels allowed to write this DID.
            reference DcmDspDidWriteSessionRef [1..*]: set at pre-compile in variant post-build+pre-compile / link in variant link-time, destination=DcmDspSessionRow  # Reference to DcmDspSessionRow Sessions allowed to write this DID.
      container DcmDspEcuReset [0..*]  # There is a container for each R-Port through which the DCM accesses the ResetService PortInterface. The name of the container is the name of the port. lowerMultiplicity: DcmDspEcuReset does not need to be defined if the EcuReset service is not supported.
        reference DcmDspEcuResetSecurityLevelRef [1..*]: destination=DcmDspSecurityRow  # Reference to DcmDspSecurityRow
        reference DcmDspEcuResetSessionRef [1..*]: destination=DcmDspSessionRow  # Reference to DcmDspSessionRow
      container DcmDspPid [0..*]  # This container defines the availability of a PID to the DCM. In case the PID is accessed through a port, the name of this container is the port-name.
        function name DcmDspGetPidValFnc: set at pre-compile  # Function name for reading value by PID (GetPIDValue-function). This is only relevant if DcmDspPidUsePort==FALSE.
        integer DcmDspPidIdentifier: 0..255, set at pre-compile in variant post-build+pre-compile / link in variant link-time  # 2 bytes Identifier of the PID
        integer DcmDspPidSize: 0..255, set at pre-compile in variant post-build+pre-compile / link in variant link-time  # Length of data associated to the PID.
        boolean DcmDspPidUsePort: set at pre-compile  # If this is false, the DCM will use the function defined in DcmDspGetPidValFnc to get the pid-value. If this is true, the PID will have an R-Port requiring the interface PidServices_&lt;PID&gt;. The name of this port is the name of the container.
      container DcmDspReadDTC  # This container contains the configuration (parameters) of the service Read DTC Information - 0x19 (per sub-function type) This container contains Rows of DcmDspReadDTCRow
        container DcmDspReadDTCRow [0..*]  # This container contains the configuration (parameters) of the service Read DTC Information - 0x19 (per sub-function type)
          integer DcmDspDTCInfoSubFuncLevel: 0..255, set at pre-compile in variant post-build+pre-compile / link in variant link-time  # hex value of the sub-function.
          boolean DcmDspDTCInfoSubFuncSupp: set at pre-compile in variant post-build+pre-compile / link in variant link-time  # Indicates whether the respective sub-function is supported. TRUE = sub-function supported. FALSE = sub-function not supported.
          reference DcmDspDTCInfoSecLevelRef [1..*]: set at pre-compile in variant post-build+pre-compile / link in variant link-time, origin=AUTOSAR_ECUC V1.0.0, destination=DcmDspSecurityRow  # Link to the Security Access Levels needed for execution of the DcmDspReadDTCRow. Please refer to the ISO 14229-1, ISO 15031-5 and "Verification of the Security Access levels". Please note, that it shall be provided to configure several DcmDsdSidTabSecLevelRef.
      container DcmDspRequestControl [0..*]  # This container contains the configuration (parameters) of the "Request control of on-board system, test or component" service (Service $08). The name of this container is the name of the port through which the DCM has access to a RequestControlServices interface.
        integer DcmDspRequestControlInBufferSize: 0..255, set at pre-compile in variant post-build+pre-compile / link in variant link-time
        integer DcmDspRequestControlOutBufferSiz: 0..255, set at pre-compile in variant post-build+pre-compile / link in variant link-time
        integer DcmDspRequestControlTestId: 0..255, set at pre-compile in variant post-build+pre-compile / link in variant link-time  # Test Id for Service $08
      container DcmDspRoutine [0..*]  # This container contains the configuration (parameters) for Routines
        function name DcmDspRequestResultsRoutineFnc [0..1]: set at pre-compile  # Function name for request to application the results of a routine. (Routine_RequestResults-function)
        integer DcmDspRoutineIdentifier: 0..65535, set at pre-compile in variant post-build+pre-compile / link in variant link-time  # 2 bytes Identifier of the RID
        boolean DcmDspRoutineUsePort: set at pre-compile  # If this is true, the DCM uses a port (whose name is the name of the container) to access the interface RoutineServices. In that case, the configuration must not provide function names in DcmDspStartRoutineFnc, DcmDspStopRoutineFnc or DcmDspRequestResultsRoutineFnc. If this is false, the DCM expects to find the names of the functions to be used in DcmDspStartRoutineFnc, DcmDspStopRoutineFnc or DcmDspRequestResultsRoutineFnc.
        function name DcmDspStartRoutineFnc [0..1]: set at pre-compile  # Function name for request to application to start a routine. (Routine_Start-function)
        function name DcmDspStopRoutineFnc [0..1]: set at pre-compile  # Function name for request to application to stop a routine. (Routine_Stop-function)
        reference DcmDspRoutineInfoRef: set at pre-compile in variant post-build+pre-compile / link in variant link-time, destination=DcmDspRoutineInfo  # Reference to DcmDspRoutineInfo containing information on this routine.
      container DcmDspRoutineInfo [0..*]  # This container contains the configuration (parameters) for Routine's Info.
        container DcmDspRoutineAuthorization  # This container contains the configuration (parameters) for the Routine Authorization.
          reference DcmDspRoutineSecurityLevelRef [1..*]: set at pre-compile in variant post-build+pre-compile / link in variant link-time, destination=DcmDspSecurityRow  # Reference to DcmDspSecurityRow Security levels allowed to control this RID.
          reference DcmDspRoutineSessionRef [1..*]: set at pre-compile in variant post-build+pre-compile / link in variant link-time, destination=DcmDspSessionRow  # Reference to DcmDspSessionRow Sessions allowed to control this RID.
        container DcmDspRoutineRequestRes [0..1]  # This container contains the configuration (parameters) of Routine Result
          integer DcmDspReqResRtnCtrlOptRecSize: 0..255, set at pre-compile in variant post-build+pre-compile / link in variant link-time  # Size of optional record in the RequestResult response
        container DcmDspRoutineStop [0..1]  # This container contains the configuration (parameters) of Routine Stop
          integer DcmDspStopRoutineCtrlOptRecSize: 0..255, set at pre-compile in variant post-build+pre-compile / link in variant link-time  # Size of optional record in the Stop request
          integer DcmDspStopRoutineStsOptRecSize: 0..255, set at pre-compile in variant post-build+pre-compile / link in variant link-time  # Size of optional record in the Stop response
        container DcmDspStartRoutine  # This container contains the configuration (parameters) of Routine Start.
          integer DcmDspStartRoutineCtrlOptRecSize: 0..255, set at pre-compile in variant post-build+pre-compile / link in variant link-time  # Size of optional record in the Routine Start request
          integer DcmDspStartRoutineStsOptRecSize: 0..255, set at pre-compile in variant post-build+pre-compile / link in variant link-time  # Size of optional record in the Routine Start response
      container DcmDspSecurity  # This container contains the configuration ( DSP parameter) for security level configuration (per security level) Description This container contains Rows of DcmDspSecurityRow
        container DcmDspSecurityRow [0..31]  # Definition of a single Row of configuration for security level onfiguration (per security level) The name of this container is the name of the port through which the DCM will require a PortInterface of type SecurityAccess_&lt;LEVEL&gt;
          integer DcmDspSecurityADRSize [0..1]: 1..255, set at pre-compile in variant post-build+pre-compile / link in variant link-time  # Size of the AccessDataRecord used in GetSeed
          float DcmDspSecurityDelayTime: 0.., set at pre-compile in variant post-build+pre-compile / link in variant link-time  # Delay time after failed security access (in ms). This is started after DcmDspSecurityNumAttDelay number of failed security accesses. The AUTOSAR configuration standard is to use SI units, so this parameter is defined as float value in seconds. DCM configuration tools must convert this float value to the appropriate value format for the use in the software implementation of DCM. min: A negative value is not allowed. upperMultiplicity: Exactly one delay time must be specified per security levbel configuration. lowerMultiplicity: Exactly one delay time must be specified per security levbel configuration. origin: Standard AUTOSAR configuration parameter.
          float DcmDspSecurityDelayTimeOnBoot: 0.., set at pre-compile in variant post-build+pre-compile / link in variant link-time, origin=AUTOSAR_ECUC V1.0.0  # Start delay timer on power on (in ms) The AUTOSAR configuration standard is to use SI units, so this parameter is defined as float value in seconds. DCM configuration tools must convert this float value to the appropriate value format for the use in the software implementation of DCM. min: A negative value is not allowed. upperMultiplicity: Exactly one delay time must be specified per security level configuration. lowerMultiplicity: Exactly one delay time must be specified per security level configuration.
          integer DcmDspSecurityKeySize: 1..255, set at pre-compile in variant post-build+pre-compile / link in variant link-time  # size of the security key (in Bytes).
          integer DcmDspSecurityLevel: 0..63, set at pre-compile in variant post-build+pre-compile / link in variant link-time, symbolic-name-value=true  # hex value of Security level 0 is the highest security level. 0x00, 0x01,0x03...0x3F: configuration dependent - Conversion formula to calculate SecurityLevel out of tester requested SecurityAccessType parameter: SecurityLevel = (SecurityAccessType + 1) / 2 Type: Dcm_SecLevelType
          integer DcmDspSecurityNumAttDelay: 1..255, set at pre-compile in variant post-build+pre-compile / link in variant link-time  # Number of failed security accesses after which the delay time is activated
          integer DcmDspSecurityNumAttLock: 0..255, set at pre-compile in variant post-build+pre-compile / link in variant link-time  # Number of failed security accesses after which security access is locked. 0 indicates that the security access will be left untouched and the ECU never locks.
          integer DcmDspSecuritySeedSize: 1..255, set at pre-compile in variant post-build+pre-compile / link in variant link-time  # size of the security seed (in Bytes).
      container DcmDspSession  # This container contains the configuration ( DSP parameter) session control configuration (per session control) This container contains Rows of DcmDspSessionRow
        container DcmDspSessionRow [0..31]  # Definition of a single Row of session control configuration (per session control)
          integer DcmDspSessionLevel: 0..255, set at pre-compile in variant post-build+pre-compile / link in variant link-time, symbolic-name-value=true  # hex value of the Session control. The symbolicName represents the Name of the Session SWS defines the Dcm_SesCtrlType: 0x01 DEFAULT_SESSION 0x02 PROGRAMMING_SESSION 0x03 EXTENDED_DIAGNOSTIC_SESSION 0x04 SAFETY_SYSTEM_DIAGNOSTIC_SESSION 0x05...0x7F <configuration dependent (according "diagnosticSessionType" parameter DiagnosticSessionControl request> 0x80...0xFE Reserved by Document 0xFF ALL_SESSION_LEVEL
          float DcmDspSessionP2ServerMax: 0.., set at pre-compile in variant post-build+pre-compile / link in variant link-time  # This is the session value for P2ServerMax in milliseconds (per Session Control). This is defined in the AUTOSAR SWS for DCM as a uint16. The AUTOSAR configuration standard is to use SI units, so this parameter is defined as a float value in seconds. DCM configuration tools must convert this float value to the appropriate value format for the use in the software implementation of DCM.
          float DcmDspSessionP2StarServerMax: 0.., set at pre-compile in variant post-build+pre-compile / link in variant link-time  # This is the session value for P2*ServerMax in milliseconds (per Session Control). This is defined in the AUTOSAR SWS for DCM as a uint16. The AUTOSAR configuration standard is to use SI units, so this parameter is defined as a float value in seconds. DCM configuration tools must convert this float value to the appropriate value format for the use in the software implementation of DCM.
      container DcmDspTestResultByObdmid [0..*]  # This container contains the configuration (parameters) of the "Request on-board monitoring test results" service (Service $06).
        container DcmDspTestResultObdmidTid [1..*]  # This container contains the configuration (parameters) of a OBDMID and the assigend TIDs for for the "Request on-board monitoring test results" service (Service $06).
          integer DcmDspTestResultObdmid: 0..255, set at pre-compile in variant post-build+pre-compile / link in variant link-time  # OBDMID for Service $06
          reference DcmDspTestResultObdmidTidRef [1..*]: set at post-build in variant post-build / link in variant link-time / pre-compile in variant pre-compile, destination=DcmDspTestResultTid  # Link to reported TIDs of this OBDMID upperMultiplicity / lowerMultiplicity:: At least one TID must be reported for an OBDMID
        container DcmDspTestResultTid [1..*]  # This container contains the configuration (parameters) of a single TID for the "Request on-board monitoring test results" service (Service $06). The name of this container is the R-Port through which the DCM requires a PortInterface DtrServices.
          integer DcmDspTestResultTestId: 0..255, set at pre-compile in variant post-build+pre-compile / link in variant link-time  # Test Id for Service $06
          integer DcmDspTestResultUaSid: 0..255, set at pre-compile in variant post-build+pre-compile / link in variant link-time  # Unit And Scaling ID for Service $06
      container DcmDspVehInfo [0..*]  # This container contains the configuration (parameters) of the "Request vehicle information service" (service $09).
        function name DcmDspGetVehInfoTypeFnc: set at pre-compile  # Function name for reading the associated INFOTYPE. (GetInfotype-function)
        integer DcmDspVehInfoInfoType: 0..255, set at pre-compile in variant post-build+pre-compile / link in variant link-time  # INFOTYPE for Service $09
        integer DcmDspVehInfoSize: 0..255, set at pre-compile in variant post-build+pre-compile / link in variant link-time  # Length of data of associated INFOTYPE.
        boolean DcmDspVehInfoUsePort: set at pre-compile  # When this is true, the DCM uses a port (whose name is the name of the DcmDspVehInfo. In that case, the DcmDspGetVehInfoTypeFnc must be an empty string as the RTE APIs are used. When this is false, the DCM calls the funtion defined in DcmDspGetVehInfoTypeFnc.
    container DcmGeneral  # This container contains the configuration (parameters) for Component wide parameters
      boolean DcmDevErrorDetect: set at pre-compile  # Preprocessor switch to enable or disable the Development Error Detection (DET) mechanism.
      boolean DcmRequestIndicationEnabled: set at pre-compile  # Allows to enable or disable the requested indication mechanism.
      boolean DcmRespondAllRequest: set at pre-compile  # If set to FALSE the DCM will not respond to diagnostic request that contains a service ID which is in the range from 0x40 to 0x7F or in the range from 0xC0 to 0xFF (Response IDs).
      float DcmTaskTime: 0.., set at pre-compile in variant post-build+pre-compile / link in variant link-time  # Allow to configure the time for the periodic cyclic task (in ms). Please note: This configuration value shall be equal to the value in the ScheduleManager module. The AUTOSAR configuration standard is to use SI units, so this parameter is defined as float value in seconds. DCM configuration tools must convert this float value to the appropriate value format for the use in the software implementation of DCM. min: A negative value is not allowed. upperMultiplicity: Exactly one TaskTime must be specified per configuration. lowerMultiplicity: Exactly one TaskTime must be specified per configuration.
      boolean DcmVersionInfoApi: set at pre-compile  # Preprocessor switch to enable or disable the output Version info of the functionality.
    container DcmPageBufferCfg  # This container contains the configuration (parameters) for Page Buffer handling
      boolean DcmPagedBufferEnabled: set at pre-compile  # Allow to enable or disable the Page buffer mechanism. true = Page buffer handling enabled false = Page Buffer handling disabled
      float DcmPagedBufferTimeout [0..1]: 0.., set at pre-compile in variant post-build+pre-compile / link in variant link-time  # Allow to configure the Timeout (in ms) towards the application for filling the next page. This parameter is only relevant if the Page Buffer handling is enabled. (DcmPagedBufferEnabled = TRUE) Defined in the DCM SWS as uint16, this parameter contains a value in milliseconds. The AUTOSAR configuration standard is to use SI units, so this parameter is defined as float value in seconds. DCM configuration tools must convert this float value to the appropriate value format for the use in the software implementation of DCM. min: A negative value is not allowed. upperMultiplicity: Exactly one Timeout must be specified per configuration. lowerMultiplicity: Exactly one Timeout must be specified per configuration.
    container DcmConfigSet: multiple-configuration-container=true
      reference DcmActiveDslProtocolRowRef [1..*]: set at pre-compile, origin=Vector Informatik, destination=DcmDslProtocolRow  # References active connections in this identity
  module definition Dem [0..1]: variants pre-compile/post-build  # Configuration of the Dem (Diagnostic Event Manager) module.
    container DemConfigSet: multiple-configuration-container=true  # This container contains the configuration parameters and sub containers of the DEM module supporting multiple configuration sets. This container is a MultipleConfigurationContainer, i.e. this container and its sub-containers exist once per configuration set.
      container DemDTCClass [1..16777214]  # This container contains the configuration (parameters) for DTCClass.
        integer DemDTC: 1..16777215, set at post-build in variant post-build / pre-compile in variant pre-compile  # Diagnostic Trouble Code
        integer DemDTCFunctionalUnit: 0..255, set at post-build in variant post-build / pre-compile in variant pre-compile  # DTCFuncitonalUnit is a 1-byte value which identifies the corresponding basic vehicle / system function which reports the DTC. This parameter is necessary for the report of severity informations.
        enumeration DemDTCKind: {DEM_DTC_KIND_ALL_DTCS, DEM_DTC_KIND_EMISSION_REL_DTCS}, set at post-build in variant post-build / pre-compile in variant pre-compile  # Defines whether the DTC is OBD-relevant or not
        enumeration DemDTCSeverity [0..1]: {DEM_DTC_SEV_CHECK_AT_NEXT_HALT, DEM_DTC_SEV_IMMEDIATELY, DEM_DTC_SEV_MAINTENANCE_ONLY, DEM_DTC_SEV_NO_SEVERITY}, set at post-build in variant post-build / pre-compile in variant pre-compile  # DTC severity This parameter depends on automotive manufacturer and is optional.
        container DemCallbackDTCStatusChanged [0..*]  # The presence of this container indicates that the DEM has access to an "DTCStatusChanged" callback, which the DEM will call to notify other components about the change in the status of a DTC. In case there is a DemCallbackDTCStatusChangedFnc, this parameter contains the name of the function that the DEM will call. In case there is no DemCallbackDTCStatusChangedFnc, the DEM will have an R-Port requiring the interface CallbackDTCStatusChanged whose name is the name of this container.
          function name DemCallbackDTCStatusChangedFnc [0..1]: set at pre-compile  # Function name of prototype "DTCStatusChanged"
        container DemCallbackInitMForF [0..*]  # The presence of this container means that the DEM will call an InitMonitorForFunction callback provided by either a SW-C or another BSWM. In case the container has a DemCallbackInitMForFFnc, this parameter defines the name of the function that the DEM will use. If there is no such parameter, the name of the container is the name of an R-Port through which the DEM requires the interface CallbackInitMonitorForFunction.
          function name DemCallbackInitMForFFnc [0..1]: set at pre-compile  # Name of a function of prototype "InitMonitorForFunction"
      container DemEventParameter [0..65535]  # This container contains the configuaration (parameters) for events. Note that this container definition does not explicitly define a symbolic name parameter. Instead, the short name of the container will be used in the Ecu Configuration Description to specify the symbolic name of the DEM_EVENT_NAME.
        integer DemEventID: 1..65535, set at pre-compile, symbolic-name-value=true  # Unique identifier of an EVENT, this parameter should not be changeable by user, because the EventId should be generated by DEM itself to prevent gaps and multiple use of an Id. max = 255 For small ECUs with < 255 different events and a limited RAM, the events should be sequentially ordered beginning with 1 and no gaps in between. max = 65535 For ECUs with > 255 different events, the events should be sequentially ordered beginning with 1 and no gaps in between.
        enumeration DemEventKind: {DEM_EVENT_KIND_BSW, DEM_EVENT_KIND_SWC}  # This container contains the configuaration (parameters) for DemEventType. This parameter is used to distinguish between SW-C and BSW events. SW-C events are for Dem_SetEventStatus API and BSW events are for Dem_ReportErrorStatus API.
        reference DemDTCClassRef [0..1]: destination=DemDTCClass  # This defines the DTC's associated with the Event. It is allowed to have Events without a DTC.
        reference DemExtendedDataRef [0..1]: destination=DemExtendedDataClass  # This reference defines the link to a ExtendedDataClass sampler.
        reference DemFreezeFrameClassRef [0..255]: destination=DemFreezeFrameClass  # These references define the links to the FreezeFrameClass sampler. The number of linked classes complies to the possible captured freeze frames, which are also reported from UDS service 0x19.
        container DemCallbackEventStatusChanged [0..*]  # The presence of this container indicates that the DEM has access to an "EventStatusChanged" callback. In case there is a DemCallbackEvenStatusChangedFnc, this parameter contains the name of the function that the DEM will call. In case there is no DemCallbackEvenStatusChangedFnc, the DEM will have an R-Port requiring the interface CallbackEventStatusChanged whose name is the name of this container.
          function name DemCallbackEventStatusChangedFnc [0..1]: set at pre-compile  # Function name of prototype "EventStatusChanged"
        container DemCallbackInitMForE [0..1]  # Monitor function which has to be initialized for the event. This is either provided by a BSWM (when the parameter DemCallbackInitMForEFnc is present) or through an R-Port requiring a CallbackInitMonitorForEvent interface whose name is the name of this container.
          function name DemCallbackInitMForEFnc [0..1]  # Name of a function with prototype "InitMonitorForEvent"
        container DemEventClass  # This container contains the configuaration (parameters) for EventClass
          boolean DemConsiderPtoStatus  # This is TRUE when the event is affected by the DEM PTO handling
          enumeration DemEventDestination [0..4]: {DEM_DTC_ORIGIN_MIRROR_MEMORY, DEM_DTC_ORIGIN_PERMANENT_MEMORY, DEM_DTC_ORIGIN_PRIMARY_MEMORY, DEM_DTC_ORIGIN_SECONDARY_MEMORY}, set at post-build in variant post-build / pre-compile in variant pre-compile  # The event destination assigns events to none, one or multiple origins. If no event destination is assigned to a specific event, the event is handled internally and is not visible externally to the DCM. If more than one event destination is assigned to a specific event, the event can be present in the corresponding origins. ImplementationType:
          integer DemEventPriority: 0..255, set at post-build in variant post-build / pre-compile in variant pre-compile  # Priority of an event, in view of full event buffer (ref. to Dem104).
          boolean DemFFPrestorageSupported: set at pre-compile  # If this parameter is set to true, then the Prestorage of FreezeFrames is supported by the assigned event. This parameter is useful to calculate the buffer size.
          boolean DemHealingAllowed: set at post-build in variant post-build / pre-compile in variant pre-compile  # (Dem104) general switch to allow healing/unlearning or not. true = healing/unlearning allowed false = healing/unlearning not allowed
          integer DemHealingCycleCounter [0..1]: 1..256, set at post-build in variant post-build / pre-compile in variant pre-compile  # cycles needed to heal/erase event (ref. Dem104). This parameter is optional (depends on OEM).
          reference DemEnableConditionRef [0..*]: set at post-build in variant post-build / pre-compile in variant pre-compile, origin=AUTOSAR_ECUC V1.0.0, destination=DemEnableCondition  # Defines a Enable Condition. This parameter is optional and depends on manufacturer.
          reference DemHealingCycleRef [0..1]: set at post-build in variant post-build / pre-compile in variant pre-compile, origin=AUTOSAR_ECUC V1.0.0, destination=DemOperationCycleTgt  # optional reference to the healing cycle
          reference DemOperationCycleRef: set at post-build in variant post-build / pre-compile in variant pre-compile, origin=AUTOSAR_ECUC V1.0.0, destination=DemOperationCycleTgt  # Kind of operation cycle for the event (e.g. power cycle, driving cycle, ...)
          container DemIndicatorAttribute [0..255]  # This container contains the event specific configuration of Indicators.
            enumeration DemIndicatorBehaviour: {DEM_INDICATOR_BLINKING, DEM_INDICATOR_BLINK_CONT, DEM_INDICATOR_CONTINUOUS}, set at pre-compile  # Behaviour of the linked indicator
            reference DemLinkedIndicator: set at pre-compile, destination=DemIndicator  # indicator name of the used indicator
          container DemOEMSpecific [0..1]  # This container contains the configuaration for OEM specific additional parameter.
          choice container DemPredebounceAlgorithmClass [0..255]  # Used algorithm class ( Dem_PredebounceMonitorInternal, Dem_PredebounceFrequencyBased, Dem_PredebounceCounterBased, Dem_PredebounceTimeBased) depends on parameter EventClass.PredebounceAlgorithm It is possible to assign more then one algorithm to one event. This is useful if the behaviour of debouncing depends on other things, like status of DTC. Example: If the event doesn't occurs before, Debounce Algorithm A with paramater set A is used. If the event occurs again, then Debounce Algorithm B with paratmeter set B is used.
            container DemPreDebounceCounterBased [0..1]  # This container contains the configuration (parameters) for DemPredebounceCounterBased
              integer DemCountInStepSize: 0..127, set at post-build in variant post-build / pre-compile in variant pre-compile  # Defines the Step size for incrementation of FDC (PREFAILED)
              integer DemCountOutStepSize: 0..127, set at post-build in variant post-build / pre-compile in variant pre-compile  # Defines the Step size for decrementation of FDC (PREPASSED)
              boolean DemJumpDown: set at pre-compile  # Switch for the activation of Jump-Down – only in combination with Jump-UP activation. true: JumpDown activated false: JumpDown not activated
              boolean DemJumpUp: set at pre-compile  # Switch for the activation of Jump-UP true: JumpUp activated false: JumpUp not activated
              enumeration DemPreDebounceName: {DEM_PRE_DEBOUNCE_COUNTER_BASED}, set at pre-compile  # Defines the selected debounce algorithm
            container DemPreDebounceFrequencyBased [0..1]  # This container contains the configuration (parameters) for DemPredebounceFrequencyBased .
              integer DemDurationOfTimeWindow: 0.., set at post-build in variant post-build / pre-compile in variant pre-compile  # Defines duration of the Time Window. Range defined in the DEM SWS as 0 .. 2^32, this parameter contains a value in milliseconds. The AUTOSAR configuration standard is to use SI units, so this parameter is defined as float value in seconds. DEM configuration tools must convert this float value to the appropriate value format for the use in the software implementation of DEM.
              enumeration DemPreDebounceName: {DEM_PRE_DEBOUNCE_FREQUENCY_BASED}, set at pre-compile  # Defines the selected debounce algorithm
              integer DemThresholdForEventTestedFailed: 0..65535, set at post-build in variant post-build / pre-compile in variant pre-compile  # Defines the threshold for FAILED-detection
              integer DemThresholdForEventTestedPassed: 0..65535, set at post-build in variant post-build / pre-compile in variant pre-compile  # Defines the threshold for PASSED-detection
            container DemPreDebounceMonitorInternal [0..1]  # This container contains the configuration (parameters) for DemPredebounceMonitorInternal
              enumeration DemPreDebounceName: {DEM_NO_PRE_DEBOUNCE}, set at pre-compile  # Defines the selected debounce algorithm
              container DemCallbackGetFDCnt  # This container defines the function that the OEM uses to obtain the value of the fault detection counter. In case the container has a parameter DemCallbackGetFDCntFnc, the function is provided through this name by another BSW. In case this parameter is not present, the name of this container is the name of a port requiring the interface CallbackGetFaultDetectionCounter
                function name DemCallbackGetFDCntFnc [0..1]: set at pre-compile  # The name of a function of prototype "GetFaultDetectionCounter"
            container DemPreDebounceTimeBase [0..1]  # This container contains the configuration (parameters) for DemPredebounceTimeBased.
              enumeration DemPreDebounceName: {DEM_PRE_DEBOUNCE_TIME_BASED}, set at pre-compile  # Defines the selected debounce algorithm
              integer DemTimeFailedThreshold: 0.., set at post-build in variant post-build / pre-compile in variant pre-compile  # Defines the time out duration in ms for "Event Failed" qualification. Range defined in the DEM SWS as 0 .. 2^32, this parameter contains a value in milliseconds. The AUTOSAR configuration standard is to use SI units, so this parameter is defined as float value in seconds. DEM configuration tools must convert this float value to the appropriate value format for the use in the software implementation of DEM.
              integer DemTimePassedThreshold: 0.., set at post-build in variant post-build / pre-compile in variant pre-compile  # Defines the time out duration in ms for "Event Passed" qualification. Range defined in the DEM SWS as 0 .. 2^32, this parameter contains a value in milliseconds. The AUTOSAR configuration standard is to use SI units, so this parameter is defined as float value in seconds. DEM configuration tools must convert this float value to the appropriate value format for the use in the software implementation of DEM.
      container DemGroupOfDTC [1..16777214]  # This container contains the configuaration (parameters) for DTC Groups.
        integer DemGroupDTCs: 1..16777214, set at pre-compile, symbolic-name-value=true  # DTC of the selected group of DTC (according to ISO14229-1[9] Annex D1)
      container DemOemIdClass [0..*]  # This container contains the configuaration (parameters) for OEMIdClass. Note hat this container definition does not explicitly define a symbolic name parameter. Instead, the short name of the container will be used in the Ecu Configuration Description to specify the symbolic name of the VALUE_NAME.
        integer DemOemID: 0..255, set at post-build in variant post-build / pre-compile in variant pre-compile, symbolic-name-value=true  # Defines a unique ID of a data value.
    container DemGeneral  # This container contains the configuration (parameters) of the BSW DEM
      integer DemBswErrorBufferSize: 0..255, set at pre-compile  # Maximum number of elements in buffer for handling of BSW errors (ref. to Dem107).
      boolean DemDevErrorDetect: set at pre-compile  # Activate/Deactivate the Development Error Detection and Notification. true: Development Error Detection and Notification activated false: Development Error Detection and Notification deactivated
      integer DemDtcStatusAvailabilityMask: 0..255, set at pre-compile  # Mask for the supported DTC status bits by the DEM. This mask is used by UDS service 0x19.
      integer DemFFDataIDLength: 0..4, set at pre-compile  # Length of the DID and PID of FreezeFrames in Bytes.
      integer DemMaxNumberEventEntryMirror: 0..255, set at pre-compile  # Maximum number of events which can be stored in the mirror memory
      integer DemMaxNumberEventEntryPermanent: 0..255, set at pre-compile  # Maximum number of events which can be stored in the permanent memory
      integer DemMaxNumberEventEntryPrimary: 1..255, set at pre-compile  # Maximum number of events which can be stored in the primary memory
      integer DemMaxNumberEventEntrySecondary: 0..255, set at pre-compile  # Maximum number of events which can be stored in the secondary memory
      integer DemMaxNumberPrestoredFF: 0..255, set at pre-compile  # Defines the maximum number for prestored FreezeFrames. If set to 0, then prestorage is not supported by the ECU.
      boolean DemOBDSupport: set at pre-compile  # This configuration switch defines whether OBD is supported or not
      boolean DemPTOSupport: set at pre-compile  # Defines whether PTO support is enabled or not
      integer DemTaskTime: 0.., set at pre-compile, origin=AUTOSAR_ECUC V1.0.0  # Allow to configure the time for the periodic cyclic task (in ms). Please note: This configuration value shall be equal to the value in the ScheduleManager module. The AUTOSAR configuration standard is to use SI units, so this parameter is defined as float value in seconds. DEM configuration tools must convert this float value to the appropriate value format for the use in the software implementation of DEM. min: A negative value is not allowed. upperMultiplicity: Exactly one TaskTime must be specified per configuration. lowerMultiplicity: Exactly one TaskTime must be specified per configuration.
      enumeration DemTypeOfDTCSupported: {DEM_ISO11992_4, DEM_ISO14229_1, DEM_ISO15031_6, DEM_SAEJ1939_73}, set at pre-compile  # This parameter defines the format returned by Dem_GetTranslationType.
      boolean DemVersionInfoApi: set at pre-compile  # Activate/Deactivate the version information API. true: version information activated false: version information deactivated
      container DemEnableCondition [0..255]  # This container contains the configuration (parameters) for Enable Conditions.
        integer DemEnableConditionID: 0..65535, set at post-build in variant post-build / pre-compile in variant pre-compile  # Defines a condition ID. This parameter is optional and depends on manufacturer.
        boolean DemEnableConditionStatus: set at post-build in variant post-build / pre-compile in variant pre-compile  # Defines a status for enable or disable of storage of a event. The value is the initialization after power up. (TRUE=enabled FALSE=disabled)
      container DemExtendedDataClass [0..*]  # This class contains the combinations of extended data records (ExtendedDataClassRec).
        reference DemExtendedDataClassRef [1..253]: destination=DemExtendedDataRecordClass  # This reference contains the link to a ExtendedDataClassRecord.
      container DemExtendedDataRecordClass [0..253]  # This container contains the configuration (parameters) for ExtendedDataClassRecords
        integer DemExtendedDataRecordDataSize: 0..256, set at post-build in variant post-build / pre-compile in variant pre-compile  # Defines the size of the extended Data Record in Bytes.
        integer DemExtendedDataRecordNumber: 0..253, set at post-build in variant post-build / pre-compile in variant pre-compile  # This configuration parameter specifies an unique identifier for an ExtendedDataRecord. One or more ExtendedDataRecords can be assigned to one DTC. max = 253 because 0xFF and 0xFE are resereved by ISO
        container DemCallbackGetExtDataRecord  # The presence of this container indicates that the DEM has access to an "GetExtendedDataRecord" callback, which the DEM will call to obtain an extended data record. In case there is a DemCallbackGetExtDataRecordFnc, this parameter contains the name of the function that the DEM will call. In case there is no DemCallbackGetExtDataRecordFnc, the DEM will have an R-Port requiring tthe interface CallbackGetExtendedDataRecord whose name is the name of this container
          function name DemCallbackGetExtDataRecordFnc [0..1]: set at pre-compile  # Function name of prototype "GetExtendedDataRecord"
      container DemFreezeFrameClass [0..255]  # This container contains the configuration (parameters) for FreezeFrameClass.
        enumeration DemFreezeFrameKind: {DEM_FREEZE_FRAME_NON_OBD, DEM_FREEZE_FRAME_OBD}, set at post-build in variant post-build / pre-compile in variant pre-compile  # Defines whether the freeze-frame is OBD relevant or not
        integer DemFreezeFrameRecordNum: 0..255, set at post-build in variant post-build / pre-compile in variant pre-compile  # For OBD relevant data Multiple PIDs can be relevant per Freezeframe. This parameter is optional!
        reference DemFreezeFrameIdClassRef [1..255]: set at post-build in variant post-build / pre-compile in variant pre-compile, destination=DemPidOrDid  # For OBD relevant data Multiple PIDs can be relevant per Freezeframe. This parameter is optional!
      container DemIndicator [0..255]  # This container contains the configuaration (parameters) for Indicators. Note hat this container definition does not explicitly define a symbolic name parameter. Instead, the short name of the container will be used in the Ecu Configuration Description to specify the symbolic name of the INDICATOR_NAME.
        integer DemIndicatorID: 0..255, set at pre-compile, symbolic-name-value=true  # Unique identifier of an indicator.
      container DemNvramBlockId [0..*]  # This container contains the configuaration (parameters) for Dem_OperationCycleList. Note hat this container definition does not explicitly define a symbolic name parameter. Instead, the short name of the container will be used in the Ecu Configuration Description to specify the symbolic name of the VALUE_NAME.
        symbolic name reference DemNvramBlockIdRef: origin=AUTOSAR_ECUC V1.0.0, destination=NvmBlockDescriptor
      container DemOperationCycleTgt [0..*]  # Note hat this container definition does not explicitly define a symbolic name parameter. Instead, the short name of the container will be used in the Ecu Configuration Description to specify the symbolic name of the OperationCycleName.
        enumeration DemOperationCycle: {DEM_IGNITION, DEM_OBD_DCY, DEM_POWER, DEM_WARMUP}, set at pre-compile  # List of cycles for the DEM to be supported by API Dem_SetOperationCycleState in SW-C. Therein, only the symbolic names shall be used. The declaration is given via Dem.h. Further cycles can be specified as part of the DEM delivery.
      container DemPidOrDid [0..255]  # This container defines how the DEM can obtain the value of a PID or a DID from either a SWC or another BSWM. Whether a port or a direct function-call is used is defined by DemPidOrDidUsePort. Whether the value is a PID or a DID is indicated through the presence of either a DemDidIdentifier OR a DemPidIdentifier. The name of the container is the name of the R-Port used to obtain the PID or DID data (when DemPidOrDidUsePort is true).
        function name DemDidConditionCheckReadFnc [0..1]: set at pre-compile  # Name of a function of prototype "ConditionCheckRead" used to check whether the DID can be read
        integer DemDidIdentifier [0..1]: 0..65535  # Identifier of the DID
        function name DemDidReadDataLengthFnc [0..1]: set at pre-compile  # Name of a function of prototype "ReadDataLength" used to obtain the lenght of a dynamically sized DID. In case this container is present, it indicates that the DID has a dynamic length. In case DemPidOrDidUsePort=true, the actual function-name is not used as the information is obtained through an R-Port.
        function name DemDidReadFnc [0..1]: set at pre-compile  # In case of a DID and if DemPidOrDidUserPort is false, this defines the function of prototype "ReadData" used to get the value of the DID.
        integer DemPidIdentifier [0..1]: 0..255, set at post-build in variant post-build / pre-compile in variant pre-compile  # identifier of the PID
        integer DemPidOrDidSize: 0..255, set at post-build in variant post-build / pre-compile in variant pre-compile  # This defines the size of the PID or DID
        boolean DemPidOrDidUsePort  # True when an R-Port is used to obtain the PID (interface PIDServices) or DID (interface DIDServices). False when the information is obtained when calling functions on another BSWM.
        function name DemPidReadFnc [0..1]: set at pre-compile  # Name of a function of prototype "GetPIDValue". This function is used to obtain the value of a PID for the case that DemPidOrDidUsePort is false.
  module definition Det [0..1]  # Configuration of the Det (Development Error Tracer) module. There are NO standardized configuration parameters defined. All the configuration of the Det is done via vendor-specific configuration parameters which need to be defined inside this ModuleDef.
  module definition Dio [0..1]: variants pre-compile/post-build  # Configuration of the Dio (Digital IO) module.
    container DioGeneral  # General DIO module configuration parameters.
      boolean DioDevErrorDetect: set at pre-compile  # Switches the Development Error Detection and Notification ON or OFF
      boolean DioVersionInfoApi: set at pre-compile  # Adds / removes the service Dio_ GetVersionInfo() from the code.
    container DioPort [1..*]  # Configuration of individual DIO ports, consisting of channels and possible channel groups. Nothe that this container definition does not explicitly define a symbolic name parameter. Instead, the container's short name will be used in the Ecu Configuration Description to specify the symbolic name of the port.
      integer DioPortId: 0.., set at post-build in variant post-build / pre-compile in variant pre-compile, symbolic-name-value=true  # Numeric identifier of the DIO port. Not all MCU ports may be used for DIO, thus there may be "gaps" in the list of all IDs. This value will be assigned to the DIO port symbolic name (i.e. the SHORT-NAME of the DioPort container).
      container DioChannel [0..*]  # Configuration of an individual DIO channel. Besides a HW specific channel name which is typically fixed for a specific micro controller, additional symbolic names can be defined per channel. Note hat this container definition does not explicitly define a symbolic name parameter. Instead, the container's short name will be used in the Ecu Configuration Description to specify the symbolic name of the channel.
        integer DioChannelId: 0.., set at post-build in variant post-build / pre-compile in variant pre-compile, symbolic-name-value=true  # Channel Id of the DIO channel. This value will be assigned to the symbolic names.
      container DioChannelGroup [0..*]  # Definition and configuration of DIO channel groups. A channel group represents several adjoining DIO channels represented by a logical group. Note hat this container definition does not explicitly define a symbolic name parameter. Instead, the container's short name will be used in the Ecu Configuration Description to specify the symbolic name of the channel group.
        string DioChannelGroupIdentification: set at pre-compile, symbolic-name-value=true  # The DIO channel group is identified in DIO API by a pointer to a data structure (of type Dio_ChannelGroupType). That data structure contains the channel group information. This parameter contains the code fragment that has to be inserted in the API call of the calling module to get the address of the variable in memory which holds the channel group information. Example values are "&MyDioGroup1" or "&MyDioGroupArray[0]"
        integer DioPortMask: set at post-build in variant post-build / pre-compile in variant pre-compile  # This shall be the mask which defines the positions of the channel group. The data type depends on the port width
        derived integer DioPortOffset: set at post-build in variant post-build / pre-compile in variant pre-compile, calculation-formula=position of the first bit of dioportmask which is set to '1' counted from lsb, calculation-language=INFORMAL  # The position of the Channel Group on the port, counted from the LSB. This value can be derived from DioPortMask. calculationFormula = Position of the first bit of DioPortMask which is set to '1' counted from LSB
  module definition Ea [0..*]: variants pre-compile  # Configuration of the Ea (EEPROM Abstraction) module. The module shall abstract from the device specific addressing scheme and segmentation and provide the upper layers with a virtual addressing scheme and segmentation as well as a "virtually" unlimited number of erase cycles.
    container EaBlockConfiguration [1..*]  # Configuration of block specific parameters for the EEPROM abstraction module.
      integer EaBlockNumber: 0..65535, set at pre-compile, symbolic-name-value=true  # Block identifier (handle). 0x0000 and 0xFFFF shall not be used for block numbers (see EA006). Range: min = 2^NVM_DATA_SELECTION_BITS max = 0xFFFF -2^NVM_DATA_SELECTION_BITS Note: Depending on the number of bits set aside for dataset selection several other block numbers shall also be left out to ease implementation.
      integer EaBlockSize: 0..65535, set at pre-compile  # Size of a logical block in bytes.
      boolean EaImmediateData: set at pre-compile  # Marker for high priority data. true: Block contains immediate data. false: Block does not contain immediate data.
      integer EaNumberOfWriteCycles: set at pre-compile  # Number of write cycles required for this block.
      symbolic name reference EaDeviceIndex: destination=EepGeneral  # Device index (handle). Range: 0 .. 254 (0xFF reserved for broadcast call to GetStatus function).
    container EaGeneral  # General configuration of the EEPROM abstraction module. This container lists block independent configuration parameters.
      boolean EaDevErrorDetect: set at pre-compile  # Pre-processor switch to enable and disable development error detection. true: Development error detection enabled. false: Development error detection disabled.
      integer EaIndex: set at pre-compile  # Specifies the InstanceId of this module instance. If only one instance is present it shall have the Id 0.
      function name EaNvmJobEndNotification: set at pre-compile  # Mapped to the job end notification routine provided by the upper layer module (NvM_JobEndNotification).
      function name EaNvmJobErrorNotification: set at pre-compile  # Mapped to the job error notification routine provided by the upper layer module (NvM_JobErrorNotification).
      boolean EaPollingMode: set at pre-compile  # Pre-processor switch to enable and disable the polling mode for this module. true: Polling mode enabled. false: Polling mode disabled.
      boolean EaVersionInfoApi: set at pre-compile  # Pre-processor switch to enable / disable the API to read out the modules version information. true: Version info API enabled. false: Version info API disabled.
      integer EaVirtualPageSize: 0..65535, set at pre-compile  # The size in bytes to which logical blocks shall be aligned.
    container EaPublishedInformation  # Additional published parameters not covered by CommonPublishedInformation container. Note that these parameters do not have any configuration class setting, since they are published information.
      integer EaBlockOverhead  # Management overhead per logical block in bytes. Note: If the management overhead depends on the block size or block location a formula has to be provided that allows the configurator to calculate the management overhead correctly.
      float EaMaximumBlockingTime: 0.., set at pre-compile  # The maximum time the EA module's API routines shall be blocked (delayed) by internal operations. (EA070) Note: Internal operations in that case means operations that are not explicitly invoked from the upper layer module but need to be handled for proper operation of this module or the underlying memory driver.
      integer EaPageOverhead  # Management overhead per page in bytes. Note: If the management overhead depends on the block size or block location a formula has to be provided that allows the configurator to calculate the management overhead correctly.
  module definition EcuC [0..1]  # Virtual module to collect ECU Configuration specific / global configuration information.
    container PduCollection [0..1]  # Collection of all Pdu objects flowing through the Com-Stack.
      container Pdu [0..*]  # One Pdu flowing through the COM-Stack. This Pdu is used by all Com-Stack modules to aggree on referencing the same Pdu.
        integer PduLength  # Length in bits of the Pdu.
        foreign reference SysTPduToFrameMappingRef [0..1]: destination-type=PduToFrameMapping  # Optional reference to the PduToFrameMapping from the SystemTemplate which this Pdu represents.
  module definition EcuM [0..1]: variants post-build  # Configuration of the EcuM (ECU State Manager) module.
    container EcuMConfiguration: multiple-configuration-container=true  # This container contains the configuration (parameters) of the ECU State Manager
      integer EcuMConfigConsistencyHash: set at link  # A hash value generated across all pre-compile and link-time parameters of all BSW modules. This hash value is compared against a field in the EcuM_ConfigType and hence allows checking the consistency of the entire configuration.
      float EcuMNvramReadallTimeout: set at post-build  # Period given in seconds for which the ECU State Manager will wait until it considers a ReadAll job of the NVRAM Manager as failed.
      float EcuMNvramWriteallTimeout: set at post-build  # Period given in seconds for which the ECU State Manager will wait until it considers a WriteAll job of the NVRAM Manager as failed.
      float EcuMRunMinimumDuration: set at post-build  # Duration given in seconds for which the ECU State Manager will stay in RUN state even when no one requests RUN. This duration should be long at least as long as a SW-Cs needs to request RUN.
      float EcuMSleepActivityPeriod: set at post-build  # Period of the EcuM_SleepActivity callout. The period is given in seconds.
      choice reference EcuMModuleConfigurationRef [0..*]: set at post-build, destination=[PduRGlobalConfig, PwmChannelConfigSet, IcuConfigSet, FlsConfigSet, LinGlobalConfig, FrSmCluster, LinSMChannel, GptChannelConfigSet, AdcConfigSet, CanConfigSet, CanIfInitConfiguration, WdgMConfigSet, WdgModeConfig, LinTpGlobalConfig, ComConfig, FrNmChannelConfig, FrIfConfig, CanNmGlobalConfig, CanStateManagerConfiguration, FrTpMultipleConfig, McuModuleConfiguration, LinIfGlobalConfig, IPduMConfig, PortConfigSet, FrMultipleConfiguration, DemConfigSet, SpiDriver]  # This parameter contains a reference to the init structure of the corresponding BSW module.
      reference EcuMDefaultAppMode: set at post-build, destination=OsAppMode  # The default application mode loaded when the ECU comes out of reset.
      symbolic name reference EcuMNormalMcuModeRef: destination=McuModeSettingConf  # This parameter is a reference to the normal MCU mode to be restored after a sleep.
      container EcuMDefaultShutdownTarget  # This container describes the default shutdown target to be selected by EcuM. The actual shutdown target may be overridden by the EcuM_SelectShutdownTarget service.
        enumeration EcuMDefaultState: {EcuMStateOff, EcuMStateReset, EcuMStateSleep}, set at post-build  # This parameter describes the state part of the default shutdown target selected when the ECU comes out of reset. If EcuMStateSleep is selected, the parameter EcuMDefaultSleepModeRef selects the specific sleep mode.
        symbolic name reference EcuMDefaultSleepModeRef: destination=EcuMSleepMode  # If EcuMDefaultShutdownTarget is EcuMStateSleep, this parameter selects the default sleep mode. Otherwise this parameter may be ignored.
      container EcuMDriverInitListOne [0..1]  # Container for Init Block I. This container holds a list of module IDs that will be initialised. Each module in the list will be called for initialisation in the list order. All modules in this list are initilialised before the OS is started and so these modules require no OS support.
        container EcuMDriverInitItem [1..*]  # This container describes one entry in a driver init list.
          string EcuMModuleID: set at pre-compile  # Short name of the module to be initialized, e.g. Mcu, Gpt etc.
          string EcuMModuleService: set at pre-compile  # The service to be called to initialize that module, e.g. Init, PreInit, Start etc. If the service is Init and the parameter EcuMModuleConfigurationRef has been set for that module, the corresponding pointer to the init structure (<Module>_ConfigType) shall be passed as an argument.
      container EcuMDriverInitListThree [0..1]  # Container for Init Block III. This container holds a list of module IDs that will be initialised. Each module in the list will be called for initialisation in the list order. All modules in this list are initilialised after the OS is started and so these modules may use OS support. These modules may also rely on the Nvram ReadAll job to have provided all data.
        container EcuMDriverInitItem [1..*]  # This container describes one entry in a driver init list.
          string EcuMModuleID: set at pre-compile  # Short name of the module to be initialized, e.g. Mcu, Gpt etc.
          string EcuMModuleService: set at pre-compile  # The service to be called to initialize that module, e.g. Init, PreInit, Start etc. If the service is Init and the parameter EcuMModuleConfigurationRef has been set for that module, the corresponding pointer to the init structure (<Module>_ConfigType) shall be passed as an argument.
      container EcuMDriverInitListTwo [0..1]  # Container for Init Block II. This container holds a list of module IDs that will be initialised. Each module in the list will be called for initialisation in the list order. All modules in this list are initilialised after the OS is started and so these modules may use OS support. These modules may not rely on the Nvram ReadAll job to have provided all data.
        container EcuMDriverInitItem [1..*]  # This container describes one entry in a driver init list.
          string EcuMModuleID: set at pre-compile  # Short name of the module to be initialized, e.g. Mcu, Gpt etc.
          string EcuMModuleService: set at pre-compile  # The service to be called to initialize that module, e.g. Init, PreInit, Start etc. If the service is Init and the parameter EcuMModuleConfigurationRef has been set for that module, the corresponding pointer to the init structure (<Module>_ConfigType) shall be passed as an argument.
      container EcuMDriverInitListZero [0..1]  # Container for Init Block 0. This container holds a list of module IDs that will be initialised. Each module in the list will be called for initialisation in the list order. All modules in this list are initilialised before the post-build configuration has been loaded and the OS is initialized. Therefore, these modules may not use post-build configuration.
        container EcuMDriverInitItem [1..*]  # This container describes one entry in a driver init list.
          string EcuMModuleID: set at pre-compile  # Short name of the module to be initialized, e.g. Mcu, Gpt etc.
          string EcuMModuleService: set at pre-compile  # The service to be called to initialize that module, e.g. Init, PreInit, Start etc. If the service is Init and the parameter EcuMModuleConfigurationRef has been set for that module, the corresponding pointer to the init structure (<Module>_ConfigType) shall be passed as an argument.
      container EcuMDriverRestartList [0..1]  # List of module IDs. EcuM2719: A configuration tool shall fill the callout EcuM_AL_DriverRestart with initialization calls to the listed drivers in the order in which they occur in the list. EcuM2720: Entries in this list must appear in the same order as in the combined list of EcuM_DriverInitListOne and EcuM_DriverInitListTwo. This list may be a real subset though. In all other cases, the generation tool shall report an error. The included container has the same structure as EcuM_DriverInitItem
        container EcuMDriverInitItem [1..*]  # This container describes one entry in a driver init list.
          string EcuMModuleID: set at pre-compile  # Short name of the module to be initialized, e.g. Mcu, Gpt etc.
          string EcuMModuleService: set at pre-compile  # The service to be called to initialize that module, e.g. Init, PreInit, Start etc. If the service is Init and the parameter EcuMModuleConfigurationRef has been set for that module, the corresponding pointer to the init structure (<Module>_ConfigType) shall be passed as an argument.
      container EcuMSleepMode [1..*]  # This container describes one configured sleep mode.
        integer EcuMSleepModeId: 0..255, set at pre-compile  # This is the ID to identify this sleep mode in services like EcuM_SelectShutdownTarget.
        string EcuMSleepModeName: set at pre-compile, symbolic-name-value=true  # This item allows to give symbolic names to the different sleep modes.
        boolean EcuMSleepModeSuspend: set at pre-compile  # Flag, which is set true, if the CPU is suspended, halted, or powered off in the sleep mode. If the CPU keeps running in this sleep mode, then this flag must be set to false.
        symbolic name reference EcuMSleepModeMcuModeRef: destination=McuModeSettingConf  # This parameter is a reference to the corresponding MCU mode for this sleep mode.
        symbolic name reference EcuMSleepModeWdgMModeRef [0..1]: destination=WdgMMode  # This parameter defines the Watchdog Manager mode that shall be active in this sleep mode.
        symbolic name reference EcuMWakeupSourceMask [1..*]: destination=EcuMWakeupSource  # This parameter is a reference to the wakeup source that shall be enabled for this sleep mode.
      container EcuMTTII [0..*]  # This container describes a structure and the following configuration items describe its elements. This structures are concatenated to build a list as indicated by Figure 27 - Configuration Container Diagram. The list must contain at least on element when ECUM_TTII_ENABLED is set to true.
        integer EcuMDivisor: set at pre-compile  # This parameter defines the divisor preload value.
        symbolic name reference EcuMSleepModeRef: destination=EcuMSleepMode  # This configuration parameter is a reference to a configured sleep mode that is used for TTII.
        symbolic name reference EcuMSuccessorRef: destination=EcuMSleepMode  # This parameter is a reference to the next sleep mode in the TTII protocol.
      container EcuMUserConfig [1..*]  # A list of identifiers that are needed to refer to a software component or another appropriate entity in the system which is designated to request the RUN state. Application requestors refer to entities above RTE, system requestors to entities below RTE (e.g. Communication Manager).
        integer EcuMUser: set at pre-compile
      container EcuMWakeupSource [1..*]  # This container describes one configured wakeup source.
        integer EcuMResetReason: set at pre-compile  # This parameter describes the mapping of reset reasons detected by the MCU driver into wakeup sources.
        float EcuMValidationTimeout: set at pre-compile  # The validation timeout (period for which the ECU State Manager will wait for the validation of a wakeup event) can be defined for each wakeup source independently. The timeout is specified in seconds.
        integer EcuMWakeupSourceId: set at pre-compile, symbolic-name-value=true  # This parameter defines the identifier of this wakeup source.
        boolean EcuMWakeupSourcePolling: set at pre-compile  # This parameter describes if the wakeup source needs polling.
        symbolic name reference EcuMComMChannelRef [0..1]: destination=ComMChannel  # This parameter is a reference to a Network (channel) defined in the Communication Manager. No reference indicates that the wakeup source is not a communication channel.
      container EcuMWdgM [0..1]  # This container holds the configuration parameters for the interaction between the Watchdog Manager (WdgM) and EcuM. The WdgM mode to be selected in a specific Sleep Mode of EcuM is configured in the EcuMSleepMode container.
        reference EcuMWdgMPostRunModeRef: set at post-build, destination=WdgMMode  # This parameter references the WdgM mode to be set when entering the POST RUN state of EcuM.
        reference EcuMWdgMRunModeRef: set at post-build, destination=WdgMMode  # This parameter references the WdgM mode to be set when entering the RUN state of EcuM.
        reference EcuMWdgMShutdownModeRef: set at post-build, destination=WdgMMode  # This parameter references the WdgM mode to be set when leaving the GO OFF I state of EcuM.
        reference EcuMWdgMStartupModeRef: set at post-build, destination=WdgMMode  # This parameter references the WdgM mode to be set when entering the STARTUP II state of EcuM.
        reference EcuMWdgMWakeupModeRef: set at post-build, destination=WdgMMode  # This parameter references the WdgM mode to be set when entering the WAKEUP I state of EcuM.
        symbolic name reference EcuMSupervisedEntityRef: destination=WdgMSupervisedEntity  # This parameter references the Supervised Entity ID that way configured for EcuM in the Watchdog Manager.
    container EcuMGeneral  # This container holds the general, pre-compile configuration parameters
      boolean EcuMDevErrorDetect: set at pre-compile  # If false, no debug artifacts (e.g. calls to DET) shall remain in the executable object. Initialization of DET, however is controlled by configuration of optional BSW modules.
      boolean EcuMIncludeDem: set at pre-compile  # If enabled and NVRAM manager is disabled, then an error shall be flagged by the configuration tool
      boolean EcuMIncludeDet: set at pre-compile  # If defined, the according BSW module will be initialized by the ECU State Manager
      boolean EcuMIncludeNvramMgr: set at pre-compile  # If NVRAM manager is enabled but both flash and EEPROM driver are missing, then an error shall be flagged by the configuration tool
      boolean EcuMIncludeWdgM: set at pre-compile  # This configuration parameter defines whether the watchdog manager is supported by EcuM. This feature is presented for development purpose to compile out the watchdog manager in the early debugging phase
      float EcuMMainFunctionPeriod: set at pre-compile  # This parameter defines the schedule period of EcuM_MainFunction. Unit: [s]
      boolean EcuMTTIIEnabled: set at pre-compile  # Boolean switch to enable / disable TTII
      boolean EcuMVersionInfoApi: set at pre-compile  # Switches the version info API on or off
      symbolic name reference EcuMTTIISleepModeRef: destination=EcuMSleepMode  # This configuration parameter references the initial sleep mode to be used by TTII when TTII is activated after a RUN mode. EcuM2785: Whenever RUN mode is reached, the TTII protocol shall be reset to use the wakeup source referenced by this parameter. This configuration parameter is a human readable name for a TTII wakeup source which is only needed by the configuration tool. For imlementation on the ECU, this parameter may be dropped and replaced by a generated list index of EcuM_TTII.
  module definition Eep [0..*]: variants pre-compile/link-time  # Configuration of the Eep (internal or external EEPROM driver) module. Its multiplicity describes the number of EEPROM drivers present, so there will be one container for each EEPROM driver in the ECUC template. When no EEPROM driver is present then the multiplicity is 0.
    container EepGeneral  # Container for general configuration parameters of the EEPROM driver. These parameters are always pre-compile.
      boolean EepDevErrorDetect: set at pre-compile, default-value=true  # Pre-processor switch to enable and disable development error detection. true: Development error detection enabled. false: Development error detection disabled.
      integer EepDriverIndex: 0..254, set at pre-compile, symbolic-name-value=true  # Index of the driver, used by EA.
      boolean EepUseInterrupts: set at pre-compile, default-value=false  # Switches to activate or deactivate interrupt controlled job processing. true: Interrupt controlled job processing enabled. false: Interrupt controlled job processing disabled.
      boolean EepVersionInfoApi: set at pre-compile, default-value=false  # Pre-processor switch to enable / disable the API to read out the modules version information. true: Version info API enabled. false: Version info API disabled.
      boolean EepWriteCycleReduction: set at pre-compile, default-value=false  # Switches to activate or deactivate write cycle reduction (EEPROM value is read and compared before being overwritten). true: Write cycle reduction enabled. false: Write cycle reduction disabled.
    container EepInitConfiguration  # Container for runtime configuration parameters of the EEPROM driver. Implementation Type: Eep_ConfigType.
      integer EepBaseAddress: set at link in variant link-time / pre-compile in variant pre-compile  # This parameter is the EEPROM device base address. Implementation Type: Eep_AddressType.
      enumeration EepDefaultMode: {MEMIF_MODE_FAST, MEMIF_MODE_SLOW}, set at link in variant link-time / pre-compile in variant pre-compile, default-value=MEMIF_MODE_SLOW  # This parameter is the default EEPROM device mode after initialization. Implementation Type: MemIf_ModeType.
      integer EepFastReadBlockSize: set at link in variant link-time / pre-compile in variant pre-compile  # This parameter is the number of bytes read within one job processing cycle in fast mode. Implementation Type: Eep_LengthType.
      integer EepFastWriteBlockSize [0..1]: set at link in variant link-time / pre-compile in variant pre-compile  # This parameter is the number of bytes written within one job processing cycle in fast mode. Implementation Type: Eep_LengthType.
      float EepJobCallCycle: set at link in variant link-time / pre-compile in variant pre-compile  # This parameter is the call cycle of the job processing function during write/erase operations. Unit: [s]
      function name EepJobEndNotification: set at link in variant link-time / pre-compile in variant pre-compile  # This parameter is a reference to a callback function for positive job result (see EEP045).
      function name EepJobErrorNotification: set at link in variant link-time / pre-compile in variant pre-compile  # This parameter is a reference to a callback function for negative job result (see EEP046).
      integer EepNormalReadBlockSize: set at link in variant link-time / pre-compile in variant pre-compile  # This parameter is the number of bytes read within one job processing cycle in normal mode. Implementation Type: Eep_LengthType.
      integer EepNormalWriteBlockSize [0..1]: set at link in variant link-time / pre-compile in variant pre-compile  # Number of bytes written within one job processing cycle in normal mode. Implementation Type: Eep_LengthType.
      integer EepSize: set at link in variant link-time / pre-compile in variant pre-compile  # This parameter is the used size of EEPROM device in bytes. Implementation Type: Eep_LengthType.
      container EepExternalDriver [0..1]  # This container is present for external EEPROM drivers only. Internal EEPROM drivers do not use the parameter listed in this container, hence its multiplicity is 0 for internal drivers.
        symbolic name reference SpiReference [1..*]: destination=SpiSequence  # Reference to SPI sequence (required for external EEPROM drivers).
    container EepPublishedInformation  # Additional published parameters not covered by CommonPublishedInformation container. Note that these parameters do not have any configuration class setting, since they are published information.
      integer EepAllowedWriteCycles: set at published-information  # Specified maximum number of write cycles under worst case conditions of specific EEPROM hardware (e.g. +90°C)
      float EepEraseTime: set at published-information  # Time for erasing one EEPROM data unit.
      integer EepEraseUnitSize: set at published-information  # Size of smallest erasable EEPROM data unit in bytes.
      integer EepEraseValue: set at published-information  # Value of an erased EEPROM cell.
      integer EepMinimumAddressType: set at published-information  # Minimum expected size of Eep_AddressType.
      integer EepMinimumLengthType: set at published-information  # Minimum expected size of Eep_LengthType.
      integer EepReadUnitSize: set at published-information  # Size of smallest readable EEPROM data unit in bytes.
      integer EepSpecifiedEraseCycles: set at published-information  # Number of erase cycles specified for the EEP device (usually given in the device data sheet).
      integer EepTotalSize: set at published-information  # Total size of EEPROM in bytes. Implementation Type: Eep_LengthType.
      float EepWriteTime: set at published-information  # Time for writing one EEPROM data unit.
      integer EepWriteUnitSize: set at published-information  # Size of smallest writeable EEPROM data unit in bytes.
  module definition Fee [0..*]: variants pre-compile  # Configuration of the Fee (Flash EEPROM Emulation) module.
    container FeeBlockConfiguration [1..*]  # Configuration of block specific parameters for the Flash EEPROM Emulation module.
      integer FeeBlockNumber: 0..65535, set at pre-compile, symbolic-name-value=true  # Block identifier (handle). 0x0000 and 0xFFFF shall not be used for block numbers (see FEE006). Range: min = 2^NVM_DATA_SELECTION_BITS max = 0xFFFF -2^NVM_DATA_SELECTION_BITS Note: Depending on the number of bits set aside for dataset selection several other block numbers shall also be left out to ease implementation.
      integer FeeBlockSize: 0..65535, set at pre-compile  # Size of a logical block in bytes.
      boolean FeeImmediateData: set at pre-compile  # Marker for high priority data. true: Block contains immediate data. false: Block does not contain immediate data.
      integer FeeNumberOfWriteCycles: set at pre-compile  # Number of write cycles required for this block.
      symbolic name reference FeeDeviceIndex: destination=FlsGeneral  # Device index (handle). Range: 0 .. 254 (0xFF reserved for broadcast call to GetStatus function).
    container FeeGeneral  # Container for general parameters. These parameters are not specific to a block.
      boolean FeeDevErrorDetect: set at pre-compile  # Pre-processor switch to enable and disable development error detection. true: Development error detection enabled. false: Development error detection disabled.
      integer FeeIndex: set at pre-compile  # Specifies the InstanceId of this module instance. If only one instance is present it shall have the Id 0.
      function name FeeNvmJobEndNotification: set at pre-compile  # Mapped to the job end notification routine provided by the upper layer module (NvM_JobEndNotification).
      function name FeeNvmJobErrorNotification: set at pre-compile  # Mapped to the job error notification routine provided by the upper layer module (NvM_JobErrorNotification).
      boolean FeePollingMode: set at pre-compile  # Pre-processor switch to enable and disable the polling mode for this module. true: Polling mode enabled. false: Polling mode disabled.
      boolean FeeVersionInfoApi: set at pre-compile  # Pre-processor switch to enable / disable the API to read out the modules version information. true: Version info API enabled. false: Version info API disabled.
      integer FeeVirtualPageSize: 0..65535, set at pre-compile  # The size in bytes to which logical blocks shall be aligned.
    container FeePublishedInformation  # Additional published parameters not covered by CommonPublishedInformation container. Note that these parameters do not have any configuration class setting, since they are published information.
      integer FeeBlockOverhead  # Management overhead per logical block in bytes. Note: If the management overhead depends on the block size or block location a formula has to be provided that allows the configurator to calculate the management overhead correctly.
      float FeeMaximumBlockingTime: 0..  # The maximum time the FEE module's API routines shall be blocked (delayed) by internal operations. Note: Internal operations in that case means operations that are not explicitly invoked from the upper layer module but need to be handled for proper operation of this module or the underlying memory driver.
      integer FeePageOverhead  # Management overhead per page in bytes. Note: If the management overhead depends on the block size or block location a formula has to be provided that allows the configurator to calculate the management overhead correctly.
  module definition Fim [0..1]: variants pre-compile/post-build  # Configuration of the Fim (Function Inhibition Manager) module.
    container FimEventSummary [0..*]  # The summarized EventId definition record consists of a summarized event ID and a specific EventId. This record means that a particular FID that has to be disabled in case of summarized event (defined above) is to be disabled in any of the specific events. A possible solution could be assigning events as summarized events along with a list of specific events. During the configuration process the summarized event substitutes the referenced single events. However, it is not outlined how this requirement is solved - whether by configuration process or by implementation within the FIM. The FIM configuration tool could also build up a suitable data structure for summarized events and deal with it in the FIM implementation.
      symbolic name reference FimInputSumEventRef: destination=DemEventParameter
      symbolic name reference FimOutputSumEventRef: destination=FimSummaryEventId
    container FimFid [0..*]  # This container includes symbolic names of all FIDs.
      integer FimFuntionId: 0..65535, set at pre-compile, symbolic-name-value=true  # The configuration parameter is used as an ID which represents a functionality. FimFuntionId is the unique identifier assigned during FIM configuration. Implementation Type: Fim_FunctionIdType.
    container FimGeneral
      boolean FimCyclicEventEvaluation: set at pre-compile  # This configuration parameter specifies whether the evaluation of DEM events is performed by the FIM cyclically or the DEM informs FIM about changes of event states. true: FIM cyclically evaluates event states in the DEM. false: DEM informs FIM about changes of event states.
      boolean FimDataFixed: set at pre-compile  # Enable or disable calibration of inhibit relations The scope of the parameter is to meet the requirement (FIM008) to have the option to calibrate inhibit data on the one hand side and also to provide the option to protect inhibit data for consistency reasons.
      boolean FimDevErrorDetect: set at pre-compile  # This configuration parameter is used to switch on or to switch off the detection of development errors during development.
      integer FimMaxEventFidLinks: 1..65535, set at pre-compile  # This configuration parameter specifies the total maximum number of links between EventIds and FIDs.
      integer FimMaxEventsPerFid: 1..65535, set at pre-compile  # This configuration parameter specifies the maximum number of EventIds that can be linked to a single FID.
      integer FimMaxFidsPerEvent: 1..65535, set at pre-compile  # This configuration parameter specifies the maximum number of FIDs that can be linked to a single event.
      integer FimMaxSummaryEvents: 0..65535, set at pre-compile  # This configuration parameter specifies the maximum number of summarized events that can be configured.
      integer FimMaxSummaryLinks: 0..65535, set at pre-compile  # This configuration parameter specifies the total maximum number of links between EventIds and summarized events.
      integer FimMaxTotalLinks: 1..65535, set at pre-compile  # This configuration parameter specifies the total maximum number of links between EventIds and FIDs plus the number of links between EventIds and summarized events.
      boolean FimVersionInfoApi: set at pre-compile  # This configuration parameter is used to switch on or to switch off the API to get the version information.
    container FimInhibitionConfiguration [0..*]  # This container includes all configuration parameters concerning the relationship between event and FID.
      enumeration FimInhInhibitionMask: {FIM_LAST_FAILED, FIM_NOT_TESTED, FIM_TESTED, FIM_TESTED_AND_FAILED}, set at post-build in variant post-build / pre-compile in variant pre-compile  # The configuration parameter is used to specify the inhibition mask for an event - FID relation.
      reference FimInhFunctionIdRef: set at post-build in variant post-build / pre-compile in variant pre-compile, destination=FimFid
      container FimInhEventId  # The configuration parameter is used for an existing DEM event and summarized events as well.
        choice container FimInhRefChoice
          container FimInhChoiceDemRef
            symbolic name reference FimInhEventRef: destination=DemEventParameter
          container FimInhChoiceSumRef
            symbolic name reference FimInhSumRef: destination=FimSummaryEventId
    container FimSummaryEventId [0..*]  # This container defines the name of a summarized event.
      integer FimEventSumId: 0..65535, set at post-build in variant post-build / pre-compile in variant pre-compile, symbolic-name-value=true  # The summarized EventId definition record defines the existence of a summarized event with a specific name. This summarized event can be referenced in the EventSummary (as FimSummaryEventId) and Inhibition configuration (as FimInhEventId).
  module definition Fls [0..*]: variants pre-compile/post-build  # Configuration of the Fls (internal or external flash driver) module. Its multiplicity describes the number of flash drivers present, so there will be one container for each flash driver in the ECUC template. When no flash driver is present then the multiplicity is 0.
    container FlsConfigSet [1..*]: multiple-configuration-container=true  # Container for runtime configuration parameters of the flash driver. Implementation Type: Fls_ConfigType.
      function name FlsAcErase: set at post-build in variant post-build / pre-compile in variant pre-compile  # Address offset in RAM to which the erase flash access code shall be loaded. Used as function pointer to access the erase flash access code.
      function name FlsAcWrite: set at post-build in variant post-build / pre-compile in variant pre-compile  # Address offset in RAM to which the write flash access code shall be loaded. Used as function pointer to access the write flash access code.
      float FlsCallCycle: 0.., set at post-build in variant post-build / pre-compile in variant pre-compile  # Cycle time of calls of the flash driver's main function.
      function name FlsJobEndNotification: set at post-build in variant post-build / pre-compile in variant pre-compile  # Mapped to the job end notification routine provided by some upper layer module, typically the Fee module.
      function name FlsJobErrorNotification: set at post-build in variant post-build / pre-compile in variant pre-compile  # Mapped to the job error notification routine provided by some upper layer module, typically the Fee module.
      integer FlsMaxReadFastMode: set at post-build in variant post-build / pre-compile in variant pre-compile  # The maximum number of bytes to read or compare in one cycle of the flash driver's job processing function in fast mode.
      integer FlsMaxReadNormalMode: set at post-build in variant post-build / pre-compile in variant pre-compile  # The maximum number of bytes to read or compare in one cycle of the flash driver's job processing function in normal mode.
      integer FlsMaxWriteFastMode: set at post-build in variant post-build / pre-compile in variant pre-compile  # The maximum number of bytes to write in one cycle of the flash driver's job processing function in fast mode.
      integer FlsMaxWriteNormalMode: set at post-build in variant post-build / pre-compile in variant pre-compile  # The maximum number of bytes to write in one cycle of the flash driver's job processing function in normal mode.
      integer FlsProtection: set at post-build in variant post-build / pre-compile in variant pre-compile  # Erase/write protection settings. Only relevant if supported by hardware.
      container FlsSectorList  # List of flashable sectors and pages.
        container FlsSector [1..*]  # Configuration description of a flashable sector
          integer FlsNumberOfSectors: set at post-build in variant post-build / pre-compile in variant pre-compile  # Number of continuous sectors with the above characteristics.
          integer FlsPageSize: set at post-build in variant post-build / pre-compile in variant pre-compile  # Size of one page of this sector. Implementation Type: Fls_LengthType.
          integer FlsSectorSize: set at post-build in variant post-build / pre-compile in variant pre-compile  # Size of this sector. Implementation Type: Fls_LengthType.
          integer FlsSectorStartaddress: set at post-build in variant post-build / pre-compile in variant pre-compile  # Start address of this sector. Implementation Type: Fls_AddressType.
    container FlsGeneral  # Container for general parameters of the flash driver. These parameters are always pre-compile.
      boolean FlsAcLoadOnJobStart: set at pre-compile, default-value=false  # The flash driver shall load the flash access code to RAM whenever an erase or write job is started and unload (overwrite) it after that job has been finished or canceled. true: Flash access code loaded on job start / unloaded on job end or error. false: Flash access code not loaded to / unloaded from RAM at all.
      integer FlsBaseAddress: set at pre-compile  # The flash memory start address (see also FLS118). FLS169: This parameter defines the lower boundary for read / write / erase and compare jobs.
      boolean FlsCancelApi: set at pre-compile  # Compile switch to enable and disable the Fls_Cancel function. true: API supported / function provided. false: API not supported / function not provided
      boolean FlsCompareApi: set at pre-compile  # Compile switch to enable and disable the Fls_Compare function. true: API supported / function provided. false: API not supported / function not provided
      boolean FlsDevErrorDetect: set at pre-compile, default-value=true  # Pre-processor switch to enable and disable development error detection (see FLS077). true: Development error detection enabled. false: Development error detection disabled.
      integer FlsDriverIndex: 0..254, set at pre-compile, symbolic-name-value=true  # Index of the driver, used by FEE.
      boolean FlsGetJobResultApi: set at pre-compile  # Compile switch to enable and disable the Fls_GetJobResult function. true: API supported / function provided. false: API not supported / function not provided
      boolean FlsGetStatusApi: set at pre-compile  # Compile switch to enable and disable the Fls_GetStatus function. true: API supported / function provided. false: API not supported / function not provided
      boolean FlsSetModeApi: set at pre-compile  # Compile switch to enable and disable the Fls_SetMode function. true: API supported / function provided. false: API not supported / function not provided
      integer FlsTotalSize: set at pre-compile  # The total amount of flash memory in bytes (see also FLS118). FLS170: This parameter in conjunction with FLS_BASE_ADDRESS defines the upper boundary for read / write / erase and compare jobs.
      boolean FlsUseInterrupts: set at pre-compile, default-value=false  # Job processing triggered by hardware interrupt. true: Job processing triggered by interrupt (hardware controlled). false: Job processing not triggered by interrupt (software controlled)
      boolean FlsVersionInfoApi: set at pre-compile  # Pre-processor switch to enable / disable the API to read out the modules version information. true: Version info API enabled. false: Version info API disabled.
    container FlsPublishedInformation  # Additional published parameters not covered by CommonPublishedInformation container. Note that these parameters do not have any configuration class setting, since they are published information.
      integer FlsAcLocationErase: set at published-information  # Position in RAM, to which the erase flash access code has to be loaded. Only relevant if the erase flash access code is not position independent. If this information is not provided it is assumed that the erase flash access code is position independent and that therefore the RAM position can be freely configured.
      integer FlsAcLocationWrite: set at published-information  # Position in RAM, to which the write flash access code has to be loaded. Only relevant if the write flash access code is not position independent. If this information is not provided it is assumed that the write flash access code is position independent and that therefore the RAM position can be freely configured.
      integer FlsAcSizeErase: set at published-information  # Number of bytes in RAM needed for the erase flash access code.
      integer FlsAcSizeWrite: set at published-information  # Number of bytes in RAM needed for the write flash access code.
      float FlsEraseTime: set at published-information  # Maximum time to erase one complete flash sector.
      integer FlsErasedValue: set at published-information  # The contents of an erased flash memory cell.
      string FlsExpectedHwId: set at published-information  # Unique identifier of the hardware device that is expected by this driver (the device for which this driver has been implemented). Only relevant for external flash drivers.
      integer FlsSpecifiedEraseCycles: set at published-information  # Number of erase cycles specified for the flash device (usually given in the device data sheet). FLS198: If the number of specified erase cycles depends on the operating environment (temperature, voltage, ...) during reprogramming of the flash device, the minimum number for which a data retention of at least 15 years over the temperature range from -40°C .. +125°C can be guaranteed shall be given. Note: If there are different numbers of specified erase cycles for different flash sectors of the device this parameter has to be extended to a parameter list (similar to the sector list above).
      float FlsWriteTime: set at published-information  # Maximum time to program one complete flash page.
  module definition Fr [0..*]: variants pre-compile/post-build  # Configuration of the Fr (FlexRay driver) module.
    container FrGeneral  # General configuration (parameters) of the FlexRay Driver module.
      boolean FrDevErrorDetect: set at pre-compile  # Switches the Development Error Detection and Notification on or off. true: Development Error Detection and Notification enabled. false: Development Error Detection and Notification disabled.
      integer FrIndex: set at pre-compile  # Specifies the InstanceId of this module instance. If only one instance is present it shall have the Id 0.
      integer FrNumCtrlSupported: 1..255, set at pre-compile  # Determines the maximum number of communication controllers that the driver supports.
      boolean FrRelativeTimerEnable: set at pre-compile  # Enables or disables the usage of relative timers. Pre-compile time switch FR_RELATIVE_TIMER_ENABLE is derived from this configuration parameter.
      boolean FrVersionInfoApi: set at pre-compile  # Enables/disables the existence of the Fr_GetVersionInfo API. Pre-compile time switch FR_VERSION_INFO_API is derived from this configuration parameter.
    container FrMultipleConfiguration: multiple-configuration-container=true  # Configuration of the individual controllers.
      container FrController [1..*]  # Configuration of the individual controller.
        integer FrCtrlClock: 0..80000000, set at post-build in variant post-build / pre-compile in variant pre-compile  # Determines clock connected to the CC [Hz].
        integer FrCtrlIdx: set at post-build in variant post-build / pre-compile in variant pre-compile, symbolic-name-value=true  # Determines index of CC within Fr.
        boolean PAllowHaltDueToClock: set at post-build in variant post-build / pre-compile in variant pre-compile  # Boolean flag that controls the transition to the POC:halt state due to a clock synchronization errors. If set to true, the CC is allowed to transition to POC:halt. If set to false, the CC will not transition to the POC:halt state but will enter or remain in the POC:normal passive state (self healing would still be possible)
        integer PAllowPassiveToActive: 0..31, set at post-build in variant post-build / pre-compile in variant pre-compile  # Number of consecutive even/odd cycle pairs that must have valid clock correction terms before the CC will be allowed to transition from the POC:normal passive state to POC:normal active state. If set to zero, the CC is not allowed to transition from POC:normal passive to POC:normal active
        enumeration PChannels: {FR_CHANNEL_A, FR_CHANNEL_AB, FR_CHANNEL_B}, set at post-build in variant post-build / pre-compile in variant pre-compile  # Channels to which the node is connected Implementation Type: Fr_ChannelType
        integer PClusterDriftDamping: 0..20, set at post-build in variant post-build / pre-compile in variant pre-compile  # Local cluster drift damping factor used for rate correction [Microticks]
        integer PDecodingCorrection: 14..143, set at post-build in variant post-build / pre-compile in variant pre-compile  # Value used by the receiver to calculate the difference between primary time reference point and secondary time reference point [Microticks]
        integer PDelayCompensationA: 0..200, set at post-build in variant post-build / pre-compile in variant pre-compile  # Value used to compensate for reception delays on the indicated channel. This covers assumed propagation delay up to cPropagationDelayMax for microticks in the range of 0.0125 µs to 0.05 µs. In practice, the minimum of the propagation delays of all sync nodes should be applied [Microticks].
        integer PDelayCompensationB: 0..200, set at post-build in variant post-build / pre-compile in variant pre-compile  # Value used to compensate for reception delays on the indicated channel. This covers assumed propagation delay up to cPropagationDelayMax for microticks in the range of 0.0125 µs to 0.05 µs. In practice, the minimum of the propagation delays of all sync nodes should be applied [Microticks].
        integer PExternOffsetCorrection: 0..7, set at post-build in variant post-build / pre-compile in variant pre-compile  # Number of microticks added or subtracted to the NIT to carry out a host-requested external offset correction [Microticks].
        integer PExternRateCorrection: 0..7, set at post-build in variant post-build / pre-compile in variant pre-compile  # Number of microticks added or subtracted to the cycle to carry out a host-requested external rate correction [Microticks].
        integer PKeySlotId [0..1]: 1..1023, set at post-build in variant post-build / pre-compile in variant pre-compile  # ID of the slot used to transmit the startup frame, sync frame, or designated single slot frame
        boolean PKeySlotUsedForStartup: set at post-build in variant post-build / pre-compile in variant pre-compile  # Flag indicating whether the Key Slot is used to transmit a startup frame
        boolean PKeySlotUsedForSync: set at post-build in variant post-build / pre-compile in variant pre-compile  # Flag indicating whether the Key Slot is used to transmit a sync frame
        integer PLatestTx: 0..7981, set at post-build in variant post-build / pre-compile in variant pre-compile  # Number of the last minislot in which a frame transmission can start in the dynamic segment [Minislots].
        integer PMacroInitialOffsetA: 2..72, set at post-build in variant post-build / pre-compile in variant pre-compile  # Integer number of macroticks between the static slot boundary and the following macrotick boundary of the secondary time reference point based on the nominal macrotick duration [Macroticks].
        integer PMacroInitialOffsetB: 2..72, set at post-build in variant post-build / pre-compile in variant pre-compile  # Integer number of macroticks between the static slot boundary and the following macrotick boundary of the secondary time reference point based on the nominal macrotick duration [Macroticks].
        integer PMicroInitialOffsetA: 0..240, set at post-build in variant post-build / pre-compile in variant pre-compile  # Number of microticks between the closest macrotick boundary described by pMacroInitialOffset[Ch] and the secondary time reference point. The parameter depends on pDelayCompensation[Ch] and therefore it has to be set independently for each channel [Microticks].
        integer PMicroInitialOffsetB: 0..240, set at post-build in variant post-build / pre-compile in variant pre-compile  # Number of microticks between the closest macrotick boundary described by pMacroInitialOffset[Ch] and the secondary time reference point. The parameter depends on pDelayCompensation[Ch] and therefore it has to be set independently for each channel [Microticks].
        integer PMicroPerCycle: 640..640000, set at post-build in variant post-build / pre-compile in variant pre-compile  # Nominal number of microticks in the communication cycle of the local node. If nodes have different microtick durations this number will differ from node to node [Microticks].
        integer PMicroPerMacroNom: 40..240, set at post-build in variant post-build / pre-compile in variant pre-compile  # Number of microticks per nominal macrotick that all implementations must support [Microticks].
        integer POffsetCorrectionOut: 5..15266, set at post-build in variant post-build / pre-compile in variant pre-compile  # Magnitude of the maximum permissible offset correction value [Microticks].
        integer PPayloadLengthDynMax: 0..127, set at post-build in variant post-build / pre-compile in variant pre-compile  # Maximum payload length for dynamic frames [16 bit words].
        integer PRateCorrectionOut: 2..1923, set at post-build in variant post-build / pre-compile in variant pre-compile  # Magnitude of the maximum permissible rate correction value [Microticks].
        enumeration PSamplesPerMicrotick: {N1SAMPLES, N2SAMPLES, N4SAMPLES}, set at post-build in variant post-build / pre-compile in variant pre-compile  # Number of samples per microtick
        boolean PSingleSlotEnabled: set at post-build in variant post-build / pre-compile in variant pre-compile  # Flag indicating whether or not the node shall enter single slot mode following startup
        enumeration PWakeupChannel: {FR_CHANNEL_A, FR_CHANNEL_B}, set at post-build in variant post-build / pre-compile in variant pre-compile  # Channel used by the node to send a wakeup pattern.
        integer PWakeupPattern: 2..63, set at post-build in variant post-build / pre-compile in variant pre-compile  # Number of repetitions of the wakeup symbol that are combined to form a wakeup pattern when the node enters the POC:wakeup send state
        integer PdAcceptedStartupRange: 0..1875, set at post-build in variant post-build / pre-compile in variant pre-compile  # Expanded range of measured clock deviation allowed for startup frames during integration [Microticks].
        integer PdListenTimeout: 1284..1283846, set at post-build in variant post-build / pre-compile in variant pre-compile  # Upper limit for the start up listen timeout and wake up listen timeout [Microticks].
        integer PdMaxDrift: 2..1923, set at post-build in variant post-build / pre-compile in variant pre-compile  # Maximum drift offset between two nodes that operate with unsynchronized clocks over one communication cycle [Microticks].
        enumeration PdMicrotick: {T100NS, T12NS, T200NS, T25NS, T50NS}, set at post-build in variant post-build / pre-compile in variant pre-compile  # Duration of a microtick.
        container FrAbsoluteTimer [1..*]  # Specifies the absolute timer configuration parameters of the Fr.
          integer FrAbsTimerIdx: 0..254, set at post-build in variant post-build / pre-compile in variant pre-compile, symbolic-name-value=true  # Contains the index of an absolute timer contained in Fr on a certain FlexRay CC.
        container FrRelativeTimer [0..*]  # Specifies the relative timer configuration parameters of the Fr.
          integer FrRelTimerIdx: 0..254, set at post-build in variant post-build / pre-compile in variant pre-compile, symbolic-name-value=true  # Contains the index of a relative timer contained in Fr on a certain FlexRay CC.
  module definition FrIf [0..1]: variants pre-compile/post-build  # Configuration of the FrIf (FlexRay Interface) module.
    container FrIfConfig: multiple-configuration-container=true  # Configuration of the FlexRay Interface. This container is a MultipleConfigurationContainer, i.e. this container and its sub-containers exist once per configuration set.
      container FrIfCluster [1..*]  # This container specifies a FrIf Cluster and all related data which is required to enable communication of the Cluster. A Cluster may consist of more than one Controller.
        integer FrIfClstIdx: 0.., set at post-build in variant post-build / pre-compile in variant pre-compile, symbolic-name-value=true  # This parameter provides a zero-based consecutive index of the FlexRay Clusters. Upper layer BSW modules and the FrIf itself use this index to identify a FlexRay Cluster.
        float FrIfMainFunctionPeriod: 0.., set at post-build in variant post-build / pre-compile in variant pre-compile  # The execution cycle of the FrIf_MainFunction_<cluster>() in seconds. The FrIf does not require this information but the BSW scheduler, which invokes the cluster main functions, needs it in order to plan its tasks.
        integer FrIfMaxIsrDelay: 0.., set at post-build in variant post-build / pre-compile in variant pre-compile  # The maximum delay in macroticks the FrIf_JoblistExec_<cluster>() function is processed after the absolute timer interrupt was triggered.
        integer GAssumedPreciscion: 0..65535, set at post-build in variant post-build / pre-compile in variant pre-compile  # Assumed precision of the application network
        enumeration GChannels: {FR_CHANNEL_A, FR_CHANNEL_AB, FR_CHANNEL_B}, set at post-build in variant post-build / pre-compile in variant pre-compile  # The channels that are used by the cluster. Implementation Type: Fr_ChannelType
        integer GClusterDriftDamping: 0..5, set at post-build in variant post-build / pre-compile in variant pre-compile  # The cluster drift damping factor, based on the longest microtick gdMaxMicrotick used in the cluster. Used to compute the local cluster drift damping factor pClusterDriftDamping [Micrroticks].
        integer GColdStartAttempts: 2..31, set at post-build in variant post-build / pre-compile in variant pre-compile  # Maximum number of times a node in the cluster is permitted to attempt to start the cluster by initiating schedule synchronization
        integer GListenNoise: 2..16, set at post-build in variant post-build / pre-compile in variant pre-compile  # Upper limit for the start up listen timeout and wake up listen timeout in the presence of noise. It is used as a multiplier of the cluster parameter pdListenTimeout.
        integer GMacroPerCycle: 10..16000, set at post-build in variant post-build / pre-compile in variant pre-compile  # Number of macroticks in a communication cycle.
        integer GMaxWithoutClockCorrectFatal: 1..15, set at post-build in variant post-build / pre-compile in variant pre-compile  # Threshold used for testing the vClockCorrectionFailed counter. Defines the number of consecutive even/odd Cycle pairs with missing clock correction terms that will cause the protocol to transition from the POC:normal active or POC:normal passive state into the POC:halt state. [Even/odd cycle pairs].
        integer GMaxWithoutClockCorrectPassive: 1..15, set at post-build in variant post-build / pre-compile in variant pre-compile  # Threshold used for testing the vClockCorrectionFailed counter. Defines the number of consecutive even/odd Cycle pairs with missing clock correction terms that will cause the protocol to transition from the POC:normal active state to the POC:normal passive state. [Even/Odd cycle pairs]
        integer GNetworkManagementVectLength: 0..12, set at post-build in variant post-build / pre-compile in variant pre-compile  # Length of the Network Management vector in a cluster [bytes]
        integer GNumberOfMinislots: 0..7986, set at post-build in variant post-build / pre-compile in variant pre-compile  # Number of minislots in the dynamic segment
        integer GNumberOfStaticSlots: 2..1023, set at post-build in variant post-build / pre-compile in variant pre-compile  # Number of static slots in the static segment
        float GOffsetCorrectionMax: 5E-07..0.0003811, set at post-build in variant post-build / pre-compile in variant pre-compile  # describes the maximum value which the offset correction should assume in seconds.
        integer GOffsetCorrectionStart: 9..15999, set at post-build in variant post-build / pre-compile in variant pre-compile  # Start of the offset correction phase within the NIT, expressed as the number of macroticks from the start of cycle.
        integer GPayloadLengthStatic: 0..127, set at post-build in variant post-build / pre-compile in variant pre-compile  # Payload length of a static frame [16 bit words]
        integer GSyncNodeMax: 2..15, set at post-build in variant post-build / pre-compile in variant pre-compile  # Maximum number of nodes that may send frames with the sync frame indicator bit set to one.
        integer GdActionPointOffset: 1..63, set at post-build in variant post-build / pre-compile in variant pre-compile  # Number of Macroticks the action point is offset from the beginning of a Static Slots or symbol window.
        float GdBit: set at post-build in variant post-build / pre-compile in variant pre-compile  # Nominal bit time in seconds
        float GdBitMax: set at post-build in variant post-build / pre-compile in variant pre-compile  # Maximum bit time taking into account the allowable clock deviation of each node (in seconds).
        float GdBitMin: set at post-build in variant post-build / pre-compile in variant pre-compile  # Minimum bit time taking into account the allowable clock deviation of each node (in seconds).
        integer GdCasRxLowMax: 67..99, set at post-build in variant post-build / pre-compile in variant pre-compile  # Upper limit of the CAS acceptance window [gdBit]
        float GdCycle: 1E-05..0.016, set at post-build in variant post-build / pre-compile in variant pre-compile  # Length of the cycle, expressed in s
        integer GdDynamicSlotIdlePhase: 0..2, set at post-build in variant post-build / pre-compile in variant pre-compile  # Duration of the idle phase within a dynamic slot [Minislots].
        float GdMacrotick: 4E-05..0.00024, set at post-build in variant post-build / pre-compile in variant pre-compile  # Duration of the cluster wide nominal macrotick, expressed in s
        float GdMaxInitializationError: 0..65535, set at post-build in variant post-build / pre-compile in variant pre-compile  # Maximum error that a node may have following integration in seconds.
        enumeration GdMaxMicrotick: {T100NS, T12_5NS, T200NS, T25NS, T50NS}, set at post-build in variant post-build / pre-compile in variant pre-compile  # Maximum Microtick length of all Microticks configured within a Cluster.
        float GdMaxPropagationDelay: set at post-build in variant post-build / pre-compile in variant pre-compile  # Maximum propagation delay of a Cluster (in seconds).
        float GdMinPropagationDelay: set at post-build in variant post-build / pre-compile in variant pre-compile  # Minimum propagation delay of a Cluster (in seconds).
        integer GdMiniSlotActionPointOffset: 1..31, set at post-build in variant post-build / pre-compile in variant pre-compile  # Number of Macroticks the Minislot action point is offset from the beginning of a Minislot [Macroticks].
        integer GdMinislot: 2..63, set at post-build in variant post-build / pre-compile in variant pre-compile  # Duration of a minislot [Macroticks]
        integer GdNit: 2..767, set at post-build in variant post-build / pre-compile in variant pre-compile  # Duration of the Network Idle Time [Macroticks]
        enumeration GdSampleClockPeriod: {T12_5NS, T25NS, T50NS}, set at post-build in variant post-build / pre-compile in variant pre-compile  # Sample clock period
        integer GdStaticSlot: 4..659, set at post-build in variant post-build / pre-compile in variant pre-compile  # Duration of a Static Slot [Macroticks].
        integer GdSymbolWindow: 0..139, set at post-build in variant post-build / pre-compile in variant pre-compile  # Duration of the symbol window [Macroticks].
        integer GdTssTransmitter: 3..15, set at post-build in variant post-build / pre-compile in variant pre-compile  # Number of bits in the Transmission Start Sequence [gdBits].
        integer GdWakeupSymbolRxIdle: 14..59, set at post-build in variant post-build / pre-compile in variant pre-compile  # Number of bits used by the node to test the duration of the 'idle' portion of a received wakeup symbol. Duration is equal to (gdWakeupSymbolTxIdle - gdWakeupSymbolTxLow)/2 minus a safe part. (Collisions, clock differences, and other effects can deform the Tx-wakeup pattern.) [gdBit].
        integer GdWakeupSymbolRxLow: 10..55, set at post-build in variant post-build / pre-compile in variant pre-compile  # Number of bits used by the node to test the LOW portion of a received wakeup symbol. This lower limit of zero bits has to be received to detect the LOW portion by the receiver. The duration is equal to gdWakeupSymbolTxLow minus a safe part. (Active stars, clock differences, and other effects can deform the Tx-wakeup pattern.) [gdBits].
        integer GdWakeupSymbolRxWindow: 76..301, set at post-build in variant post-build / pre-compile in variant pre-compile  # The size of the window used to detect wakeups. Detection of a wakeup requires a low and idle period (from one WUS) and a low period (from another WUS) to be detected entirely within a window of this size. The duration is equal to gdWakeupSymbolTxIdle + 2 * gdWakeupSymbolTxLow plus a safe part. (Clock differences and other effects can deform the Tx-wakeup pattern.) [gdBit].
        integer GdWakeupSymbolTxIdle: 45..180, set at post-build in variant post-build / pre-compile in variant pre-compile  # Number of bits used by the node to transmit the 'idle' part of a wakeup symbol. The duration is equal to cdWakeupSymbolTxIdle [gdBit].
        integer GdWakeupSymbolTxLow: 15..60, set at post-build in variant post-build / pre-compile in variant pre-compile  # Number of bits used by the node to transmit the LOW part of a wakeup symbol. The duration is equal to cdWakeupSymbolTxLow [gdBit].
        container FrIfController [1..*]  # This container contains the configuration of FlexRay CC.
          integer FrIfCtrlIdx: 0.., set at post-build in variant post-build / pre-compile in variant pre-compile, symbolic-name-value=true  # This parameter provides a zero-based consecutive index of the FlexRay Communication Controllers. Upper layer BSW modules and the FrIf itself use this index to identify a FlexRay CC.
          symbolic name reference FrIfFrCtrlRef: destination=FrController  # Reference to a Controller, which is handled by a specific Driver. This reference is unique for the ECU.
          container FrIfAbsTimer [1..*]  # This container contains the configuration of an absolute timer of a FlexRay CC.
            integer FrIfAbsTimerIdx: 0.., set at post-build in variant post-build / pre-compile in variant pre-compile, symbolic-name-value=true  # This parameter provides a zero-based consecutive index of the absolute timers. Upper layer BSW modules use this index to identify an absolute timer.
            symbolic name reference FrIfFrAbsTimerRef: destination=FrAbsoluteTimer  # Reference to an absolute timer, which is handled by a specific FlexRay Driver. This reference is unique for the ECU, therefore, an explicit reference to the FlexRay Driver is not necessary.
          container FrIfFrameTriggering [1..*]  # A Frame triggering contains the communication parameters of the FlexRay Frame as well as a reference to the Frame Construction Plan.
            boolean FrIfAllowDynamicLSduLength: set at post-build in variant post-build / pre-compile in variant pre-compile  # Allows L-PDU length reduction ('FrIfLSduLength' defines max. length) and indicates that the related CC buffer has to be reconfigured for the actual length and Header-CRC before transmission of the L-PDU.
            boolean FrIfAlwaysTransmit: set at post-build in variant post-build / pre-compile in variant pre-compile  # Defines wether the driver's API function Fr_TransmitTxLPdu() shall always be called for this L-PDU.
            integer FrIfBaseCycle: 0..63, set at post-build in variant post-build / pre-compile in variant pre-compile  # This parameter contains the FlexRay Base Cycle used to transmit this FlexRay Frame.
            enumeration FrIfChannel: {FRIF_CHANNEL_A, FRIF_CHANNEL_AB, FRIF_CHANNEL_B}, set at post-build in variant post-build / pre-compile in variant pre-compile  # This parameter contains the FlexRay Channel used to transmit this FlexRay Frame.
            integer FrIfCycleRepetition: 1..64, set at post-build in variant post-build / pre-compile in variant pre-compile  # This parameter contains the FlexRay Cycle Repetition used to transmit this FlexRay Frame.. possible Values: 1,2,4,8,16,32,64
            integer FrIfLSduLength: 0..254, set at post-build in variant post-build / pre-compile in variant pre-compile  # The payload length of the Frame is given here. This parameter is required for validation if configured PDUs and update information fits into the Frame at configuration time [bytes].
            boolean FrIfNoneMode: set at post-build in variant post-build / pre-compile in variant pre-compile  # Using the "None-Mode" which means that there is no API FrIf_Transmit call of the upper layer for this PDU.
            boolean FrIfPayloadPreamble: set at post-build in variant post-build / pre-compile in variant pre-compile  # Switching the Payload Preamble bit.
            integer FrIfSlotId: 1..2047, set at post-build in variant post-build / pre-compile in variant pre-compile  # This parameter contains the FlexRay Slot ID used to transmit this FlexRay Frame.
            reference FrIfFrameStructureRef: set at post-build in variant post-build / pre-compile in variant pre-compile, destination=FrIfFrameStructure  # Reference to the Construction Plan of the FlexRay Frame.
          container FrIfLPdu [1..*]  # LPdu is an abstraction of all FlexRay Frames (L-PDUs) belonging to the same Frame Triggering FrIfFrameTriggering.
            integer FrIfLPduIdx: set at post-build in variant post-build / pre-compile in variant pre-compile, symbolic-name-value=true  # This parameter identifies the L-PDU in the interaction between FlexRay Interface and FlexRay Driver.
            reference FrIfVBTriggeringRef: set at post-build in variant post-build / pre-compile in variant pre-compile, destination=FrIfFrameTriggering  # Reference to the assigned Frame triggering.
          container FrIfRelTimer [0..*]  # This container contains the configuration of a relative timer of a FlexRay CC.
            integer FrIfRelTimerIdx: 0.., set at post-build in variant post-build / pre-compile in variant pre-compile, symbolic-name-value=true  # This parameter provides a zero-based consecutive index of the relative timers. Upper layer BSW modules use this index to identify a relative timer.
            symbolic name reference FrIfFrRelTimerRef: destination=FrRelativeTimer  # Reference to a relative timer, which is handled by a specific FlexRay Driver. This reference is unique for the ECU, therefore, an explicit reference to the FlexRay Driver is not necessary.
          container FrIfTransceiver [0..2]  # Up to two FlexRay Transceivers may connect a Controller to a Cluster. This container realizes a Controller-Transceiver assignment.
            enumeration FrIfClusterChannel: {FRIF_CHANNEL_A, FRIF_CHANNEL_B}, set at post-build in variant post-build / pre-compile in variant pre-compile  # This parameter identifies to which one of the two Channels "A" or "B" of the Cluster the Transceiver is connected.
            symbolic name reference FrIfFrTrcvChannelRef: destination=FrTrcvNode  # Reference to a Transceiver Driver Channel. This reference is unique for the ECU.
        container FrIfJobList  # This container specifies a list of all FlexRay Jobs of the Cluster to be performed by FrIf_JobListExec_<ClstIdx>().
          symbolic name reference FrIfAbsTimerRef: destination=FrIfAbsTimer  # Reference to the absolute timer to be used to trigger the interrupt whose ISR contains the FrIf_JobListExec_<ClstIdx>() function.
          container FrIfJob [1..*]  # A job may contain more than one operation that are executed at a specific point in time.
            integer FrIfCycle: 0..63, set at post-build in variant post-build / pre-compile in variant pre-compile  # The FlexRay Cycle in which the communication operation will execute this job
            integer FrIfMacrotick: set at post-build in variant post-build / pre-compile in variant pre-compile  # Macrotick offset in the Cycle [Macrotick]
            container FrIfCommunicationOperation [1..*]  # A separate operation which is part of a FlexRay Job and defines what type of action is executed.
              enumeration FrIfCommunicationAction: {DECOUPLED_TRANSMISSION, PREPARE_LPDU, RECEIVE_AND_INDICATE, RECEIVE_AND_STORE, RX_INDICATION, TX_CONFIRMATION}, set at post-build in variant post-build / pre-compile in variant pre-compile  # The action to be performed in the FlexRay Operation
              integer FrIfCommunicationOperationIdx: set at post-build in variant post-build / pre-compile in variant pre-compile  # For each FlexRay Communication Job, this index spans a range of zero-based consecutive values and thus defines the order of the FlexRay Communication Operation in the respective FlexRay Communication Job.
              reference FrIfLPduIdxRef: set at post-build in variant post-build / pre-compile in variant pre-compile, destination=FrIfLPdu  # Reference to a L-PDu index
      container FrIfFrameStructure [0..*]  # The Frame structure specifies a Construction Plan how a Frame is assembled with PDUs and their respective Update-Bits.
        container FrIfPdusInFrame [1..*]  # This container holds all the information about a PDU in a FlexRay Frame.
          integer FrIfPduOffset: 0..253, set at post-build in variant post-build / pre-compile in variant pre-compile  # The value specifies the offset of the PDU within the Frame [bytes].
          integer FrIfPduUpdateBitOffset [0..1]: 0..2031, set at post-build in variant post-build / pre-compile in variant pre-compile  # This value specifies where the PDU's Update-Bit is stored in the Frame (bit location of PDU's Update-Bit in the FlexRay Frame).
          reference FrFrIfPduRef: set at post-build in variant post-build / pre-compile in variant pre-compile, destination=FrIfPdu  # This is the reference to the local definition of a PDU.
      container FrIfPdu [1..*]  # Contains PDU information. A PDU may be either a transmission PDU or a reception PDU.
        choice container FrIfPduDirection  # A PDU is either transmit or receive
          container FrIfRxPdu [0..1]  # Receive PDU
            reference FrIfPduRef: set at post-build in variant post-build / pre-compile in variant pre-compile, destination=Pdu  # Reference to the external PDU definition.
          container FrIfTxPdu [0..1]  # This container specifies transmission PDUs.
            boolean FrIfConfirm: set at post-build in variant post-build / pre-compile in variant pre-compile  # Defines whether the transmission of a PDU should be checked and confirmed to the PDU owning BSW module.
            integer FrIfCounterLimit: 1.., set at post-build in variant post-build / pre-compile in variant pre-compile  # This value states the maximum number of indication of ready PDU data to the FrIf (i.e. maximum number of invocations of FrIf_Transmit) without an intermediate transmission of the PDU.
            boolean FrIfImmediate: set at post-build in variant post-build / pre-compile in variant pre-compile  # Defines whether the the PDU is transmitted immediate or decoupled.
            integer FrIfTxPduId: 0.., set at post-build in variant post-build / pre-compile in variant pre-compile, symbolic-name-value=true  # The global PDU identifier, which has to be used by the upper layer BSW module. The identifier has to be zero based and consecutive.
            reference FrIfPduRef: set at post-build in variant post-build / pre-compile in variant pre-compile, destination=Pdu  # Reference to the external PDU definition.
    container FrIfGeneral  # This container contains the general configuration parameters of the FlexRay Interface.
      boolean FrIfDevErrorDetect: set at pre-compile  # Switches the Development Error Detection and Notification on or off true: Development Error Detection and Notification on false: Development Error Detection and Notification off
      integer FrIfNumClstSupported: 1.., set at pre-compile  # Maximum number of FlexRay Clusters that the FlexRay Interface supports.
      integer FrIfNumCtrlSupported: 1.., set at pre-compile  # Maximum number of FlexRay CCs that the FlexRay Interface supports
      boolean FrIfVersionInfoApi: set at pre-compile  # Enables/disables the existence of the FrIf_GetVersionInfo() API service true: FrIf_GetVersionInfo() API service exists false: FrIf_GetVersionInfo() API service does not exist
  module definition FrNm [0..1]: variants pre-compile/link-time/post-build  # The Flexray Nm module
    container FrNmChannelConfig: multiple-configuration-container=true  # This container contains all configuration parameters of FlexRay NM configured from the channel perspective.
      container FrNmChannelIdentifiers  # This container contains instance specific identifiers related to the respective FlexRay Channel.
        boolean FrNmDataEnabled: set at link in variant post-build+link-time / pre-compile in variant pre-compile  # Enable the separated sending of NM-Data.
        integer FrNmInstanceId: 8192..8446, set at post-build in variant post-build / link in variant link-time / pre-compile in variant pre-compile  # FlexRay NM instance identifier configured for the respective FlexRay Channel. It is used for reporting of development errors to DET. It must be unique for each NM instance within one ECU.
        integer FrNmNodeId: 0..255, set at post-build in variant post-build / link in variant link-time / pre-compile in variant pre-compile  # NM node identifier configured for the respective FlexRay Channel. It is used for identifying the respective NM node in the NM-cluster. It must be unique for each NM node within one NM cluster.
        integer FrNmPduLength: 0..8, set at link in variant post-build+link-time / pre-compile in variant pre-compile  # Length of the NM-Data PDU.
        boolean FrNmPnEnabled: set at link in variant link-time / post-build in variant post-build / pre-compile in variant pre-compile, default-value=false  # Enables or disables support of partial networking. false: Partial networking Range not supported true: Partial networking supported
        boolean FrNmPnEraCalcEnabled: set at pre-compile in variant pre-compile / link in variant link-time+post-build, origin=Vector Informatik, default-value=false  # This parameter enables/disables the Partial Networking External Cluster Calculation for this channel. RESTRICTIONS: This parameter is only valid if (FrNmPnEraCalcFeatureEnabled == true) AND (FrNmPnEnabled == true)
        symbolic name reference FrNmChannelHandle: destination=FrIfCluster  # Channel identifier configured for the respective instance of the NM. The FrNmChannelHandle shall be encoded in the FrNmRxPduId parameter which is passed to FrNm_RxIndication() function called by the FrIf.
        symbolic name reference FrNmChannelIdRef: destination=NmChannelConfig  # NM-Network identifier configured for the respective FlexRay Channel. It is used for referring to the respective NM-Network handle.
        reference FrNmPnEraRxNSduRef: set at pre-compile in variant pre-compile / link in variant link-time+post-build, origin=Vector Informatik, destination=Pdu  # Reference to a Com Rx PDU. The FrNm provides the External Cluster Request Information to this PDU if this information changes. This information is reported per channel. RESTRICTIONS: This parameter is only valid if (FrNmPnEraCalcEnabled == true)
        container FrNmRxPdu [1..*]  # This container describes the FlexRay NM RX PDU:s.
          boolean FrNmRxPduContainsData: set at post-build in variant post-build / link in variant link-time / pre-compile in variant pre-compile  # This parameted defines if the PDU contains NM Data.
          boolean FrNmRxPduContainsVote: set at post-build in variant post-build / link in variant link-time / pre-compile in variant pre-compile  # This parameted defines if the PDU contains NM Vote information.
          integer FrNmRxPduId: 0..65536, set at post-build in variant post-build / link in variant link-time / pre-compile in variant pre-compile  # PDU identifier configured for the respective FlexRay Channel. It is used for referring to the FlexRay Interface receive function. It must be consistent with the value configured in the FlexRay Interface. This ID is used for the combined reception of NM Vote and NM Data or for the reception of the NM Vote if NM Data is received in a separate PDU. ImplementationType: PduIdType
          reference FrNmRxPduRef: set at post-build in variant post-build / link in variant link-time / pre-compile in variant pre-compile, destination=Pdu  # The reference to a PDU in the global PDU structure described in the AUTOSAR ECU Configuration Specification. This reference will be used by the FrIf module to derive the PDU Id.
        container FrNmTxPdu [0..*]  # This container describes the FlexRay NM TX PDU:s.
          boolean FrNmTxPduContainsData: set at post-build in variant post-build / link in variant link-time / pre-compile in variant pre-compile  # This parameted defines if the PDU contains NM Data.
          boolean FrNmTxPduContainsVote: set at post-build in variant post-build / link in variant link-time / pre-compile in variant pre-compile  # This parameted defines if the PDU contains NM Vote information.
          reference FrNmTxPduRef: set at post-build in variant post-build / link in variant link-time / pre-compile in variant pre-compile, destination=Pdu  # The reference to a PDU in the global PDU structure described in the AUTOSAR ECU Configuration Specification. This reference is used to derive the PDU Id that is defined by the FrIf module.
        container FrNmUserDataTxPdu  # This container contains the FrNmTxUserDataPduRef and the FrNmTxUserDataPduId.
          reference FrNmTxUserDataPduRef: set at pre-compile in variant pre-compile / link in variant link-time / post-build in variant post-build, origin=Vector Informatik, destination=Pdu  # Reference to the NM user data I-PDU. This parameter is only valid if FrNmComUserDataEnabled = True.
      container FrNmChannelTiming  # This container contains instance-specific timing related to the respective FlexRay Channel.
        enumeration FrNmDataCycle: {FRNM_CYCLE_VALUE_1, FRNM_CYCLE_VALUE_16, FRNM_CYCLE_VALUE_2, FRNM_CYCLE_VALUE_32, FRNM_CYCLE_VALUE_4, FRNM_CYCLE_VALUE_64, FRNM_CYCLE_VALUE_8}, set at link in variant post-build+link-time / pre-compile in variant pre-compile  # Number of FlexRay Schedule Cycles needed to transmit the NM Data of all ECUs on the FlexRay bus
        integer FrNmMsgTimeoutTime: 0..65535, set at post-build in variant post-build / link in variant link-time / pre-compile in variant pre-compile  # Timeout of a NM-message [number of communication cycles]. It determines how long the NM shall wait with notification of transmission failure while communication errors occur on the bus.
        integer FrNmReadySleepCnt: 1..65535, set at link in variant post-build+link-time / pre-compile in variant pre-compile  # Numbers of repetitions in the ready sleep state before NM switches to bus sleep mode. On a value of "1", the NM-State Machine will leave the Ready Sleep State after one NM Repetition Cycle with no "keep awake" votes.
        integer FrNmRemoteSleepIndTime: 0..65535, set at link in variant post-build+link-time / pre-compile in variant pre-compile  # Timeout for Remote Sleep Indication. It defines the time [number of communication cycles] how long it shall take to recognize that all other nodes are ready to sleep. The value "0" denotes that no Remote Sleep Indication functionality is configured.
        float FrNmRepeatMessageTime: 0..65.535, set at link in variant post-build+link-time / pre-compile in variant pre-compile  # Timeout for Repeat Message State. Defines the time in seconds how long the NM shall stay in the Repeat Message State. The value "0" denotes that no Repeat Message State is configured, which means that Repeat Message State is transient and implies that it is left immediately after entry and consequently no startup stability is guaranteed and no node detection procedure is possible.
        enumeration FrNmRepetitionCycle: {FRNM_CYCLE_VALUE_1, FRNM_CYCLE_VALUE_16, FRNM_CYCLE_VALUE_2, FRNM_CYCLE_VALUE_32, FRNM_CYCLE_VALUE_4, FRNM_CYCLE_VALUE_64, FRNM_CYCLE_VALUE_8}, set at link in variant post-build+link-time / pre-compile in variant pre-compile  # Number of Flexray Schedule Cycles used to repeat the transmission of the Nm vote of all ECUs on the Flexray Bus.
        enumeration FrNmVotingCycle: {FRNM_CYCLE_VALUE_1, FRNM_CYCLE_VALUE_16, FRNM_CYCLE_VALUE_2, FRNM_CYCLE_VALUE_32, FRNM_CYCLE_VALUE_4, FRNM_CYCLE_VALUE_64, FRNM_CYCLE_VALUE_8}, set at link in variant post-build+link-time / pre-compile in variant pre-compile  # Number of FlexRay Schedule Cycles needed to transmit the Nm vote of all ECUs on the FlexRay Bus.
    container FrNmGlobalConfig  # This container contains all global configuration parameters for the FrNm module.
      container FrNmGlobalConstants  # This container contains module constants related to the Flexray NM functionality.
        integer FrNmNumberOfClusters: 1..255, set at link in variant post-build+link-time / pre-compile in variant pre-compile  # Number of AUTOSAR FR NM clusters allowed within one ECU.
        reference FrNmPnEiraRxNSduRef: set at pre-compile in variant pre-compile / link in variant link-time+post-build, origin=Vector Informatik, destination=Pdu  # Reference to a Com Rx PDU. The FrNm provides the External and Internal Cluster Request Information to this PDU if this information changes. This information is aggregated over all FlexRay channels. RESTRICTIONS: This parameter is only valid if (FrNmPnEiraCalcEnabled == true)
        container FrNmPnInfo [0..1]  # PN information configuration
          integer FrNmPnInfoLength: 0..7, set at link in variant link-time+post-build / pre-compile in variant pre-compile  # Specifies the length of the PN request information in the NM message.
          integer FrNmPnInfoOffset: 1..7, set at link in variant link-time+post-build / pre-compile in variant pre-compile, default-value=0  # Specifies the offset of the PN request information in the NM message.
          container FrNmPnFilterMaskByte [0..7]  # PN Filter Mask Byte Configuration
            integer FrNmPnFilterMaskByteIndex: 0..6, set at pre-compile in variant pre-compile / link in variant link-time+post-build, origin=Vector Informatik, default-value=0  # This parameter defines the index of the mask byte array which is used for the filter algorithm for relevant NM messages. RESTRICTIONS: This parameter is only valid if (FrNmPnEnabled == true)
            integer FrNmPnFilterMaskByteValue: 0..255, set at pre-compile in variant pre-compile / link in variant link-time+post-build, origin=Vector Informatik, default-value=0  # This parameter defines the value of the mask byte which is used for the filter algorithm for relevant NM messages. RESTRICTIONS: This parameter is only valid if (FrNmPnEnabled == true)
      container FrNmGlobalFeatures  # This container contains module features related to the FlexRay NM functionality.
        boolean FrNmBusSynchronizationEnabled: set at pre-compile  # Pre-processor switch for enabling the bus synchronisation.
        derived boolean FrNmControlBitVectorEnabled: set at pre-compile, calculation-formula=if (frnmnodedetectionenabled == false) then equal(false) else equal(false or true), calculation-language=INFORMAL  # Pre-processor switch for enabling control bit vector support. calculationFormula = If (FrNmNodeDetectionEnabled == False) then Equal(False) else Equal(False or True)
        boolean FrNmDualChannelPduEnable: set at pre-compile  # Pre-processor switch for enabling the support of dual channel transmission and reception of NM messages.
        boolean FrNmHwVoteEnable: set at pre-compile  # Pre-processor switch for enabling the processing of FlexRay Hardware aggregated NM-Votes.
        boolean FrNmNmDataDisabled: set at pre-compile  # Pre-processor switch for enabling the transmission of NM-Data.
        derived boolean FrNmNodeDetectionEnabled: set at pre-compile, calculation-formula=if (frnmpassivemodeenabled == false) then equal(nmnodedetectionenabled) else equal(false), calculation-language=INFORMAL  # Pre-processor switch for enabling node detection support. calculationFormula = If (FrNmPassiveModeEnabled == False) then Equal(NmNodeDetectionEnabled) else Equal(False)
        derived boolean FrNmPassiveModeEnabled: set at pre-compile, calculation-formula=equal(nmpassivemodeenabled), calculation-language=INFORMAL  # Pre-processor switch for enabling Passive Mode Configuration support. calculationFormula = Equal(NmPassiveModeEnabled)
        boolean FrNmPduRxIndicationEnabled: set at pre-compile  # Pre-processor switch for enabling PDU reception indication.
        derived boolean FrNmRemoteSleepIndicationEnabled: set at pre-compile, calculation-formula=if (frnmpassivemodeenabled == true) then equal(false) else equal(false or true), calculation-language=INFORMAL  # Pre-processor switch for enabling remote sleep indication. calculationFormula = If (FrNmPassiveModeEnabled == True) then Equal(False) else Equal(False or True)
        derived boolean FrNmRepeatMessageBitEnabled: set at pre-compile, calculation-formula=if (frnmcontrolbitvectorenabled == false) then equal(false) else equal(false or true), calculation-language=INFORMAL  # Pre-processor switch for enabling the repeat message bit support. calculationFormula = If (FrNmControlBitVectorEnabled == False) then Equal(False) else Equal(False or True)
        boolean FrNmSourceNodeIdentifierEnabled: set at pre-compile  # Pre-processor switch for enabling SourceNodeIdentifier support.
        boolean FrNmStateChangeIndicationEnabled: set at pre-compile  # Pre-processor switch for enabling state change indication.
        boolean FrNmUserDataEnabled: set at pre-compile  # Pre-processor switch for enabling user data support.
        boolean FrNmPnEiraCalcEnabled: set at pre-compile in variant pre-compile / link in variant link-time+post-build, origin=Vector Informatik, default-value=false  # This parameter enables/disables the Partial Networking External and Internal Cluster Calculation. RESTRICTIONS: This parameter is only valid if (FrNmPnEiraCalcFeatureEnabled == true) AND (FrNmPnEnabled == true) for at least one channel.
      container FrNmGlobalProperties  # This container contains module properties related to the FlexRay NM functionality.
        boolean FrNmDevErrorDetect: set at pre-compile  # Pre-processor switch for enabling development error detection
        boolean FrNmMainAcrossFrCycle: set at link in variant post-build+link-time / pre-compile in variant pre-compile  # Parameter describing if the execution of FrNm_Main function crosses the FlexRay cycle boundary or not.
        boolean FrNmVersionInfoApi: set at pre-compile  # Pre-processor switch for enabling version info API support.
      container FrNmVendorSpecific
        boolean FrNmComUserDataEnabled: set at pre-compile, origin=Vector Informatik, default-value=false  # If this feature is enabled the application can set the NM user data via the signal interface of the Com by setting signals of the corresponding NM I-PDU. The reference to this I-PDU has to be provided in FrNmTxUserDataPduRef. Note that this feature will disable the API FrNm_SetUserData. Since this is a pre-compile parameter it can only be customized in pre-compile configurations. RESTRICTIONS: Derived from NmComUserDataEnabled. If (FrNmPassiveModeEnabled == True) then (FrNmComUserDataEnabled = False)
        boolean FrNmPnFeatureEnabled: set at pre-compile, origin=Vector Informatik, default-value=false  # If this feature is enabled the application can set the NM user data via the signal interface of the Com by setting signals of the corresponding NM I-PDU. The reference to this I-PDU has to be provided in FrNmTxUserDataPduRef. Note that this feature will disable the API FrNm_SetUserData. Since this is a pre-compile parameter it can only be customized in pre-compile configurations. RESTRICTIONS: Derived from NmComUserDataEnabled. If (FrNmPassiveModeEnabled == True) then (FrNmComUserDataEnabled = False)
  module definition FrSm [0..1]: variants pre-compile/link-time/post-build
    container FrSmCluster [1..*]: multiple-configuration-container=true
      integer FrSmDurationT1: 0.., set at post-build in variant post-build / link in variant link-time / pre-compile in variant pre-compile  # The duration of timer t1 as multiples of the cycle time of the FrSm main function. A value of 0 shall imply that the timer is not used.
      integer FrSmDurationT2: 0.., set at post-build in variant post-build / link in variant link-time / pre-compile in variant pre-compile  # The duration of timer t2 as multiples of the cycle time of the FrSm main function. A value of 0 shall imply that the timer is not used.
      boolean FrSmIsColdstartEcu: set at post-build in variant post-build / link in variant link-time / pre-compile in variant pre-compile  # True: The ECU is a coldstart node for this FlexRay cluster. False: The ECU is no coldstart node for this FlexRay cluster.
      boolean FrSmIsWakeupEcu: set at post-build in variant post-build / link in variant link-time / pre-compile in variant pre-compile  # True: FrSm shall perform a wakeup for this cluster. False: FrSm shall never perform a wakeup for this FlexRay cluster.
      float FrSmMainFunctionCycleTime: set at link in variant post-build+link-time / pre-compile in variant pre-compile  # This parameter defines the cycle time of the periodic calling of FrSm main function.
      integer FrSmStartupRepetitions: 0.., set at post-build in variant post-build / link in variant link-time / pre-compile in variant pre-compile  # The number of times an ECU may repeat the startup procedure for a FlexRay cluster.
      integer FrSmWakeupRepetitions: 0.., set at post-build in variant post-build / link in variant link-time / pre-compile in variant pre-compile  # The number of times an ECU may repeat the wakeup procedure for a FlexRay cluster.
      symbolic name reference FrSmFrIfClusterRef: destination=FrIfCluster  # References the cluster configuration in the FlexRay Interface configuration. Note that the assigned controllers and transceivers are defined in the FrIf configuration and can be accessed via this reference.
      symbolic name reference FrSmNetworkHandleRef: destination=ComMChannel  # Reference to the unique handle to identify one certain FlexRay network correspond to one of the network handles of the ComM configuration.
      symbolic name reference FrSmRxIPduGroupRef: destination=ComIPduGroup  # ID of the RX-IPDU group that shall be started and stopped by the FrSm.
      symbolic name reference FrSmTxIPduGroupRef: destination=ComIPduGroup  # ID of the TX-IPDU group that shall be started and stopped by the FrSm.
    container FrSmGeneral
      boolean FrSmDevErrorDetect: set at pre-compile, default-value=false  # Enables and disables the development error detection and notification mechanism.
      boolean FrSmVersionInfoApi: set at pre-compile, default-value=false  # Enables and disables the version info API
  module definition FrTp [0..1]: variants pre-compile/post-build  # Configuration of the FrTp (FlexRay Transport Protocol) module.
    container FrTpGeneral  # This container contains the general configuration (parameters) of the FlexRay TP.
      integer FrTpChanNum: 1..32, set at pre-compile  # Preprocessor switch for defining the number of concurrent channels the module supports. Up to 32 channels shall be definable here.
      boolean FrTpDevErrorDetect: set at pre-compile  # Preprocessor switch for enabling development error detection.
      boolean FrTpHaveAckRt: set at pre-compile  # Preprocessor switch for enabling the Acknowledgement and retry mechanisms.
      boolean FrTpHaveGrpSeg: set at pre-compile  # Preprocessor switch for enabling segmentation of 1:n messages.
      boolean FrTpHaveLm: set at pre-compile  # Preprocessor switch for enabling the mechanism for message longer than allowed by.
      boolean FrTpHaveTc: set at pre-compile  # Preprocessor switch for enabling Transmit Cancellation.
      float FrTpMainFuncCycle: set at post-build in variant post-build / pre-compile in variant pre-compile  # This parameter contains the calling period of the TPs Main Function. The parameter is specified in seconds.
      boolean FrTpVersionInfoApi: set at pre-compile  # Preprocessor switch for enabling the Version info API.
    container FrTpMultipleConfig: multiple-configuration-container=true  # This container holds one or several multiple configuration sets.
      container FrTpChannel [1..*]  # This container contains the configuration (parameters) of one FlexRay TP channel.
        enumeration FrTpAckType: {FRTP_ACK_WITHOUT_RT, FRTP_ACK_WITH_RT, FRTP_NO}, set at post-build in variant post-build / pre-compile in variant pre-compile  # This parameter defines the type of acknowledgement which is used for the specific channel.
        enumeration FrTpAdrType: {FRTP_OB, FRTP_TB}, set at post-build in variant post-build / pre-compile in variant pre-compile  # This parameter states the addressing type this connection has. The meanings of the values are one byte and two byte.
        integer FrTpChannelId: 0.., set at post-build in variant post-build / pre-compile in variant pre-compile, symbolic-name-value=true  # The Id of the channel.
        integer FrTpConNum: set at post-build in variant post-build / pre-compile in variant pre-compile  # This parameter states the number of connections used in this channel. At least 256 shall be configurable here.
        boolean FrTpGrpSeg: set at post-build in variant post-build / pre-compile in variant pre-compile  # Here can be specified, whether segmentation within a 1:n connection is allowed or not.
        enumeration FrTpLm: {FRTP_ISO, FRTP_ISO6, FRTP_L4G}, set at post-build in variant post-build / pre-compile in variant pre-compile  # This specifies the maximum message length for the particular channel.
        integer FrTpMaxAr: 0..255, set at post-build in variant post-build / pre-compile in variant pre-compile  # This parameter defines the maximum number of trying to send a frame when a TIMEOUT AR occurs (depending on whether retry is configured).
        integer FrTpMaxAs: 0..255, set at post-build in variant post-build / pre-compile in variant pre-compile  # This parameter defines the maximum number of trying t osend a frame when a TIMEOUT AS occurs (depending on whether retry is configured)
        integer FrTpMaxBs: 1..16, set at post-build in variant post-build / pre-compile in variant pre-compile  # This parameter is only relevant when having retry activated. It limits the maximal block size the FrTp can choose in order to limit the amount of Tx buffer that will be requested at the sender side in a segmented transfer.
        integer FrTpMaxBufReq: 0..255, set at post-build in variant post-build / pre-compile in variant pre-compile  # This parameter defines the maximum number of trying to get a buffer (Transmit / Receive), depending of the return value of PduR_FrTpProvideTxBuffer / PduR_FrTpProvideRxBuffer and on whether retry is configured.
        integer FrTpMaxFrIf: 0..255, set at post-build in variant post-build / pre-compile in variant pre-compile  # This parameter defines the maximum number of trying to send a frame when the FrIf returns an error.
        integer FrTpMaxRn: 0..255, set at post-build in variant post-build / pre-compile in variant pre-compile  # This parameter defines the maximum number of retries (if retry is configured for the particular channel).
        float FrTpStMin: 0..255, set at post-build in variant post-build / pre-compile in variant pre-compile  # This parameter defines the minimum amount of time between two succeeding CFs. Specified in seconds.
        boolean FrTpTc: set at post-build in variant post-build / pre-compile in variant pre-compile  # With this switch Transmit Cancellation can be turned on or off for this channel.
        float FrTpTimeBr: set at pre-compile  # This parameter defines the time in seconds between receiving the last CF of a block or an FF-x (or SF-x) and sending out an FC or AF. It is obvious that FRTP_TIME_BR + FRTP_TIMEOUT_AR < FRTP_TIMEOUT_BS must hold (because the transmission duration on the bus has also to be considered). This parameter is defined in ISO 15765-2. It is contained in the configuration as a performance requirement.
        float FrTpTimeBuffer: 0..0.255, set at post-build in variant post-build / pre-compile in variant pre-compile  # This parameter defines the time in seconds of waiting for the next try (if retry is activated) to get a Tx or Rx buffer.
        float FrTpTimeCs: set at pre-compile  # This parameter defines the time in seconds between the sending of two consecutive CFs or between a CF and a FC (for Transmit Cancellation) or between reception of an FC or AF and sending of the next CF or a FC (for Transmit Cancellation). It is obvious that FRTP_TIME_CS + FRTP_TIMEOUT_AS < FRTP_TIMEOUT_CR must hold (because the transmission duration on the bus has also to be considered). This parameter is defined in ISO 15765-2. It is contained in the configuration as a performance requirement.
        float FrTpTimeFrIf: 0..0.255, set at post-build in variant post-build / pre-compile in variant pre-compile  # This parameter defines the time in seconds of waiting for the next try (if retry is activated) to send via FrIf_Transmit.
        float FrTpTimeoutAr: 0..65.535, set at post-build in variant post-build / pre-compile in variant pre-compile  # This parameter states the timeout in seconds between the PDU transmit request of the Transport Layer to the FlexRay Interface and the corresponding confirmation of the FlexRay Interface on the receiver side (for FC or AF).
        float FrTpTimeoutAs: 0..65.535, set at post-build in variant post-build / pre-compile in variant pre-compile  # This parameter states the timeout in seconds between the PDU transmit request for the first PDU of the group used in the current connection of the Transport Layer to the FlexRay Interface and the corresponding confirmation of the FlexRay Interface (when having sent the last PDU of the group used in this connection) on the sender side (SF-x, FF-x, CF or FC (in case of Transmit Cancellation)).
        float FrTpTimeoutBs: 0..65.535, set at post-build in variant post-build / pre-compile in variant pre-compile  # This parameter defines the timeout in seconds for waiting for an FC or AF on the sender side in a 1:1 connection.
        float FrTpTimeoutCr: 0..65.535, set at post-build in variant post-build / pre-compile in variant pre-compile  # This parameter defines the timeout value in seconds for waiting for a CF or FF-x (in case of retry) after receiving the last CF or after sending an FC or AF on the receiver side.
        boolean FrTpUsePduFc: set at post-build in variant post-build / pre-compile in variant pre-compile  # This switch defines, whether within this channel the dedicated FC/ACK PDU (FrTpPduFc) shall be used or not. If this is not used FC / ACK frames are sent using the normal IDs, otherwise only FrTpPduFc shall be used for sending / receiving FC / ACK frames.
        integer FrTpConcurrentConnections: default-value=0
        integer FrTpMaxWft: default-value=0
        container FrTpConnection [1..*]  # This container contains the configuration (parameters) of one FlexRay TP connection. A connection can only belong to one channel.
          integer FrTpLa: 0..65535, set at post-build in variant post-build / pre-compile in variant pre-compile  # This parameter defines the Local Address for the respective connection. When the local instance is the sender, this is the Source Address within the TP frame. When the local instance is the receiver, this is the Target Address within the TP frame. Note that in case of 1 byte addressing only the values from 0x0000 - 0x00FF are valid.
          boolean FrTpMultRec: set at post-build in variant post-build / pre-compile in variant pre-compile  # This parameter defines, whether this connection is an 1:1 ('false') or an 1:n ('true') connection. Of course, if the channel to which the connection is configured has retry or acknowledgement enabled, no retry or acknowledgement will occur in case the connection is an 1:n connection.
          integer FrTpRa: 0..65535, set at post-build in variant post-build / pre-compile in variant pre-compile  # This parameter defines the Remote Address for the respective connection. When the local instance is the sender, this is the Target Address within the TP frame. When the local instance is the receiver, this is the Source Address within the TP frame. Note that in case of 1 byte addressing only the values from 0x0000 - 0x00FF are valid.
          reference FrTpConPduRef [1..*]: set at post-build in variant post-build / pre-compile in variant pre-compile, destination=FrTpPdu  # Each value defines a PDU to be used for this connection. Thus each value is a PDU-ID given in FrTpPdu and this array cannot be longer than the array FrTpPdu. Please note: Only PDUs of the same size shall be used within a connection. Of course the PDU having the TxConfirmation configured has to be used by every connection.
          container FrTpRxSdu [0..1]  # Describes the Rx SDU
            reference FrTpRxSduRef: set at post-build in variant post-build / pre-compile in variant pre-compile, destination=Pdu  # Reference to a PDU in the global PDU structure.
          container FrTpTxSdu [0..1]  # Describes the Tx SDU
            integer FrTpSduTxId: set at post-build in variant post-build / pre-compile in variant pre-compile, symbolic-name-value=true  # This is a unique identifier for a received or a to be transmitted message. With this (and by means of e.g. a lookup table) the PDU Router can route the message appropriately without dealing with the particularities of the Transport Layer. This parameter can also be seen as the identifier of a connection. ImplementationType: PduIdType
            reference FrTpTxSduRef: set at post-build in variant post-build / pre-compile in variant pre-compile, destination=Pdu  # Reference to a PDU in the global PDU structure.
        container FrTpPdu [1..*]  # Container to hold the PDU parameters. ImplementationType: FrTp_PduInfoType
          enumeration FrTpPduDirection: {FRTP_RX, FRTP_TX}, set at post-build in variant post-build / pre-compile in variant pre-compile  # This parameter defines the direction of the PDU.
          integer FrTpPduId: set at post-build in variant post-build / pre-compile in variant pre-compile, symbolic-name-value=true  # This is the identifier of the FlexRay Interface PDUs (Fr N-PDU, Fr L-SDU) in which the Transport Layer Frames of this channel should be transmitted. ImplementationType: PduIdType
          reference FrTpPduRef: set at post-build in variant post-build / pre-compile in variant pre-compile, destination=Pdu
        container FrTpPduFc [0..2]  # This is the identifier of the FlexRay Interface PDUs (Fr N-PDU, Fr L-SDU) in which the Transport Layer Flow Control and Acknowledgement Frames of this channel should be transmitted. ImplementationType: FrTp_PduInfoType
          enumeration FrTpPduFcDirection: {FRTP_FC_RX, FRTP_FC_TX}, set at post-build in variant post-build / pre-compile in variant pre-compile  # This parameter defines the direction of the PDU.
          integer FrTpPduFcId: set at post-build in variant post-build / pre-compile in variant pre-compile, symbolic-name-value=true  # This is the identifier of the FlexRay Interface PDUs (Fr N-PDU, Fr L-SDU) in which the Transport Layer Flow Control and Acknowledgement Frames of this channel should be transmitted.
          reference FrTpPduFcRef: set at post-build in variant post-build / pre-compile in variant pre-compile, destination=Pdu
      container FrTpConnectionControl
        integer FrTpPduPerCycle: 0..31, origin=AUTOSAR, default-value=0
        integer FrTpSeparationCycles: 0..7, origin=Vector Informatik, default-value=0
        integer FrTpSeparationCycleExp: 0..7, origin=AUTOSAR, default-value=0
