[part 1 of 3: package /AUTOSAR]
AUTOSAR XML (schema 3.1.4)
package /AUTOSAR
  ecu parameter definition AUTOSARParameterDefinition: module=[Adc, Can, CanIf, CanNm, CanSM, CanTp, CanTrcv, Com, ComM, Crc, Dcm, Dem, Det, Dio, Ea, EcuC, EcuM, Eep, Fee, Fim, Fls, Fr, FrIf, FrNm, FrSm, FrTp, FrTrcv, Gpt, IPduMplex, Icu, IoHwAbstraction, Lin, LinIf, LinSM, LinTp, Mcu, MemIf, Nm, NvM, Os, PduR, Port, Pwm, RamTst, Rte, SchM, Spi, Wdg, WdgIf, WdgM]
  module definition Adc [0..1]: variants pre-compile/post-build  # Configuration of the Adc (Analog Digital Conversion) module.
    container AdcConfigSet: multiple-configuration-container=true  # This is the base container that contains the post-build selectable configuration parameters
      container AdcHwUnit [1..*]  # This container contains the Driver configuration (parameters) depending on grouping of channels This container could contain HW specific parameters which are not defined in the Standardized Module Definition. They must be added in the Vendor Specific Module Definition.
        integer AdcClockSource [0..1]: 0.., set at post-build in variant post-build / pre-compile in variant pre-compile  # The ADC module specific clock input for the conversion unit can statically be configured to select different clock sources if provided by hardware. ImplementationType: Adc_ClockSourceType
        integer AdcHwUnitId: set at post-build in variant post-build / pre-compile in variant pre-compile, symbolic-name-value=true  # Numeric ID of the HW Unit. This symbolic name allows accessing Hw Unit data. ImplementationType: Adc_HwUnitType
        integer AdcPrescale [0..1]: 0.., set at post-build in variant post-build / pre-compile in variant pre-compile  # Optional ADC module specific clock prescale factor, if supported by hardware. ImplementationType: Adc_PrescaleType
        container AdcChannel [1..*]  # This container contains the channel configuration (parameters) depending on the hardware capability. The organization of this data structure could contain dependencies to the microcontroller so this is left up to the implementer and its location is left up to the configuration. Note: Since a AdcChannel can be part of several AdcGroups, this container is not realized as a subcontainer of AdcGroup but instead as a subcontainer of AdcHwUnit.
          integer AdcChannelConvTime [0..1]: 0.., set at post-build in variant post-build / pre-compile in variant pre-compile  # Configuration of conversion time, i.e. the time during which the analogue value is converted into digital representation, (in clock cycles) for each channel, if supported by hardware. ImplementationType: Adc_ConversionTimeType
          integer AdcChannelId: 0.., set at post-build in variant post-build / pre-compile in variant pre-compile, symbolic-name-value=true  # Numeric ID of the channel. This parameter is the symbolic name to be used on the API. This symbolic name allows accessing Channel data. This value will be assigned to the symbolic name derived of the AdcChannel container shortName. ImplementationType: Adc_ChannelType
          integer AdcChannelRefVoltsrcHigh [0..1]: set at post-build in variant post-build / pre-compile in variant pre-compile  # Upper reference voltage source for each channel. ImplementationType: Adc_VoltageSourceType
          integer AdcChannelRefVoltsrcLow [0..1]: set at post-build in variant post-build / pre-compile in variant pre-compile  # Lower reference voltage source for each channel. ImplementationType: Adc_VoltageSourceType
          integer AdcChannelResolution [0..1]: 0.., set at post-build in variant post-build / pre-compile in variant pre-compile  # Channel resolution in bits. ImplementationType: Adc_ResolutionType
          integer AdcChannelSampTime [0..1]: 0.., set at post-build in variant post-build / pre-compile in variant pre-compile  # Configuration of sampling time, i.e. the time during which the value is sampled, (in clock cycles) for each channel, if supported by hardware. ImplementationType: Adc_SamplingTimeType
        container AdcGroup [1..*]  # This container contains the Group configuration (parameters).
          enumeration AdcGroupAccessMode: {ADC_ACCESS_MODE_SINGLE, ADC_ACCESS_MODE_STREAMING}, set at post-build in variant post-build / pre-compile in variant pre-compile  # Type of access mode to group conversion results. ImplementationType: Adc_GroupAccessModeType
          enumeration AdcGroupConversionMode: {ADC_CONV_MODE_CONTINUOUS, ADC_CONV_MODE_ONESHOT}, set at post-build in variant post-build / pre-compile in variant pre-compile  # Type of conversion mode supported by the driver. ImplementationType: Adc_GroupConvModeType
          integer AdcGroupId: 0.., set at post-build in variant post-build / pre-compile in variant pre-compile, symbolic-name-value=true  # Numeric ID of the group. This parameter is the symbolic name to be used on the API. This symbolic name allows accessing Channel Group data. This value will be assigned to the symbolic name derived of the AdcGroup container shortName. ImplementationType: Adc_GroupType
          integer AdcGroupPriority: 0..255, set at post-build in variant post-build / pre-compile in variant pre-compile  # Priority level of the AdcGroup. ImplementationType: Adc_GroupPriorityType
          enumeration AdcGroupReplacement: {ADC_GROUP_REPL_ABORT_RESTART, ADC_GROUP_REPL_SUSPEND_RESUME}, set at post-build in variant post-build / pre-compile in variant pre-compile  # Replacement mechanism, which is used on ADC group level, if a group conversion is interrupted by a group which has a higher priority. ImplementationType: Adc_GroupReplacementType
          enumeration AdcGroupTriggSrc: {ADC_TRIGG_SRC_HW, ADC_TRIGG_SRC_SW}, set at post-build in variant post-build / pre-compile in variant pre-compile  # Type of source event that starts a group conversion. ImplementationType: Adc_TriggerSourceType
          enumeration AdcHwTrigSignal: {ADC_HW_TRIG_BOTH_EDGES, ADC_HW_TRIG_FALLING_EDGE, ADC_HW_TRIG_RISING_EDGE}, set at post-build in variant post-build / pre-compile in variant pre-compile  # Configures on which edge of the hardware trigger signal the driver should react, i.e. start the conversion (only if supported by the ADC hardware). ImplementationType: Adc_HwTriggerSignalType
          integer AdcHwTrigTimer [0..1]: set at post-build in variant post-build / pre-compile in variant pre-compile  # Reload value of the ADC module embedded timer (only if supported by ADC hardware). ImplementationType: Adc_HwTriggerTimerType
          function name AdcNotification [0..1]: set at post-build in variant post-build / pre-compile in variant pre-compile  # Callback function for each group
          linker symbol def AdcResultBufferPointer: lower-multiplicity=0, upper-multiplicity=1, set at post-build in variant post-build / pre-compile in variant pre-compile  # Pointer to data buffer (destination for conversion results). One pointer for each ADC group is required. In streaming access mode the Adc_ValueGroupType buffer is made of m*n elements, where n is the number of channels belonging to the group and m the number of samples acquired per channel (i.e. ADC_STREAMING_NUM_SAMPLES). In single access mode (m=1) the Adc_ValueGroupType buffer is made of n elements, where n is the number of channels belonging to the group. User has to ensure that the AdcResultBufferPointer of the ADC groups point to the base addresses of the ADC result buffer. ImplementationType: Adc_ValueGroupType *
          enumeration AdcStreamingBufferMode: {ADC_STREAM_BUFFER_CIRCULAR, ADC_STREAM_BUFFER_LINEAR}, set at post-build in variant post-build / pre-compile in variant pre-compile  # Configure streaming buffer as "linear buffer" (i.e. the ADC Driver stops the conversion as soon as the stream buffer is full) or as "ring buffer" (wraps around if the end of the stream buffer is reached). ImplementationType: Adc_StreamBufferModeType
          integer AdcStreamingNumSamples: set at post-build in variant post-build / pre-compile in variant pre-compile, default-value=1  # Number of ADC values to be acquired per channel in streaming access mode. Note: in single access mode this parameter assumes value 1, since only one sample per channel is processed. ImplementationType: Adc_StreamNumSampleType
          reference AdcGroupDefinition [0..*]: set at post-build in variant post-build / pre-compile in variant pre-compile, destination=AdcChannel  # Assignment of AdcChannels to a AdcGroups. ImplementationType: Adc_GroupDefType
    container AdcGeneral  # General configuration (parameters) of the ADC Driver software module.
      boolean AdcDeInitApi: set at pre-compile  # Adds / removes the service Adc_DeInit() from the code. true: Adc_DeInit() can be used. false: Adc_DeInit() can not be used.
      boolean AdcDevErrorDetect: set at pre-compile  # Switches the Development Error Detection and Notification ON or OFF. true: Enabled. false: Disabled.
      boolean AdcEnableQueuing: set at pre-compile  # Determines, if the queuing mechanism is active in case of priority mechanism disabled. Note: If priority mechanism is enabled, queuing mechanism is always active and the parameter ADC_ENABLE_QUEUING is not evaluated. true: Enabled. false: Disabled.
      boolean AdcEnableStartStopGroupApi: set at pre-compile  # Adds / removes the services Adc_StartGroupConversion() and Adc_StopGroupConversion() from the code. true: Adc_StartGroupConversion() and Adc_StopGroupConversion() can be used. false: Adc_StartGroupConversion() and Adc_StopGroupConversion() can not be used.
      boolean AdcGrpNotifCapability: set at pre-compile  # Determines, if the group notification mechanism (the functions to enable and disable the notifications) is available at runtime. true: Enabled. false: Disabled.
      boolean AdcHwTriggerApi: set at pre-compile  # Adds / removes the services Adc_EnableHardwareTrigger() and Adc_DisableHardwareTrigger() from the code. true: Adc_EnableHardwareTrigger() and Adc_DisableHardwareTrigger() can be used. false: Adc_EnableHardwareTrigger() and Adc_DisableHardwareTrigger() can not be used.
      enumeration AdcPriorityImplementation: {ADC_PRIORITY_HW, ADC_PRIORITY_HW_SW, ADC_PRIORITY_NONE}, set at pre-compile  # Determines whether a priority mechanism is available for prioritization of the conversion requests and if available, the type of prioritization mechanism. The selection applies for groups with trigger source software and trigger source hardware. Two types of prioritization mechanism can be selected. The hardware prioritization mechanism (AdcPriorityHw) uses the ADC hardware features for prioritization of the software conversion requests and hardware trigger signals for groups with trigger source hardware. The mixed hardware and software prioritization mechanism (AdcPriorityHwSw) uses the ADC hardware features for prioritization of ADC hardware trigger for groups with trigger source hardware and a software implemented prioritization mechanism for groups with trigger source software. The group priorities for software triggered groups are typically configured with lower priority levels than the group priorities for hardware triggered groups. ImplementationType: Adc_PriorityImplementationType
      boolean AdcReadGroupApi: set at pre-compile  # Adds / removes the service Adc_ReadGroup() and from the code. true: Adc_ReadGroup() can be used. false: Adc_ReadGroup() can not be used.
      boolean AdcVersionInfoApi: set at pre-compile  # Adds / removes the service Adc_GetVersionInfo() from the code. true: Adc_GetVersionInfo() can be used. false: Adc_GetVersionInfor() can not be used.
    container AdcPublishedInformation  # Additional published parameters not covered by CommonPublishedInformation container. Note that these parameters do not have any configuration class setting, since they are published information.
      boolean AdcChannelValueSigned: set at published-information  # Information whether the result value of the ADC driver has sign information (true) or not (false). If the result shall be interpreted as signed value it shall apply to C-language rules.
      boolean AdcGroupFirstChannelFixed: set at published-information  # Information whether the first channel of an ADC Channel group can be configured (false) or is fixed (true) to a value determined by the ADC HW Unit.
      integer AdcMaxChannelResolution: set at published-information  # Maximum Channel resolution in bits (does not specify accuracy).
  module definition Can [0..*]: variants pre-compile/post-build  # This container holds the configuration of a single CAN Driver.
    container CanConfigSet: multiple-configuration-container=true  # This is the multiple configuration set container for CAN Driver
      container CanController [1..*]  # This container contains the configuration parameters of the CAN controller(s).
        enumeration CanBusoffProcessing: {INTERRUPT, POLLING}, set at pre-compile  # Enables / disables API Can_MainFunction_BusOff() for handling busoff events in polling mode.
        boolean CanControllerActivation: set at pre-compile  # Defines if a CAN controller is used in the configuration.
        integer CanControllerBaudRate: set at post-build in variant post-build / pre-compile in variant pre-compile  # Specifies the buadrate of the controller in kbps.
        integer CanControllerId: set at pre-compile, symbolic-name-value=true  # This parameter provides the controller ID which is unique in a given CAN Driver. The value for this parameter starts with 0 and continue without any gaps.
        integer CanControllerPropSeg: set at post-build in variant post-build / pre-compile in variant pre-compile  # Specifies propagation delay in time quantas.
        integer CanControllerSeg1: set at post-build in variant post-build / pre-compile in variant pre-compile  # Specifies phase segment 1 in time quantas.
        integer CanControllerSeg2: set at post-build in variant post-build / pre-compile in variant pre-compile  # Specifies phase segment 2 in time quantas.
        float CanControllerTimeQuanta: set at post-build in variant post-build / pre-compile in variant pre-compile  # Specifies the time quanta for the controller. The calculation of the resulting prescaler value depending on module clocking and time quanta shall be done offline Hardware specific.
        enumeration CanRxProcessing: {INTERRUPT, POLLING}, set at pre-compile  # Enables / disables API Can_MainFunction_Read() for handling PDU reception events in polling mode.
        enumeration CanTxProcessing: {INTERRUPT, POLLING}, set at pre-compile  # Enables / disables API Can_MainFunction_Write() for handling PDU transmission events in polling mode.
        enumeration CanWakeupProcessing: {INTERRUPT, POLLING}, set at pre-compile  # Enables / disables API Can_MainFunction_Wakeup() for handling wakeup events in polling mode.
        reference CanCpuClockRef: set at pre-compile, destination=McuClockReferencePoint  # Reference to the CPU clock configuration, which is set in the MCU driver configuration
        symbolic name reference CanWakeupSourceRef [0..1]: destination=EcuMWakeupSource  # This parameter contains a reference to the Wakeup Source for this controller as defined in the ECU State Manager. Implementation Type: reference to EcuM_WakeupSourceType
        foreign reference CanControllerSystemRef: destination-type=CanCommunicationController
        container CanFilterMask [0..*]  # This container contains the configuration (parameters) of the CAN Filter Mask(s).
          integer CanFilterMaskValue: set at post-build in variant post-build / pre-compile in variant pre-compile  # Describes a mask for hardware-based filtering of CAN identifiers It shall be distinguished between - Standard identifier mask - Extended identifier mask.
      container CanHardwareObject [1..*]  # This container contains the configuration (parameters) of CAN Hardware Objects.
        enumeration CanHandleType: {BASIC, FULL}, set at post-build in variant post-build / pre-compile in variant pre-compile  # Specifies the type (Full-CAN or Basic-CAN) of a hardware object.
        enumeration CanIdType: {EXTENDED, MIXED, STANDARD}, set at post-build in variant post-build / pre-compile in variant pre-compile  # Specifies whether the IdValue is of type - standard identifier - extended identifier - mixed mode ImplementationType: Can_IdType
        integer CanIdValue: set at post-build in variant post-build / pre-compile in variant pre-compile  # Specifies (together with the filter mask) the identifiers range that passes the hardware filter.
        integer CanObjectId: set at post-build in variant post-build / pre-compile in variant pre-compile, symbolic-name-value=true  # Holds the handle ID of HRH or HTH. The value of this parameter is unique in a given CAN Driver, and it should start with 0 and continue without any gaps. The HRH and HTH Ids are defined under two different name-spaces. Example: HRH0-0, HRH1-1, HTH0-2, HTH1-3
        enumeration CanObjectType: {RECEIVE, TRANSMIT}, set at post-build in variant post-build / pre-compile in variant pre-compile  # Specifies if the HardwareObject is used as Transmit or as Receive object
        reference CanControllerRef: set at post-build in variant post-build / pre-compile in variant pre-compile, destination=CanController  # Reference to CAN Controller to which the HOH is associated to.
        reference CanFilterMaskRef: set at post-build in variant post-build / pre-compile in variant pre-compile, destination=CanFilterMask  # Reference to the filter mask that is used for hardware filtering togerther with the CAN_ID_VALUE
    container CanGeneral  # This container contains the parameters related each CAN Driver Unit.
      boolean CanDevErrorDetection: set at pre-compile  # Switches the Development Error Detection and Notification ON or OFF.
      boolean CanHardwareCancellation: set at pre-compile  # Specifies if hardware cancellation shall be supported.ON or OFF
      integer CanIndex: set at pre-compile  # Specifies the InstanceId of this module instance. If only one instance is present it shall have the Id 0.
      float CanMainFunctionBusoffPeriod: set at pre-compile  # This parameter describes the period for cyclic call to Can_MainFunction_Busoff. Unit is seconds.
      float CanMainFunctionReadPeriod: set at pre-compile  # This parameter describes the period for cyclic call to Can_MainFunction_Read. Unit is seconds.
      float CanMainFunctionWakeupPeriod: set at pre-compile  # This parameter describes the period for cyclic call to Can_MainFunction_Wakeup. Unit is seconds.
      float CanMainFunctionWritePeriod: set at pre-compile  # This parameter describes the period for cyclic call to Can_MainFunction_Write. Unit is seconds.
      boolean CanMultiplexedTransmission: set at pre-compile  # Specifies if multiplexed transmission shall be supported.ON or OFF
      integer CanTimeoutDurationFactor: set at pre-compile  # Specifies the maximum number of loops for blocking function until a timeout is raised in short term wait loops.
      boolean CanVersionInfoApi: set at pre-compile  # Switches the Can_GetVersionInfo() API ON or OFF.
      boolean CanWakeupSupport: set at pre-compile  # CAN driver support for wakeup over CAN Bus.
  module definition CanIf [0..1]: variants pre-compile/link-time/post-build  # This container includes all necessary configuration sub-containers according the CAN Interface configuration structure.
    container CanIfControllerConfig [1..*]  # This container contains the configuration (parameters) of all addressed CAN controllers by each underlying CAN driver.
      enumeration CanIfWakeupSupport: {CONTROLLER, NO_WAKEUP, TRANSCEIVER}, set at link in variant post-build+link-time / pre-compile in variant pre-compile  # Enables wakeup support and defines the source device of a wakeup event.
      reference CanIfDriverNameRef: set at link in variant post-build+link-time / pre-compile in variant pre-compile, destination=CanIfDriverConfig  # Refers to the CAN Driver Name to which the controller belongs to. This parameter refers to CanIfDriverConfig container.
      reference CanIfInitControllerRef: set at link in variant post-build+link-time / pre-compile in variant pre-compile, destination=CanIfInitControllerConfig  # Reference to the Init Controller Configuration.
      symbolic name reference CanIfControllerIdRef [0..*]: destination=CanController  # Logical handle of the underlying CAN controller to be served by the CAN Interface. Range: 0..max. number of underlying supported
    container CanIfDispatchConfig [0..1]  # Callout functions with respect to the upper layers. This callout functions defined in this container are common to all configured underlying CAN Drivers / CAN Transceiver Drivers.
      function name CanIfBusOffNotification: set at link in variant post-build+link-time / pre-compile in variant pre-compile  # Name of target BusOff notification services to target upper layers (PduRouter, CanNm, CanTp and ComplexDeviceDrivers).
      function name CanIfWakeupNotification [0..1]: set at link in variant post-build+link-time / pre-compile in variant pre-compile  # Name of target wakeup notification services to target upper layers (PduRouter, CanNm, CanTp and ComplexDeviceDrivers). If parameter is 0 no call-out function is configured.
      function name CanIfWakeupValidNotification [0..1]: set at link in variant post-build+link-time / pre-compile in variant pre-compile  # Name of target wakeup validation notification services to target upper layers (ECU State Manager). If parameter is 0 no call-out function is configured.
    container CanIfDriverConfig [1..*]  # Configuration parameters for all the underlying CAN drivers are aggregated under this container.
      boolean CanIfBusoffNotification: set at link in variant post-build+link-time / pre-compile in variant pre-compile, default-value=true  # Selects whether BusOff indication notification is supported. True: Enabled False: Disabled
      boolean CanIfReceiveIndication: set at link in variant post-build+link-time / pre-compile in variant pre-compile  # Selects whether receive indication notification is supported. True: Enabled False: Disabled
      boolean CanIfTransmitCancellation: set at pre-compile  # Selects whether transmit cancellation is supported. True: Enabled False: Disabled
      boolean CanIfTxConfirmation: set at link in variant post-build+link-time / pre-compile in variant pre-compile  # Selects whether transmit confirmation notification is supported.
      boolean CanIfWakeupNotification: set at link in variant post-build+link-time / pre-compile in variant pre-compile, default-value=true  # Selects whether wakeup indication notification is supported. True: Enabled False: Disabled
      reference CanIfDriverNameRef: set at pre-compile, destination=CanGeneral  # CAN Interface Driver Reference. This reference can be used to get any information (Ex. Driver Name, Vendor ID) from the CAN driver. The CAN Driver name can be derived from the ShortName of the CAN driver module.
      reference CanIfInitHohConfigRef: set at link in variant post-build+link-time / pre-compile in variant pre-compile, destination=CanIfInitHohConfig  # Reference to the Init Hoh Configuration
    container CanIfInitConfiguration [1..*]: multiple-configuration-container=true  # This container contains the init parameters of the CAN Interface.
      string CanIfConfigSet: set at post-build in variant post-build / link in variant link-time / pre-compile in variant pre-compile  # Selects the CAN Interface specific configuration setup. This type of the external data structure shall contain the post build initialization data for the CAN Interface for all underlying CAN Dirvers. constant to CanIf_ConfigType
      integer CanIfNumberOfCanRxPduIds: set at post-build in variant post-build / link in variant link-time / pre-compile in variant pre-compile  # Total number of CanRxPduIds to be handled. Range: 0..max number of defined CanRxPduIds
      integer CanIfNumberOfCanTXPduIds: set at post-build in variant post-build / link in variant link-time / pre-compile in variant pre-compile  # Total number of CanTxPduIds to be handled. Range: 0..max number of defined CanTxPduIds
      integer CanIfNumberOfDynamicCanTXPduIds: set at post-build in variant post-build / link in variant link-time / pre-compile in variant pre-compile  # Total number of dynamic CanTxPduIds to be handled. Range: 0..max. nember of defined CanTxPduIds
      container CanIfInitControllerConfig [0..*]  # This container contains the references to the configuration setup of each underlying CAN driver.
        symbolic name reference CanIfControllerRefConfigSet: destination=CanController  # References the corresponding CAN Controller configuration setup of the corresponding CAN Driver.
      container CanIfInitHohConfig [0..*]  # This container contains the references to the configuration setup of each underlying CAN Driver.
        reference CanIfRefConfigSet: set at post-build in variant post-build / link in variant link-time / pre-compile in variant pre-compile, destination=CanConfigSet  # Selects the CAN Interface specific configuration setup. This type of external data structure shall contain the post build initialization data for the CAN Interface for all underlying CAN Drivers.
        container CanIfHrhConfig [0..*]  # This container contains configuration parameters for each hardware receive object (HRH).
          enumeration CanIfHrhType: {BASIC_CAN, FULL_CAN}, set at link in variant post-build+link-time / pre-compile in variant pre-compile  # Defines the HRH type i.e, whether its a BasicCan or FullCan. If BasicCan is configured, software filtering is enabled.
          boolean CanIfSoftwareFilterHrh: set at link in variant post-build+link-time / pre-compile in variant pre-compile, default-value=true  # Selects the hardware receive objects by using the HRH range/list from CAN Driver configuration to define, for which HRH a software filtering has to be performed at during receive processing. True: Software filtering is enabled False: Software filtering is enabled
          reference CanIfCanControllerHrhIdRef: set at link in variant post-build+link-time / pre-compile in variant pre-compile, destination=CanIfControllerConfig  # Reference to controller Id to which the HRH belongs to. A controller can contain one or more HRHs.
          symbolic name reference CanIfHrhIdSymRef: destination=CanHardwareObject  # The parameter refers to a particular HRH object in the CAN Driver Module configuration. The HRH id is unique in a given CAN Driver. The HRH Ids are defined in the CAN Driver Module and hence it is derived from CAN Driver Configuration.
          container CanIfHrhRangeConfig [0..*]  # Defines the parameters required for configuraing multiple CANID ranges for a given same HRH.
            integer CanIfRxPduLowerCanId [0..1]: 0..8589934591, set at post-build in variant post-build / link in variant link-time / pre-compile in variant pre-compile  # Lower CAN Identifier of a receive CAN L-PDU for identifier range definition, in which all CAN Ids shall pass the software filtering.
            enumeration CanIfRxPduRangeCanIdType: {EXTENDED, STANDARD}, set at post-build in variant post-build / link in variant link-time / pre-compile in variant pre-compile  # Specifies whether a configured Range of CAN Ids shall only consider standard CAN Ids or extended CAN Ids.
            integer CanIfRxPduUpperCanId: 0..8589934591, set at post-build in variant post-build / link in variant link-time / pre-compile in variant pre-compile  # Upper CAN Identifier of a receive CAN L-PDU for identifier range definition, in which all CAN Ids shall pass the software filtering.
        container CanIfHthConfig [0..*]  # This container contains parameters related to each HTH.
          enumeration CanIfHthType: {BASIC_CAN, FULL_CAN}, set at link in variant post-build+link-time / pre-compile in variant pre-compile  # Transmission method of the corresponding HTH.
          reference CanIfCanControllerIdRef: set at link in variant post-build+link-time / pre-compile in variant pre-compile, destination=CanIfControllerConfig  # Reference to controller Id to which the HTH belongs to. A controller can contain one or more HTHs.
          symbolic name reference CanIfHthIdSymRef: destination=CanHardwareObject  # The parameter refers to a particular HTH object in the CAN Driver Module configuration. The HTH id is unique in a given CAN Driver. The HTH Ids are defined in the CAN Driver Module and hence it is derived from CAN Driver Configuration.
      container CanIfRxPduConfig [0..*]  # This container contains the configuration (parameters) of each receive CAN L-PDU. The SHORT-NAME of "CanIfRxPduConfig" container itself represents the symolic name of Receive L-PDU.
        integer CanIfCanRxPduCanId: set at post-build in variant post-build / link in variant link-time / pre-compile in variant pre-compile  # CAN Identifier of Receive CAN L-PDUs used by the CAN Interface. Exa: Software Filtering. Range: 11 Bit For Standard CAN Identifier ... 29 Bit For Extended CAN identifier
        integer CanIfCanRxPduDlc: 0..8, set at post-build in variant post-build / link in variant link-time / pre-compile in variant pre-compile  # Data Length code of received CAN L-PDUs used by the CAN Interface. Exa: DLC check. The data area size of a CAN L-PDU can have a range from 0 to 8 bytes.
        integer CanIfCanRxPduId: set at post-build in variant post-build / link in variant link-time / pre-compile in variant pre-compile, symbolic-name-value=true  # ECU wide unique, symbolic handle for receive CAN L-PDU. The CanRxPduId is configurable at pre-compile and post-built time. It shall fulfill ANSI/AUTOSAR definitions for constant defines. Range: 0..max. number of defined CanRxPduIds
        boolean CanIfReadRxPduData: set at post-build in variant post-build / link in variant link-time / pre-compile in variant pre-compile, default-value=false  # Enables and disables the Rx buffering for reading of received L-PDU data. True: Enabled False: Disabled
        boolean CanIfReadRxPduNotifyStatus: set at post-build in variant post-build / link in variant link-time / pre-compile in variant pre-compile, default-value=false  # Enables and disables receive indication for each receive CAN L-PDU for reading its' notification status. True: Enabled False: Disabled
        enumeration CanIfRxPduIdCanIdType: {EXTENDED_CAN, STANDARD_CAN}, set at post-build in variant post-build / link in variant link-time / pre-compile in variant pre-compile  # CAN Identtifier of receive CAN L-PDUs used by the CAN Driver for CAN L-PDU reception.
        enumeration CanIfRxUserType: {CAN_NM, CAN_TP, PDUR, APPL}, set at post-build in variant post-build / link in variant link-time / pre-compile in variant pre-compile  # This parameter defines the type of the receive indication call-outs called to the corresponding upper layer the used TargetRxPduId belongs to.
        function name CanIfUserRxIndication: set at link in variant post-build+link-time / pre-compile in variant pre-compile  # Name of target indication services to target upper layers (PduRouter, CanNm, CanTp and ComplexDeviceDrivers). If parameter is 0 no call-out function is configured.
        boolean CanIf_DlcCheck
        reference CanIfCanRxPduHrhRef [0..*]: set at post-build in variant post-build / link in variant link-time / pre-compile in variant pre-compile, destination=CanIfHrhConfig  # The HRH to which Rx L-PDU belongs to, is referred through this parameter.
        reference PduIdRef: set at pre-compile, destination=Pdu  # Reference to the "global" Pdu structure to allow harmonization of handle IDs in the COM-Stack.
      container CanIfTxPduConfig [0..*]  # This container contains the configuration (parameters) of each transmit CAN L-PDU. The SHORT-NAME of "CanIfTxPduConfig" container represents the symolic name of Transmit L-PDU.
        integer CanIfCanTxPduId: set at post-build in variant post-build / link in variant link-time / pre-compile in variant pre-compile, symbolic-name-value=true  # ECU wide unique, symbolic handle for transmit CAN L-PDU. The CanIfCanTxPduId is configurable at pre-compile and post-built time. Range: 0..max. number of CantTxPduIds
        integer CanIfCanTxPduIdCanId: set at post-build in variant post-build / link in variant link-time / pre-compile in variant pre-compile  # CAN Identifier of transmit CAN L-PDUs used by the CAN Driver for CAN L-PDU transmission. Range: 11 Bit For Standard CAN Identifier ... 29 Bit For Extended CAN identifier
        integer CanIfCanTxPduIdDlc: 0..8, set at post-build in variant post-build / link in variant link-time / pre-compile in variant pre-compile  # Data length code (in bytes) of transmit CAN L-PDUs used by the CAN Driver for CAN L-PDU transmission. The data area size of a CAN L-Pdu can have a range from 0 to 8 bytes.
        enumeration CanIfCanTxPduType: {DYNAMIC, STATIC}, set at post-build in variant post-build / link in variant link-time / pre-compile in variant pre-compile  # Defines the type of each transmit CAN L-PDU.
        boolean CanIfReadTxPduNotifyStatus: set at post-build in variant post-build / link in variant link-time / pre-compile in variant pre-compile, default-value=false  # Enables and disables transmit confirmation for each transmit CAN L-PDU for reading its notification status. True: Enabled False: Disabled
        enumeration CanIfTxPduIdCanIdType: {EXTENDED_CAN, STANDARD_CAN}, set at post-build in variant post-build / link in variant link-time / pre-compile in variant pre-compile  # CAN Identifier of transmit CAN L-PDUs used by the CAN Driver for CAN L-PDU transmission.
        enumeration CanIfTxUserType: {CAN_NM, CAN_TP, PDUR, APPL}, set at post-build in variant post-build / link in variant link-time / pre-compile in variant pre-compile  # This parameter defines the type of the transmit confirmation call-out called to the corresponding upper layer the used TargetTxPduId belongs to.
        function name CanIfUserTxConfirmation [0..1]: set at link in variant post-build+link-time / pre-compile in variant pre-compile  # Name of target confirmation services to target upper layers (PduR, CanNm and CanTp. If parameter is not configured then no call-out function is provided by the upper layer for this Tx L-PDU.
        reference CanIfCanTxPduHthRef [0..*]: set at post-build in variant post-build / link in variant link-time / pre-compile in variant pre-compile, destination=CanIfHthConfig  # Handle, that defines the hardware object or the pool of hardware objects configured for transmission. The parameter refers HTH Id, to which the L-PDU belongs to.
        reference PduIdRef: set at pre-compile, destination=Pdu  # Reference to the "global" Pdu structure to allow harmonization of handle IDs in the COM-Stack.
    container CanIfPrivateConfiguration  # This container contains the private configuration (parameters) of the CAN Interface.
      boolean CanIfDlcCheck: set at pre-compile, default-value=true  # Selects whether the DLC check is supported. True: Enabled False: Disabled
      integer CanIfNumberOfTxBuffers: set at pre-compile  # Defined the number of L-PDU elements for the transmit buffering. The Tx L-PDU buffers shall be used to store an L-PDU once for each different L-PDU handle. Range: 0..max. number of Tx L-PDUs to be used. Default Value: NUMBER_OF_TX_PDUS
      enumeration CanIfSoftwareFilterType: {BINARY, INDEX, LINEAR, TABLE}, set at pre-compile  # Selects the desired software filter mechanism for reception only. Each implemented software filtering method is identified by this enumeration number. Range: Types implemented software filtering methods
      boolean CanIf_TransmitCancellationAPI: origin=Vector Informatik
    container CanIfPublicConfiguration  # This container contains the public configuration (parameters) of the CAN Interface.
      boolean CanIfDevErrorDetect: set at pre-compile, default-value=true  # Enables and disables the development error detection and notification mechanism. True: Enabled False: Disabled
      boolean CanIfMultipleDriverSupport: set at pre-compile, default-value=true  # Selects support for multiple CAN Drivers. True: Enabled False: Disabled
      integer CanIfNumberOfCanHwUnits: set at link in variant post-build+link-time / pre-compile in variant pre-compile, default-value=1  # Number of served CAN hardware units. Range: 1..max. number of underlying supported CAN Hardware units
      boolean CanIfReadRxPduDataApi: set at pre-compile, default-value=false  # Enables / Disables the API CanIf_ReadRxPduData() for reading received L-PDU data. True: Enabled False: Disabled
      boolean CanIfReadRxPduNotifyStatusApi: set at pre-compile, default-value=false  # Enables and disables the API for reading the received L-PDU data. True: Enabled False: Disabled
      boolean CanIfReadTxPduNotifyStatusApi: set at pre-compile, default-value=false  # Enables and disables the API for reading the notification status of transmit and receive L-PDUs. True: Enabled False: Disabled
      boolean CanIfSetDynamicTxIdApi: set at pre-compile, default-value=false  # Enables and disables the API for reconfiguration of the CAN Identifier for each Transmit L-PDU. True: Enabled False: Disabled
      boolean CanIfVersionInfoApi: set at pre-compile, default-value=true  # Enables and disables the API for reading the version information about the CAN Interface. True: Enabled False: Disabled
      boolean CanIfPublicPnSupport: set at pre-compile  # Selects support of Partial Networking features in CanIf. True: Enabled False: Disabled
    container CanIfTransceiverDrvConfig [1..*]  # This container contains the configuration (parameters) of all addressed CAN transceivers by each underlying CAN Transceiver Driver.
      boolean CanIfTrcvWakeupNotification: set at link in variant post-build+link-time / pre-compile in variant pre-compile, default-value=false  # Selects whether wakeup indication notification is supported. True: Enabled False: Disabled
      symbolic name reference CanIfTrcvIdRef [0..*]: destination=CanTrcv/CanTrcvChannel  # Logical handle of the underlying CAN transceiver to be served by the CAN Interface.
  module definition CanNm [0..1]: variants pre-compile/link-time/post-build  # Configuration Parameters for the Can Nm module.
    container CanNmGlobalConfig: multiple-configuration-container=true  # This container contains the global configuration parameter of the CanNm. The parameters and the parameters of the sub containers shall be mapped to the C data type CanNm_ConfigType (for parameters where it is possible) which is passed to the CanNm_Init function. This container is a MultipleConfigurationContainer (only for variant 3), i.e. this container and its sub-containers exit once per configuration set.
      boolean CanNmBusLoadReductionEnabled: set at pre-compile  # Pre-processor switch for enabling busload reduction support.
      derived boolean CanNmBusSynchronizationEnabled: set at pre-compile, calculation-formula=if (cannmpassivemodeenabled == false) then equal(nmbussynchronizationenabled) else equal(false), calculation-language=INFORMAL  # Pre-processor switch for enabling bus synchronization support. This feature is required for gateway nodes only. calculationFormula = If (CanNmPassiveModeEnabled == False) then Equal(NmBusSynchronizationEnabled) else Equal(False)
      derived boolean CanNmComControlEnabled: set at pre-compile, calculation-formula=equal(nmcomcontrolenabled), calculation-language=INFORMAL  # Pre-processor switch for enabling the Communication Control support. calculationformula = Equal(NmComControlEnabled)
      integer CanNmConfigPtr: set at post-build in variant post-build / link in variant link-time / pre-compile in variant pre-compile  # Pointer to configuration of CanNm.
      boolean CanNmDevErrorDetect: set at pre-compile  # Pre-processor switch for enabling development error detection support.
      boolean CanNmImmediateRestartEnabled: set at pre-compile  # Pre-processor switch for enabling the asynchronous transmission of a NM PDU upon bus-communication request in Prepare-Bus-Sleep mode.
      boolean CanNmImmediateTxconfEnabled: set at pre-compile  # Enable/disable the immediate tx confirmation.
      derived boolean CanNmNodeDetectionEnabled: set at pre-compile, calculation-formula=if(cannmnodeidenabled == true) then equal(nmnodedetectionenabled) else equal(false), calculation-language=INFORMAL  # Pre-processor switch for enabling the node detection support. calculationFormula = If(CanNmNodeIdEnabled == True) then Equal(NmNodeDetectionEnabled) else Equal(False)
      derived boolean CanNmNodeIdEnabled: set at pre-compile, calculation-formula=equal(nmnodeidenabled), calculation-language=INFORMAL  # Pre-processor switch for enabling the source node identifier. calculationFormula = Equal(NmNodeIdEnabled)
      integer CanNmNumberOfChannels: 1..255, set at pre-compile  # Number of Can NM channels allowed within one ECU.
      derived boolean CanNmPassiveModeEnabled: set at pre-compile, calculation-formula=equal(nmpassivemodeenabled), calculation-language=INFORMAL  # Pre-processor switch for enabling support of the Passive Mode. calculationFormula = Equal(NmPassiveModeEnabled)
      derived boolean CanNmPduRxIndicationEnabled: set at pre-compile, calculation-formula=equal(nmpdurxindicationenabled), calculation-language=INFORMAL  # Pre-processor switch for enabling the PDU Rx Indication. calculationFormula = Equal(NmPduRxIndicationEnabled)
      derived boolean CanNmRemoteSleepIndEnabled: set at pre-compile, calculation-formula=if (cannmpassivemodeenabled == false) then equal(nmremotesleepindenabled) else equal(false), calculation-language=INFORMAL  # Pre-processor switch for enabling remote sleep indication support. This feature is required for gateway nodes only. calculationFormula = If (CanNmPassiveModeEnabled == False) then Equal(NmRemoteSleepIndEnabled) else Equal(False)
      derived boolean CanNmRepeatMsgIndEnabled: set at pre-compile, calculation-formula=equal(nmrepeatmsgindenabled), calculation-language=INFORMAL  # Enable/disable the notification that a RepeatMessageRequest bit has been received. calculationformula = Equal(NmRepeatMsgIndEnabled)
      derived boolean CanNmStateChangeIndEnabled: set at pre-compile, calculation-formula=equal(nmstatechangeidenabled), calculation-language=INFORMAL  # Pre-processor switch for enabling the CAN NM state change notification. calculationFormula = Equal(NmStateChangeIdEnabled)
      derived boolean CanNmUserDataEnabled: set at pre-compile, calculation-formula=equal(nmuserdataenabled), calculation-language=INFORMAL  # Pre-processor switch for enabling user data support. calculationFormula = Equal(NmUserDataEnabled)
      boolean CanNmVersionInfoApi: set at pre-compile  # Pre-processor switch for enabling version info API support.
      boolean CanNmComUserDataEnabled: origin=Vector Informatik, default-value=false  # If this feature is enabled the application can set the NM user data via the signal interface of the Com by setting signals of the corresponding NM I-PDU. The reference to this I-PDU has to be provided in CanNmTxUserDataPduRef. Note that this feature will disable the API CanNm_SetUserData. Since this is a pre-compile parameter it can only be customized in pre-compile configurations. RESTRICTIONS: Derived from NmComUserDataEnabled. If (CanNmPassiveModeEnabled == True) then (CanNmComUserDataEnabled = False)
      boolean CanNmPnFeatureEnabled [0..1]: set at link in variant link-time / post-build in variant post-build / pre-compile in variant pre-compile, default-value=false  # Enables or disables support of partial networking. false: Partial networking Range not supported true: Partial networking supported
      boolean CanNmPnEiraCalcEnabled [0..1]: set at pre-compile in variant pre-compile / link in variant link-time+post-build, origin=Vector Informatik, default-value=false  # This parameter enables/disables the Partial Networking External and Internal Cluster Calculation. RESTRICTIONS: This parameter is only valid if (CanNmPnEnabled == True) for at least one channel. This parameter is only available if (CanNmPnEiraCalcFeatureEnabled == True).
      reference CanNmPnEiraRxNSduRef [0..1]: set at pre-compile in variant pre-compile / link in variant link-time+post-build, origin=Vector Informatik, destination=Pdu  # Reference to a Com Rx PDU. The CanNm provides the External and Internal Cluster Request Information to this PDU if this information changes. This information is aggregated over all CAN channels. RESTRICTIONS: This parameter is only valid if (CanNmPnEiraCalcEnabled == True). This parameter is only available if (CanNmPnEiraCalcFeatureEnabled == True).
      container CanNmChannelConfig [1..*]  # This container contains the channel specific configuration parameter of the CanNm.
        boolean CanNmBusLoadReductionActive: set at link in variant post-build+link-time / pre-compile in variant pre-compile  # This parameter defines if bus load reduction for the respective NM channel is active or not.
        boolean CanNmChannelActive: set at link in variant post-build+link-time / pre-compile in variant pre-compile  # It determines if the respective NM channel is active or not. Indicates whether a particular NM-channel shall be initialized (TRUE) or not (FALSE). If this parameter is set to FALSE the respective NM instance shall not be used during runtime.
        float CanNmMainFunctionPeriod: 0.001..0.255, set at link in variant post-build+link-time / pre-compile in variant pre-compile  # Call cycle in seconds of CanNm_MainFunction_x for the respective instance.
        float CanNmMsgCycleOffset: 0..65.535, set at link in variant post-build+link-time / pre-compile in variant pre-compile  # Time offset in the periodic transmission node. It determines the start delay of the transmission. Specified in seconds. This parameter is only valid if CanNmPassiveModeEnabled is False.
        float CanNmMsgCycleTime: 0.001..65.535, set at link in variant post-build+link-time / pre-compile in variant pre-compile  # Period of a NM-message in seconds. It determines the periodic rate in the "periodic transmission mode with bus load reduction" and is the basis for transmit scheduling in the "periodic transmission mode without bus load reduction". This parameter is only valid if CanNmPassiveModeEnabled is False.
        float CanNmMsgReducedtime: 0.001..65.535, set at link in variant link-time / pre-compile in variant pre-compile  # Node specific bus cycle time in the periodic transmission mode with bus load reduction. Specified in seconds. This parameter is only valid if CanNmBusLoadReductionEnabled == True and CanNmBusLoadReductionActive == True and CanNmPassiveModeEnabled == False Otherwise this parameter is not used.
        float CanNmMsgTimeoutTime: 1..65.535, set at link in variant post-build+link-time / pre-compile in variant pre-compile  # Transmission Timeout of NM-message. If there is no transmission confirmation by the CAN Interface within this timeout, the CANNM module shall give an error notification. This parameter is only valid if CANNM_PASSIVE_MODE_ENABLED is disabled.
        integer CanNmNodeId: 0..255, set at link in variant post-build+link-time / pre-compile in variant pre-compile  # Node identifier of local node. This parameter is only valid if CanNmPassiveModeEnabled = False and CanNmNodeDetectionEnabled = True
        enumeration CanNmPduCbvPosition: {CANNM_PDU_BYTE_0, CANNM_PDU_BYTE_1, CANNM_PDU_OFF}, set at link in variant post-build+link-time / pre-compile in variant pre-compile  # Defines the position of the control bit vector within the NM PDU. The value of the parameter represents the location of the control bit vector in the NM PDU (CanNmPduByte0 means byte 0, CanNmPduByte1 means byte 1, CanNmPduOff means source node identifier is not part of the NM PDU) if(CANNM_PDU_CBV_POSITION != CANNM_PDU_OFF && CANNM_PDU_NID_POSITION != CANNM_PDU_OFF) then CANNM_PDU_CBV_POSITION != CANNM_PDU_NID_POSITION if(CANNM_PDU_CBV_POSITION != CANNM_PDU_OFF && CANNM_PDU_NID_POSITION == CANNM_PDU_OFF) then CANNM_PDU_CBV_POSITION = CANNM_PDU_BYTE0 ImplementationType: CanNm_PduPositionType
        integer CanNmPduLength: 0..8, set at link in variant post-build+link-time / pre-compile in variant pre-compile  # Defines the length of the NM PDU.
        enumeration CanNmPduNidPosition: {CANNM_PDU_BYTE_0, CANNM_PDU_BYTE_1, CANNM_PDU_OFF}, set at link in variant post-build+link-time / pre-compile in variant pre-compile  # Defines the position of the source node identifier within the NM PDU. The value of the parameter represents the location of the source node identifier in the NM PDU (CanNMPduByte0 means byte 0, CanNmPduByte1 means byte 1, CanNmPduOff means source node identifier is not part of the NM PDU) if(CANNM_PDU_NID_POSITION != CANNM_PDU_OFF && CANNM_PDU_CBV_POSITION != CANNM_PDU_OFF) then CANNM_PDU_NID_POSITION != CANNM_PDU_CBV_POSITION if(CANNM_PDU_NID_POSITION != CANNM_PDU_OFF && CANNM_PDU_CBV_POSITION == CANNM_PDU_OFF) then CANNM_PDU_NID_POSITION = CANNM_PDU_BYTE0 ImplementationType: CanNm_PduPositionType
        float CanNmRemoteSleepIndTime: 0.001..65.535, set at link in variant post-build+link-time / pre-compile in variant pre-compile  # Timeout for Remote Sleep Indication. It defines the time in seconds how long it shall take to recognize that all other nodes are ready to sleep. Typically it should be equal to: n * CanNmMsgCycleTime, where n denotes the number of NM-Messages that are normally sent before Remote Sleep Indication is detected. The value of n decremented by one determines the amount of lost NM-Messages that can be tolerated by the Remote Sleep Indication procedure. The value 0 denotes that no Remote Sleep Indication functionality is configured.
        float CanNmRepeatMessageTime: 0..65.535, set at link in variant post-build+link-time / pre-compile in variant pre-compile  # Timeout for Repeat Message State. It defines the time in seconds how long the NM shall stay in the Repeat Message State. Typically it should be equal to: n * CanNmMsgCycleTime, where n denotes the number of NM-Messages that are normally sent in the Repeat Message State. The value of n decremented by one determines the amount of lost NM-Messages that can be tolerated by the node detection procedure. The value 0 denotes that no Repeat Message State is configured. It means that Repeat Message State is transient what implicates that it is left immediately after entrance and in result no start-up stability is guaranteed and no node detection procedure is possible.
        float CanNmTimeoutTime: 0.002..65.535, set at link in variant post-build+link-time / pre-compile in variant pre-compile  # Network Timeout for NM-Messages. It denotes the time in seconds how long the NM shall stay in the Network Mode before transition into Prepare Bus-Sleep Mode shall take place. It shall be equal for all nodes in the cluster. It shall be greater than CanNmMsgCycleTime. Typically it should be equal to: n * CanNmMsgCycleTime, where n denotes the number of NM-Message cycle times in the Ready Sleep State before transition into the Bus-Sleep Mode is initiated. The value of n decremented by one determines the amount of lost NM-Messages that can be tolerated by the coordination algorithm.
        integer CanNmUserDataLentgh: 0..8, set at link in variant post-build+link-time / pre-compile in variant pre-compile  # Defines the length of the user data contained in the NM PDU
        float CanNmWaitBusSleepTime: 0.001..65.535, set at link in variant post-build+link-time / pre-compile in variant pre-compile  # Timeout for bus calm down phase. It denotes the time in seconds how long the NM shall stay in the Prepare Bus-Sleep Mode before transition into Bus-Sleep Mode shall take place. It shall be equal for all nodes in the cluster. It shall be long enough to make all Tx-buffer empty.
        integer CanNmMessageCount: 2..256, set at pre-compile in variant pre-compile / link in variant link-time+post-build, origin=Vector Informatik, default-value=64  # 'Network Management Message Count' defines the number of network management message that are received by your network node. The identifiers of the network managment messages are within the range ['Network Management Base Address', 'Network Management Base Address' + 'Network Management Message Count' - 1]. This value must be a power of 2. Note: Since the 'Network Management Message Count' is a network parameter it is set by the database attribute 'NmAsrMessageCount'.
        integer CanNmBaseAddress: 0..536870911, set at pre-compile in variant pre-compile / link in variant link-time+post-build, origin=Vector Informatik, default-value=1024  # 'Network Management Base Address' defines the start address of the network management message range. Only network management messages within the range are received by your network node. Refer also to the parameter 'NM Message Count' (CanNmMessageCount). Note: For DBC based configurations this value can be set by the database attribute 'NmAsrBaseAddress'. In this case the value is not editable in GENy.
        boolean CanNmPnEnabled [0..1]: set at link in variant link-time / post-build in variant post-build / pre-compile in variant pre-compile, default-value=false  # Enables or disables support of partial networking. false: Partial networking Range not supported true: Partial networking supported
        boolean CanNmPnEraCalcEnabled [0..1]: set at pre-compile in variant pre-compile / link in variant link-time+post-build, origin=Vector Informatik, default-value=false  # This parameter enables/disables the PN External Cluster Calculation for this channel. RESTRICTIONS: This parameter is only valid if (CanNmPnEnabled == True) This parameter is only available if (CanNmPnEraCalcFeatureEnabled == True).
        float CanNmImmediateNmCycleTime [0..1]: 0.001..65.535, set at link in variant link-time+post-build / pre-compile in variant pre-compile  # Defines the immediate NM PDU cycle time in seconds which is used for CanNmImmediateNmTransmissions NM PDU transmissions. This parameter is only valid if CanNmImmediateNmTransmissions is greater one.
        integer CanNmImmediateNmTransmissions: 0..255, set at link in variant link-time+post-build / pre-compile in variant pre-compile  # Defines the number of immediate NM PDUs which shall be transmitted. If the value is zero no immediate NM PDUs are transmitted. The cycle time of immeditate NM PDUs is defined by CanNmImmediateNmCycleTime.
        reference CanNmNetworkHandle: set at post-build in variant post-build / link in variant link-time / pre-compile in variant pre-compile, destination=CanStateManagerNetworks  # Channel identifier configured for the respective instance of the NM. The CanNmChannelHandle shall be encoded in the canNmRxPduId parameter which is passed to CanNm_RxIndication() function called by the CanIf.
        symbolic name reference CanNmChannelIdRef: destination=NmChannelConfig  # Channel identifier configured for the respective AUTOSAR NM cluster. It is used by referring to the respective NM channel handle. It must be unique for each AUTOSAR NM cluster within one ECU.
        reference CanNmPnEraRxNSduRef [0..1]: set at pre-compile in variant pre-compile / link in variant link-time+post-build, origin=Vector Informatik, destination=Pdu  # Reference to a Com Rx PDU. The CanNm provides the External Cluster Request Information to this PDU if this information changes. This information is reported per channel. RESTRICTIONS: This parameter is only valid if (CanNmPnEraCalcEnabled == True) This parameter is only available if (CanNmPnEraCalcFeatureEnabled == True).
        container CanNmRxPdu  # This container is used to configure the Rx PDU Properties that are used for the CanNm Channel.
          integer CanNmRxPduId: 0.., set at link in variant post-build+link-time / pre-compile in variant pre-compile  # This parameter defines the Rx PDU ID of the CanIf L-PDU range that is associated with this CanNmChannel instance. ImplementationType: PduIdType
          reference CanNmRxPduRef: set at link in variant post-build+link-time / pre-compile in variant pre-compile, destination=Pdu  # Reference to the global PDU that is used by this CanNmChannel instance.
        container CanNmTxPdu  # This container contains the CanNmTxPduId and the CanNmTxPduRef.
          reference CanNmTxPduRef: set at link in variant post-build+link-time / pre-compile in variant pre-compile, destination=Pdu  # The reference to the common PDU structure.
        container CanNmUserDataTxPdu  # This container contains the CanNmTxUserDataPduRef and the CanNmTxUserDataPduId.
          reference CanNmTxUserDataPduRef: set at pre-compile in variant pre-compile / link in variant link-time / post-build in variant post-build, origin=Vector Informatik, destination=Pdu  # Reference to the NM user data I-PDU. This parameter is only valid if CanNmComUserDataEnabled = True.
      container CanNmPnInfo [0..1]  # PN information configuration
        integer CanNmPnInfoLength: 0..7, set at link in variant link-time+post-build / pre-compile in variant pre-compile  # Specifies the length of the PN request information in the NM message.
        integer CanNmPnInfoOffset: 1..7, set at link in variant link-time+post-build / pre-compile in variant pre-compile, default-value=0  # Specifies the offset of the PN request information in the NM message.
        container CanNmPnFilterMaskByte [0..7]  # Filter mask byte configuration
          integer CanNmPnFilterMaskByteIndex: 0..6, set at link in variant link-time+post-build / pre-compile in variant pre-compile  # Index of the filter mask byte. Specifies the position within the filter mask byte array.
          integer CanNmPnFilterMaskByteValue: 0..255, set at link in variant link-time+post-build / pre-compile in variant pre-compile, default-value=0  # Parameter to configure the filter mask byte.
  module definition CanSM [0..1]: variants pre-compile/link-time/post-build  # Configuration of the CanSM module
    container CanStateManagerConfiguration: multiple-configuration-container=true  # This container contains the global parameters of the CanSM and sub containers, which are for the CAN network specific configuration.
      boolean CanSMDevErrorDetect: set at pre-compile  # Enables and disables the development error detection and notification mechanism.
      boolean CanSMPartialNetwork: set at pre-compile  # Enables and disables the development error detection and notification mechanism.
      container CanStateManagerNetworks [1..*]  # This container contains the CAN network specific parameters of each CAN network
        integer CanSMBorCounterL1ToL2: 0..255, set at post-build in variant post-build / link in variant link-time / pre-compile in variant pre-compile  # This threshold defines at which bus-off-counter value the bus-off recovery state machine switches from level 1 to level 2.
        integer CanSMBorCounterL2Err: 0..255, set at post-build in variant post-build / link in variant link-time / pre-compile in variant pre-compile  # This threshold defines at which bus-off-counter value the bus-off recovery state machine shall report a failed production error state to the DEM.
        boolean CanSMBorDisableRxDlMonitoring: set at pre-compile  # If "On" the CanSM disables the deadline monitoring of RX PDU Groups during bus-off recovery to avoid timeouts (False: Off, True: On).
        float CanSMBorTimeL1: 0..65.535, set at post-build in variant post-build / link in variant link-time / pre-compile in variant pre-compile  # This time parameter defines in seconds the duration of the bus-off recovery time in level 1 (short recovery time).
        float CanSMBorTimeL2: 0..65.535, set at post-build in variant post-build / link in variant link-time / pre-compile in variant pre-compile  # This time parameter defines in seconds the duration of the bus-off recovery time in level 2 (long recovery time).
        float CanSMBorTimeTxEnsured: 0..65.535, set at post-build in variant post-build / link in variant link-time / pre-compile in variant pre-compile  # This parameter defines in seconds the duration of the bus-off event check. This check assesses, if the recovery has been successful after the recovery reenables the transmit path. If a new bus-off occurs during this time period, the CanSM assesses this bus-off as sequential bus-off without successful recovery. Because a bus-off only can be detected, when PDUs are transmitted, the time has to be great enough to ensure that PDUs are transmitted again.
        symbolic name reference CanSMNetworkHandle: destination=ComMChannel  # Unique handle to identify one certain CAN network. Reference to one of the network handles configured for the ComM.
        symbolic name reference CanSMRxPduGroupId: destination=ComIPduGroup  # ID of the RX PDU Group assigned to the configured network handle. Reference to one of the PDU group Ids of the COM configuration.
        symbolic name reference CanSMTransceiverId: destination=CanTrcv/CanTrcvChannel  # ID of the CAN transceiver assigned to the configured network handle. Reference to one of the transceivers of CanTrcv configuration.
        symbolic name reference CanSMTxPduGroupId: destination=ComIPduGroup  # ID of the TX PDU Group assigned to the configured network handle. Reference to one of the PDU group Ids of the COM configuration.
        container CanStateManagerControllers [1..*]  # This container contains the controller IDs assigned to a CAN network.
          symbolic name reference CanSMControllerId: destination=CanController  # Unique handle to identify one certain CAN controller. Reference to one of the CAN controllers of CAN driver (Can) configuration.
  module definition CanTp [0..1]: variants pre-compile/post-build  # Configuration of the CanTp (CAN Transport Protocol) module.
    container CanTpGeneral  # This container contains the general configuration parameters of the CanTp module.
      boolean CanTpDevErrorDetect: set at pre-compile  # Switches the Development Error Detection and Notification ON or OFF
      float CanTpMainFunctionPeriod: 0..0.255, set at post-build in variant post-build / pre-compile in variant pre-compile  # Allow to configure the time for the MainFunction (as float in seconds). Please note: This configuration value shall be equal to the value in the ScheduleManger module.
      boolean CanTpTc: set at pre-compile  # Preprocessor switch for enabling Transmit Cancellation.
      boolean CanTpSupportMixed11Addressing: origin=Vector Informatik, default-value=true
    container CanTpRxNSdu [0..*]  # The following parameters needs to be configured for each CAN N-SDU that the CanTp module shall receive.
      enumeration CanTpAddressingFormat: {CANTP_EXTENDED, CANTP_STANDARD, CANTP_MIXED11}, set at pre-compile in variant post-build+pre-compile+pre-compile / link in variant post-build, default-value=CANTP_STANDARD  # Declares which communication addressing mode is supported for this Rx N-SDU. Enum values: CanTpStandard. To use normal addressing format. CanTpExtended. To use extended addressing format. Defines which communication addressing mode is used for this Rx N-Sdu. Enumeration values: CANTP_STANDARD to use normal addressing format. CANTP_EXTENDED to use extended addressing format. CANTP_MIXED11 to use mixed11 addressing format.
      integer CanTpBs: set at post-build in variant post-build / pre-compile in variant pre-compile  # Sets the maximum number of N-PDUs the CanTp receiver allows the sender to send, before waiting for an authorization to continue transmission of the following N-PDUs.For further details on this parameter value see ISO 15765-2 specification. Note: For reasons of buffer length, the CAN Transport Layer can adapt the BS value within the limit of this maximum BS
      float CanTpNar: set at post-build in variant post-build / pre-compile in variant pre-compile  # Value in seconds of the N_Ar timeout. N_Ar is the time for transmission of a CAN frame (any N_PDU) on the receiver side.
      float CanTpNbr: set at post-build in variant post-build / pre-compile in variant pre-compile  # Value in seconds of the performance requirement for (N_Br + N_Ar). N_Br is the elapsed time between the receiving indication of a FF or CF or the transmit confirmation of a FC, until the transmit request of the next FC.
      float CanTpNcr: set at post-build in variant post-build / pre-compile in variant pre-compile  # Value in seconds of the N_Cr timeout. N_Cr is the time until reception of the next Consecutive Frame N_PDU.
      integer CanTpRxChannel: 0.., set at pre-compile  # Link to the Rx connection channel, which has to be used for receiving this N-PDU.
      integer CanTpRxDl: set at pre-compile  # Data Length Code of this RxNsdu. In case of variable message length, this value indicates the minimum data length. Depending on SF or FF N-SDU the value will be limited to 7 (6 for an extended addressing format) and 4095 respectively.
      enumeration CanTpRxPaddingActivation: {CANTP_OFF, CANTP_ON}, set at pre-compile  # Defines if the receive frame uses padding or not. Definition of enumeration values: CanTpOn: The N-PDU received uses padding for SF, FC and the last CF. (N-PDU length is always 8 bytes) CanTpOff: The N-PDU received does not use padding for SF, CF and the last CF. (N-PDU length is dynamic)
      enumeration CanTpRxTaType: {CANTP_FUNCTIONAL, CANTP_PHYSICAL}, set at pre-compile  # Declares the communication type of this Rx N-SDU.
      integer CanTpRxWftMax: set at post-build in variant post-build / pre-compile in variant pre-compile  # This parameter indicates how many Flow Control wait N-PDUs can be consecutively transmitted by the receiver. It is local to the node and is not transmitted inside the FC protocol data unit. CanTpRxWftMax is used to avoid sender nodes being potentially hooked-up in case of a temporarily reception inability on the part of the receiver nodes, whereby the sender could be waiting continuously.
      integer CanTpSTmin: set at post-build in variant post-build / pre-compile in variant pre-compile  # Sets the duration of the minimum time the CanTp sender shall wait between the transmissions of two CF N-PDUs. For further details on this parameter value see ISO 15765-2 specification.
      reference CanTpRxNSduRef: set at link in variant post-build / pre-compile in variant pre-compile, destination=Pdu  # Reference to a Pdu in the COM-Stack.
      container CanTpNSa [0..1]  # Contains the parameters needed to configure each RxNSdu or TxNSdu with CanTpAddressingFormat set to CanTpExtended.
        integer CanTpNSa: set at pre-compile  # If an RxNSdu ora TxNSdu is configured for extended addressing format, this parameter contains the transport protocol source address's value.
      container CanTpNTa [0..1]  # The following parameters need to be configured for each RxNsdu or TxNsdu with the CanTpAddressingFormat set to CanTpExtended.
        integer CanTpNTa: set at pre-compile  # If an RxNsdu or a TxNsdu is configured for extended addressing format, this parameter contains the transport protocol target address's value.
      container CanTpRxNPdu  # Used for grouping of the ID of a PDU and the Reference to a PDU.
        integer CanTpRxNPduId: 0.., set at pre-compile, symbolic-name-value=true  # The N-PDU identifier attached to the RxNsdu is identified by CanTpRxNSduId. Each RxNsdu identifier is linked to only one SF/FF/CF N-PDU identifier. Nevertheless, in the case of extended addressing format, the same N-PDU identifier can be used for several N-SDU identifiers. The distinction is made by the N_TA value (first data byte of SF or FF frames).
        reference CanTpRxNPduRef: set at post-build in variant post-build / pre-compile in variant pre-compile, destination=Pdu  # Reference to a Pdu in the COM-Stack.
      container CanTpTxFcNPdu [0..1]  # Used for grouping of the ID of a PDU and the Reference to a PDU.
        reference CanTpTxFcNPduRef: set at post-build in variant post-build / pre-compile in variant pre-compile, destination=Pdu  # Reference to a Pdu in the COM-Stack.
    container CanTpTxNSdu [0..*]  # The following parameters needs to be configured for each CAN N-SDU that the CanTp module shall transmitt.
      enumeration CanTpAddressingMode: {CANTP_EXTENDED, CANTP_STANDARD, CANTP_MIXED11}, set at pre-compile in variant post-build+pre-compile+pre-compile / link in variant post-build, default-value=CANTP_STANDARD  # Declares which communication addressing format is supported for this TxNsdu. Definition of Enumeration values: CanTpStandard to use normal addressing format. CanTpExtended to use extended addressing format (the N_TA container of this TxNsdu will be used). Defines which communication addressing format is used for this Tx N-Sdu. Enumeration values: CANTP_STANDARD to use normal addressing format. CANTP_EXTENDED to use extended addressing format. CANTP_MIXED11 to use mixed11 addressing format.
      float CanTpNas: set at post-build in variant post-build / pre-compile in variant pre-compile  # Value in second of the N_As timeout. N_As is the time for transmission of a CAN frame (any N_PDU) on the part of the sender.
      float CanTpNbs: set at post-build in variant post-build / pre-compile in variant pre-compile  # Value in seconds of the N_Bs timeout. N_Bs is the time of transmission until reception of the next Flow Control N_PDU.
      float CanTpNcs: set at post-build in variant post-build / pre-compile in variant pre-compile  # Value in seconds of the performance requirement of (N_Cs + N_As). N_Cs is the time which elapses between the transmit request of a CF N-PDU until the transmit request of the next CF N-PDU.
      integer CanTpTxChannel: set at pre-compile  # Link to the connection channel which has to be used for transmission of this N-PDU.
      integer CanTpTxDl: set at pre-compile  # Data Length Code of this TxNsdu. In case of variable length message, this value indicates the minimum data length.
      integer CanTpTxNSduId: 0.., set at pre-compile, symbolic-name-value=true  # Unique identifier to a structure that contains all useful information to process the transmission of a TxNsdu.
      enumeration CanTpTxPaddingActivation: {CANTP_OFF, CANTP_ON}, set at pre-compile  # Defines if the transmit frame use padding or not. Definition of Enumeration values: CanTpOn The transmit N-PDU uses padding for SF, FC and the last CF. (N-PDU length is always 8 bytes) CanTpOff The transmit N-PDU does not use padding for SF, CF and the last CF. (N-PDU length is dynamic)
      enumeration CanTpTxTaType: {CANTP_FUNCTIONAL, CANTP_PHYSICAL}, set at pre-compile  # Declares the communication type of this TxNsdu. Enumeration values: CanTpPhysical. Used for 1:1 communication. CanTpFunctional. Used for 1:n communication.
      reference CanTpTxNSduRef: set at link in variant post-build / pre-compile in variant pre-compile, destination=Pdu  # Reference to a Pdu in the COM-Stack.
      container CanTpNSa [0..1]  # Contains the parameters needed to configure each RxNSdu or TxNSdu with CanTpAddressingFormat set to CanTpExtended.
        integer CanTpNSa: set at pre-compile  # If an RxNSdu ora TxNSdu is configured for extended addressing format, this parameter contains the transport protocol source address's value.
      container CanTpNTa [0..1]  # The following parameters need to be configured for each RxNsdu or TxNsdu with the CanTpAddressingFormat set to CanTpExtended.
        integer CanTpNTa: set at pre-compile  # If an RxNsdu or a TxNsdu is configured for extended addressing format, this parameter contains the transport protocol target address's value.
      container CanTpRxFcNPdu [0..1]  # Used for grouping of the ID of a PDU and the Reference to a PDU.
        integer CanTpRxFcNPduId: 0.., set at pre-compile, symbolic-name-value=true  # N-PDU identifier attached to the FC N-PDU of this TxNsdu identified by CanTpTxNSduId. Each TxNsdu identifier is linked to one Rx FC N-PDU identifier only. However, in the case of extended addressing format, the same FC N-PDU identifier can be used for several N-SDU identifiers. The distinction is made by means of the N_TA value (first data byte of FC frames).
        reference CanTpRxFcNPduRef: set at post-build in variant post-build / pre-compile in variant pre-compile, destination=Pdu  # Reference to a Pdu in the COM-Stack.
      container CanTpTxNPdu  # Used for grouping of the ID of a PDU and the Reference to a PDU.
        reference CanTpTxNPduRef: set at post-build in variant post-build / pre-compile in variant pre-compile, destination=Pdu  # Reference to a Pdu in the COM-Stack.
    container CanTpConfigSet: multiple-configuration-container=true
      reference CanTpActiveRxNSduRef [0..*]: set at pre-compile, destination=CanTpRxNSdu  # References active rx connections in this identity
      reference CanTpActiveTxNSduRef [0..*]: set at pre-compile, destination=CanTpTxNSdu  # References active rx connections in this identity
  module definition CanTrcv [0..*]: variants pre-compile/post-build  # Configuration of the CanTrcv (CAN Transceiver driver) module.
    container CanTrcvChannel [1..*]  # Container gives CAN transceiver driver information about a single CAN transceiver channel. Any CAN transceiver driver has such CAN transceiver channels.
      integer CanTrcvChannelId: set at pre-compile, symbolic-name-value=true  # Unique identifier of the CAN Transceiver Channel.
      boolean CanTrcvChannelUsed: set at pre-compile, default-value=true  # Shall the related CAN transceiver channel be used?
      boolean CanTrcvControlsPowerSupply: set at pre-compile, default-value=false  # Is ECU power supply controlled by this transceiver? TRUE = Controlled by transceiver. FALSE = Not controlled by transceiver.
      enumeration CanTrcvInitState: {CANTRCV_OP_MODE_NORMAL, CANTRCV_OP_MODE_SLEEP, CANTRCV_OP_MODE_STANDBY}, set at pre-compile, default-value=CANTRCV_OP_MODE_NORMAL  # State of CAN transceiver after call to CanTrcv_Init.
      integer CanTrcvMaxBaudrate: 0..1000, set at pre-compile  # Max baudrate for transceiver hardware type. Only used for validation purposes. Value shall be configured by configuration tool based on transceiver hardware type.
      boolean CanTrcvWakeupByBusUsed: set at pre-compile, default-value=false  # Is wake up by bus supported? If CAN transceiver hardware does not support wake up by bus value is always FALSE. If CAN transceiver hardware supports wake up by bus value is TRUE or FALSE depending whether it is used or not. TRUE = Is used. FALSE = Is not used.
      symbolic name reference CanTrcvWakeupSourceRef: destination=EcuMWakeupSource  # Reference to a wakeup source in the EcuM configuration. This reference is only needed if CanTrcvWakeupByBusUsed is true. Implementation Type: reference to EcuM_WakeupSourceType
      choice container CanTrcvAccess [1..*]
        container CanTrcvDioAccess [0..1]  # Container gives CAN transceiver driver information about accessing ports and port pins. In addition relation between CAN transceiver hardware pin names and Dio port access information is given. If a CAN transceiver hardware has no Dio interface, there is no instance of this container.
          string CanTrcvHardwareInterfaceName: set at pre-compile  # CAN transceiver hardware interface name. It is typically the name of a pin. From a Dio point of view it is either a port, a single channel or a channel group. Depending on this fact either CANTRCV_DIO_PORT_SYMBOLIC_NAME or CANTRCV_DIO_CHANNEL_SYMBOLIC_NAME or CANTRCV_DIO_CHANNEL_GROUP_SYMBOLIC_NAME shall reference a Dio configuration. The CAN transceiver driver implementation description shall list up this name for the appropriate CAN transceiver hardware.
          choice reference CanTrcvDioSymNameRef: set at pre-compile, destination=[DioChannel, DioPort, DioChannelGroup]  # Choice Reference to a DIO Port, DIO Channel or DIO Channel Group. This reference replaces the CANTRCV_DIO_PORT_SYM_NAME, CANTRCV_DIO_CHANNEL_SYM_NAME and CANTRCV_DIO_GROUP_SYM_NAME references in the Can Trcv SWS.
        container CanTrcvSpiSequence [0..1]  # Container gives CAN transceiver driver information about one SPI sequence. One SPI sequence used by CAN transceiver driver is in exclusive use for it. No other driver is allowed to access this sequence. CAN transceiver driver may use one sequence to access n CAN transceiver hardwares chips of the same type or n sequences are used to access one single CAN transceiver hardware chip. If a CAN transceiver hardware has no SPI interface, there is no instance of this container.
          symbolic name reference CanTrcvSpiSequenceName: destination=SpiSequence  # Reference to a Spi sequence configuration container.
    container CanTrcvGeneral  # Container gives CAN transceiver driver basic information.
      boolean CanTrcvDevErrorDetect: set at pre-compile  # Switches development error detection and notification on and off. If switched on, #define CANTRCV_DEV _ERROR_DETECT ON shall be generated. If switched off, #define CANTRCV_DEV_ERROR _DETECT OFF shall be generated. Define shall be part of file CanTrcv_Cfg.h.
      boolean CanTrcvGetVersionInfo: set at pre-compile, default-value=false  # Switches version information API on and off. If switched off, function need not be present in compiled code.
      integer CanTrcvIndex: set at pre-compile  # Specifies the InstanceId of this module instance. If only one instance is present it shall have the Id 0.
      enumeration CanTrcvWakeUpSupport: {CANTRCV_WAKEUP_BY_ISR, CANTRCV_WAKEUP_NOT_SUPPORTED, CAVTRCV_WAKEUP_BY_POLLING}, set at pre-compile  # Informs whether wake up is supported by ISR, by polling or whether it is not supported. In case no wake up is supported by CAN transceiver hardware setting has to be always NO. Only in case wake up is supported by polling main function CanTrcv_main has to be present in source code and called by CanIf. Only in case wake up is supported by ISR callback function CanTrcv_CB_WakeupByBus has to be present in source code. In case of support for wake up either by ISR or by polling wake up ability may be switched on or off for each channel of one CAN transceiver channel independently by CanTrcvWakeupByBusUsed. Informs whether wake up is supported by ISR, by polling or whether it is not supported. In case no wake up is supported by CAN transceiver hardware setting has to be always NO. Only in case wake up is supported by polling main function CanTrcv_main has to be present in source code and called by CanIf.
    container CanTrcvConfigSet: multiple-configuration-container=true  # This is the multiple configuration set container for CAN Transceiver.
      integer CanTrcvSPICommRetries: 0..255, set at post-build in variant post-build / pre-compile in variant pre-compile, default-value=0  # Indicates the maximum number of communication retries in case of a failed SPI communication (applies both to timed out communication and to errors/NACK in the response data). If configured value is '0', no retry is allowed (communication is expected to succeed at first try).
      integer CanTrcvSPICommTimeout: 0..100, set at post-build in variant post-build / pre-compile in variant pre-compile, default-value=0  # Indicates the maximum time allowed to the CanTrcv for replying (either positively or negatively) to a SPI command. Timeout is configured in milliseconds. Timeout value of '0' means that no specific timeout is to be used by CanTrcv and the communication is executed at the best of the SPI HW capacity.
      container CanTrcvChannel [1..*]  # Container gives CAN transceiver driver information about a single CAN transceiver channel. Any CAN transceiver driver has such CAN transceiver channels.
        integer CanTrcvChannelId: 0..8, set at pre-compile, symbolic-name-value=true, default-value=0  # Not used. Unique identifier of the CAN Transceiver Channel.
        boolean CanTrcvChannelUsed: set at pre-compile, default-value=true  # Shall the related CAN transceiver channel be used?
        boolean CanTrcvControlsPowerSupply: set at pre-compile, default-value=false  # Is ECU power supply controlled by this transceiver? TRUE = Controlled by transceiver. FALSE = Not controlled by transceiver.
        boolean CanTrcvHwPnSupport: set at pre-compile, default-value=true  # Indicates whether the transceiver has the ability to be selectively woken up by a Wake-up Frame (WUF). TRUE = Selective wakeup functionality is available in transceiver. FALSE = Selective wakeup functionality is not available in transceiver.
        enumeration CanTrcvInitState: {CANTRCV_OP_MODE_NORMAL, CANTRCV_OP_MODE_SLEEP, CANTRCV_OP_MODE_STANDBY}, set at pre-compile, default-value=CANTRCV_OP_MODE_NORMAL  # State of CAN transceiver after call to CanTrcv_Init.
        integer CanTrcvMaxBaudrate: 0..1000, set at pre-compile  # Max baudrate for transceiver hardware type. Only used for validation purposes. Value shall be configured by configuration tool based on transceiver hardware type.
        boolean CanTrcvWakeupByBusUsed: set at pre-compile, default-value=false  # Is wake up by bus supported? If CAN transceiver hardware does not support wake up by bus value is always FALSE. If CAN transceiver hardware supports wake up by bus value is TRUE or FALSE depending whether it is used or not. TRUE = Is used. FALSE = Is not used.
        symbolic name reference CanTrcvIcuChannelRef [0..1]: destination=IcuChannel  # Reference to the IcuChannel to enable/disable the interrupts for wakeups.
        symbolic name reference CanTrcvWakeupSourceRef: destination=EcuMWakeupSource  # Reference to a wakeup source in the EcuM configuration. This reference is only needed if CanTrcvWakeupByBusUsed is true. Implementation Type: reference to EcuM_WakeupSourceType
        choice container CanTrcvAccess [1..*]
          container CanTrcvDioAccess [0..1]  # Container gives CAN transceiver driver information about accessing ports and port pins. In addition relation between CAN transceiver hardware pin names and Dio port access information is given. If a CAN transceiver hardware has no Dio interface, there is no instance of this container.
            string CanTrcvHardwareInterfaceName: set at pre-compile  # CAN transceiver hardware interface name. It is typically the name of a pin. From a Dio point of view it is either a port, a single channel or a channel group. Depending on this fact either CANTRCV_DIO_PORT_SYMBOLIC_NAME or CANTRCV_DIO_CHANNEL_SYMBOLIC_NAME or CANTRCV_DIO_CHANNEL_GROUP_SYMBOLIC_NAME shall reference a Dio configuration. The CAN transceiver driver implementation description shall list up this name for the appropriate CAN transceiver hardware.
            choice reference CanTrcvDioSymNameRef: set at pre-compile, destination=[DioChannel, DioChannelGroup, DioPort]  # Choice Reference to a DIO Port, DIO Channel or DIO Channel Group. This reference replaces the CANTRCV_DIO_PORT_SYM_NAME, CANTRCV_DIO_CHANNEL_SYM_NAME and CANTRCV_DIO_GROUP_SYM_NAME references in the Can Trcv SWS.
          container CanTrcvSpiSequence [0..*]  # Container gives information about the SPI sequences used to access a CAN Transceiver device. It is assumed that one SPI sequence used by a CAN transceiver device is for its exclusive use.
            boolean CanTrcvSpiAccessSynchronous [0..1]: set at pre-compile, default-value=false  # This parameter is used to define whether the access to the Spi sequence is synchronous or asynchronous. true: SPI access is synchronous. false: SPI access is asynchronous.
            symbolic name reference CanTrcvSpiSequenceName [0..*]: destination=SpiSequence  # Reference to a Spi sequence configuration container.
        container CanTrcvPartialNetwork [0..1]  # Container gives CAN transceiver driver information about the configuration of Partial Networking functionality.
          integer CanTrcvBaudRate: 0..1000, set at post-build in variant post-build / pre-compile in variant pre-compile  # Indicates the CAN Bus communication baud rate in kbps.
          boolean CanTrcvBusErrFlag: set at post-build in variant post-build / pre-compile in variant pre-compile, default-value=false  # Indicates if the Bus Error (BUSERR) flag is managed by the BSW. This flag is set if a bus failure is detected by the transceiver. TRUE = Supported by transceiver and managed by BSW. FALSE = Not managed by BSW.
          boolean CanTrcvPnCanIdIsExtended: set at post-build in variant post-build / pre-compile in variant pre-compile, default-value=false  # Indicates whether extended or standard ID is used. TRUE = Extended Can identifier is used. FALSE = Standard Can identifier is used.
          boolean CanTrcvPnEnabled: set at post-build in variant post-build / pre-compile in variant pre-compile, default-value=false  # Indicates whether the selective wake-up function is enabled or disabled in HW. TRUE = Selective wakeup feature is enabled in the transceiver hardware FALSE = Selective wakeup feature is disabled in the transceiver hardware
          integer CanTrcvPnFrameCanId: 0..4294967295, set at post-build in variant post-build / pre-compile in variant pre-compile  # CAN ID of the Wake-up Frame (WUF).
          integer CanTrcvPnFrameCanIdMask: 0..4294967295, set at post-build in variant post-build / pre-compile in variant pre-compile  # ID Mask for the selective activation of the transceiver. It is used to enableFrame Wake-up (WUF) on a group of IDs.
          integer CanTrcvPnFrameDlc: 0..8, set at post-build in variant post-build / pre-compile in variant pre-compile  # Data Length of the Wake-up Frame (WUF).
          boolean CanTrcvPowerOnFlag: set at post-build in variant post-build / pre-compile in variant pre-compile, default-value=false  # Description: Indicates if the Power On Reset (POR) flag is available and is managed by the transceiver. TRUE = Supported by Hardware. FALSE = Not supported by Hardware.
          container CanTrcvPnFrameDataMaskSpec [0..8]  # Defines data payload mask to be used on the received payload in order to determine if the transceiver must be woken up by the received Wake-up Frame (WUF).
            integer CanTrcvPnFrameDataMask: 0..255, set at post-build in variant post-build / pre-compile in variant pre-compile  # Defines the n byte (Byte0 = LSB) of the data payload mask to be used on the received payload in order to determine if the transceiver must be woken up by the received Wake-up Frame (WUF).
            integer CanTrcvPnFrameDataMaskIndex: 0..7, set at post-build in variant post-build / pre-compile in variant pre-compile  # holds the position n in frame of the mask-part
  module definition Com [0..1]: variants pre-compile/link-time/post-build  # COM540: Configuration of the Com module.
    container ComConfig: multiple-configuration-container=true  # This container contains the configuration parameters and sub containers of the COM module. This container is a MultipleConfigurationContainer, i.e. this container and its sub-containers exist once per configuration set.
      integer ComConfigurationId: set at post-build in variant post-build / link in variant link-time / pre-compile in variant pre-compile  # This ID is returned by a call to Com_GetConfigurationId.
      container ComGwMapping [0..*]  # Each instance of this container defines one mapping of the integrated Signal Gateway.
        choice container ComGwDestination [1..*]  # Each instance of this choice container allows to define one routing destination either by reference to an already configured COM signal / signal group or by a destination description container.
          container ComGwDestinationDescription [0..1]  # Description of a gateway destination. This container allows defining a gateway destination without the configuration of a complete COM signal. This allows adding / changing gateway relations post build without the configuration of new signals.
            integer ComBitPosition: 0..63, set at post-build in variant post-build / link in variant link-time / pre-compile in variant pre-compile  # Starting position within the I-PDU. This parameter refers to the position in the I-PDU and not in the shadow buffer.
            integer ComSignalDataInvalidValue: set at link in variant post-build+link-time / pre-compile in variant pre-compile  # COM391: On receiver side: When this value is received it is recognized as the invalid value and the appropriate invalid action (as specified by ComDataInvalidAction) is performed. COM501: On sender side: This configures the data invalid value that is used by a call to Com_InvalidateSignal.
            enumeration ComSignalEndianess: {BIG_ENDIAN, LITTLE_ENDIAN, OPAQUE}, set at post-build in variant post-build / link in variant link-time / pre-compile in variant pre-compile  # Defines the endianness of the signal's network representation.
            integer ComSignalInitValue [0..1]: set at post-build in variant post-build / link in variant link-time / pre-compile in variant pre-compile, default-value=0  # COM170: Initial value for this signal. The default value is 0. The lower n-bits of the configured Integer shall be used as init-value for an n-bit sized signal type. COM483: If the signal is of type UINT[n], the Integer's least significant byte shall be assigned to the byte array’s last byte. The second-least significant byte shall be assigned to the byte array’s last but one byte, and so on.
            enumeration ComTransferProperty [0..1]: {PENDING, TRIGGERED, TRIGGERED_ON_CHANGE, TRIGGERED_ON_CHANGE_WITHOUT_REPETITION, TRIGGERED_WITHOUT_REPETITION}, set at post-build in variant post-build / link in variant link-time / pre-compile in variant pre-compile  # Derived from [18].
            integer ComUpdateBitPosition [0..1]: 0..63, set at post-build in variant post-build / link in variant link-time / pre-compile in variant pre-compile  # Bit position of update-bit inside I-PDU. If this attribute is omitted then there is no update-bit. This setting must be consistently on sender and on receiver side.
            symbolic name reference ComGwIPduRef: destination=ComIPdu  # Symbolic reference to an I-PDU of a Signal Gateway source or destination description.
          container ComGwSignal [0..1]  # This container allows specifying a gateway source or destination respectively with a reference to a ComSignal, a ComGroupSignal or a ComSignalGroup.
            choice reference ComGwSignalRef: set at post-build in variant post-build / link in variant link-time / pre-compile in variant pre-compile, destination=[ComSignal, ComSignalGroup, ComGroupSignal]  # Reference to an object of a gateway relation. Either to a ComSignal, ComGroupSignal or to a SignalGroup.
        choice container ComGwSource  # This choice container allows the definition of the gateway source signal either by reference to an already configured COM signal / signal group or by a source description container.
          container ComGwSignal [0..1]  # This container allows specifying a gateway source or destination respectively with a reference to a ComSignal, a ComGroupSignal or a ComSignalGroup.
            choice reference ComGwSignalRef: set at post-build in variant post-build / link in variant link-time / pre-compile in variant pre-compile, destination=[ComSignal, ComSignalGroup, ComGroupSignal]  # Reference to an object of a gateway relation. Either to a ComSignal, ComGroupSignal or to a SignalGroup.
          container ComGwSourceDescription [0..1]  # Description of a gateway source. This container allows defining a gateway source without the configuration of a complete COM signal. This allows adding / changing gateway relations post build without the configuration of new signals.
            integer ComBitPosition: 0..63, set at post-build in variant post-build / link in variant link-time / pre-compile in variant pre-compile  # Starting position within the I-PDU. This parameter refers to the position in the I-PDU and not in the shadow buffer.
            integer ComBitSize: 0..64, set at post-build in variant post-build / link in variant link-time / pre-compile in variant pre-compile  # Size in bits.
            enumeration ComSignalEndianess: {BIG_ENDIAN, LITTLE_ENDIAN, OPAQUE}, set at post-build in variant post-build / link in variant link-time / pre-compile in variant pre-compile  # Defines the endianness of the signal's network representation.
            enumeration ComSignalType: {BOOLEAN, SINT16, SINT32, SINT8, UINT16, UINT32, UINT8, UINT8_N}, set at post-build in variant post-build / link in variant link-time / pre-compile in variant pre-compile  # The AUTOSAR type of the signal. Whether or not the signal is signed or unsigned can be found by examining the value of this attribute. This type could also be used to reserved appropriate storage in AUTOSAR COM.
            integer ComUpdateBitPosition [0..1]: 0..63, set at post-build in variant post-build / link in variant link-time / pre-compile in variant pre-compile  # Bit position of update-bit inside I-PDU. If this attribute is omitted then there is no update-bit. This setting must be consistently on sender and on receiver side.
            symbolic name reference ComGwIPduRef: destination=ComIPdu  # Symbolic reference to an I-PDU of a Signal Gateway source or destination description.
      container ComIPdu [0..*]  # Contains the configuration parameters of Com I-Pdus. COM174: The shortName is used as the symbolic name (ComIpduName) of this I-Pdu when communicating with the PduR. Is optional because the Com module might be used for internal communication only. This parameter is only stored in the XML file, and must not be used within the implementation.
        function name ComIPduCallout [0..1]: set at pre-compile  # If there is a callout defined for this I-PDU this parameter contains the name of the callout function..
        integer ComIPduRxHandleId [0..1]: set at link in variant post-build+link-time / pre-compile in variant pre-compile, symbolic-name-value=true  # The numerical value used as the ID of this I-PDU. The Com_IPduRxHandleId is required by the API calls to receive I-PDUs from the PduR. It is only present for I-PDU is received from the PduR, because Com is the starting module for Tx I-PDUs and there is no need to define IDs for Tx I-PDUs in the Com module.
        enumeration ComIPduSignalProcessing [0..1]: {DEFERED, IMMEDIATE}, set at post-build in variant post-build / link in variant link-time / pre-compile in variant pre-compile  # For the definition of the two modes Immediate and Defered, see COM298.
        integer ComIPduSize: 0..254, set at post-build in variant post-build / link in variant link-time / pre-compile in variant pre-compile  # The size of the I-PDU in bytes. The maximum size is limited by the underlying communication interface. 0-8 for CAN and LIN 0-254 for FlexRay
        enumeration ComIpduDirection: {RECEIVE, SEND}, set at post-build in variant post-build / link in variant link-time / pre-compile in variant pre-compile  # The direction defines if this I-PDU, and therefore the contributing signals and signal groups, shall be send or received.
        boolean ComGwRouteDlc [0..1]: set at post-build in variant post-build / pre-compile in variant pre-compile, default-value=false
        reference ComIPduGroupRef [1..*]: set at post-build in variant post-build / link in variant link-time / pre-compile in variant pre-compile, destination=ComIPduGroup  # Reference to the I-PDU group this I-PDU belongs to.
        reference ComIPduSignalGroupRef [0..*]: set at post-build in variant post-build / link in variant link-time / pre-compile in variant pre-compile, destination=ComSignalGroup  # References to all signal groups contained in this I-Pdu
        reference ComIPduSignalRef [0..*]: set at post-build in variant post-build / link in variant link-time / pre-compile in variant pre-compile, destination=ComSignal  # References to all signals contained in this I-PDU.
        reference PduIdRef: set at link in variant post-build / pre-compile in variant pre-compile, destination=Pdu  # Reference to the "global" Pdu structure to allow harmonization of handle IDs in the COM-Stack.
        container ComTxIPdu [0..1]  # This container contains additional transmission related configuration parameters of COM I-PDUs
          integer ComTxIPduMinimumDelayTimeFactor [0..1]: set at post-build in variant post-build / link in variant link-time / pre-compile in variant pre-compile, origin=AUTOSAR_ECUC V3.0  # COM181: Minimum delay between successive transmissions of this I-PDU, independent of the transmission mode. There is only one minimum delay time parameter for the I-PDU. This minimum delay time does not change with mode changes. Neither is the timer reset. This means that mode changes are not allowed to violate the minimum delay time. It is not possible to monitor the minumum delay time for I-PDUs that are requested using the Com_TriggerTransmit API. Depending on the implementation, this timeout may be implemented as a 32-bit or a 16-bit counter. COM471: No minimum delay time monitoring shall take place, if ComTxIPduMinimumDelayTimeFactor is omitted or configured to 0.
          integer ComTxIPduUnusedAreasDefault: 0..255, set at link in variant post-build+link-time / pre-compile in variant pre-compile  # AUTOSAR COM fills not used areas of an I-PDU with this bit-pattern. This attribute is mandatory to avoid undefined behaviour. This byte-pattern will be repeated throughout the I-PDU.
          container ComTxModeFalse [0..1]  # This container contains the configuration parameters of COM transmission modes in the case the ComFilter evaluates to false.
            container ComTxMode  # This container contains the configuration parameters of COM transmission modes.
              enumeration ComTxModeMode: {DIRECT, MIXED, NONE, PERIODIC}, set at post-build in variant post-build / link in variant link-time / pre-compile in variant pre-compile  # The available transmission modes described in [18] shall be extended by the additional mode None. The transmission mode None shall not have any further sub-attributes in the ComTxMode object.
              integer ComTxModeNumberOfRepetitions [0..1]: 0..255, set at post-build in variant post-build / link in variant link-time / pre-compile in variant pre-compile  # Defines the number of repetitions for the Direct/N-Times transmission mode and the event driven part of Mixed transmission mode.
              integer ComTxModeRepetitionPeriodFactor [0..1]: set at post-build in variant post-build / link in variant link-time / pre-compile in variant pre-compile  # Period of the repetition of the n transmission for the Direct/NTimes transmission mode and the event driven part of the Mixed transmission mode. Depending on the implementation, this timeout may be implemented as a 32-bit or a 16-bit counter.
              integer ComTxModeTimeOffsetFactor [0..1]: set at post-build in variant post-build / link in variant link-time / pre-compile in variant pre-compile  # Time until first transmission of this I-PDU. ComTxModeTimeOffsetFactor defines the time between Com_IpduGroupStart and the first transmission of the cyclic part of this transmission request for this I-PDU. Depending on the implementation, this timeout may be implemented as a 32-bit or a 16-bit counter.
              integer ComTxModeTimePeriodFactor [0..1]: set at post-build in variant post-build / link in variant link-time / pre-compile in variant pre-compile  # Period of the repetition of cyclic transmissions. Depending on the implementation, this timeout may be implemented as a 32-bit or a 16-bit counter.
          container ComTxModeTrue [0..1]  # This container contains the configuration parameters of COM transmission modes in the case the ComFilter evaluates to true.
            container ComTxMode  # This container contains the configuration parameters of COM transmission modes.
              enumeration ComTxModeMode: {DIRECT, MIXED, NONE, PERIODIC}, set at post-build in variant post-build / link in variant link-time / pre-compile in variant pre-compile  # The available transmission modes described in [18] shall be extended by the additional mode None. The transmission mode None shall not have any further sub-attributes in the ComTxMode object.
              integer ComTxModeNumberOfRepetitions [0..1]: 0..255, set at post-build in variant post-build / link in variant link-time / pre-compile in variant pre-compile  # Defines the number of repetitions for the Direct/N-Times transmission mode and the event driven part of Mixed transmission mode.
              integer ComTxModeRepetitionPeriodFactor [0..1]: set at post-build in variant post-build / link in variant link-time / pre-compile in variant pre-compile  # Period of the repetition of the n transmission for the Direct/NTimes transmission mode and the event driven part of the Mixed transmission mode. Depending on the implementation, this timeout may be implemented as a 32-bit or a 16-bit counter.
              integer ComTxModeTimeOffsetFactor [0..1]: set at post-build in variant post-build / link in variant link-time / pre-compile in variant pre-compile  # Time until first transmission of this I-PDU. ComTxModeTimeOffsetFactor defines the time between Com_IpduGroupStart and the first transmission of the cyclic part of this transmission request for this I-PDU. Depending on the implementation, this timeout may be implemented as a 32-bit or a 16-bit counter.
              integer ComTxModeTimePeriodFactor [0..1]: set at post-build in variant post-build / link in variant link-time / pre-compile in variant pre-compile  # Period of the repetition of cyclic transmissions. Depending on the implementation, this timeout may be implemented as a 32-bit or a 16-bit counter.
      container ComIPduGroup [0..*]  # Contains the configuration parameters of Com I-Pdu groups. COM126: The shortName is used as the symbolic name of the I-Pdu group (ComIpduGroupName). This parameter is only stored in the XML file, and must not be used within the implementation.
        integer ComIPduGroupHandleId: 0..31, set at link in variant post-build+link-time / pre-compile in variant pre-compile, symbolic-name-value=true  # The numerical value used as the ID of this I-PDU Group . The ComIPduGroupHandleId is required by the API calls to start and stop I-PDU Groups. For the rational for the range see COM187.
        reference ComIPduGroupGroupRef [0..1]: set at post-build in variant post-build / link in variant link-time / pre-compile in variant pre-compile, destination=ComIPduGroup  # If the I-PDU Group belongs to an I-PDU group, this is the name of the I-PDU group it belongs to. This I-PDU Group does not belong to another I-PDU group, if this reference is omitted.
      container ComSignal [0..*]  # Contains the configuration parameters of Com signals. COM163: The shortName is used as the symbolic name of the signal (ComSignalName). This name is also used as the handle name for the signal. This parameter is only stored in the XML file, and must not be used within the implementation.
        integer ComBitPosition: 0..63, set at post-build in variant post-build / link in variant link-time / pre-compile in variant pre-compile  # Starting position within the I-PDU. This parameter refers to the position in the I-PDU and not in the shadow buffer.
        integer ComBitSize: 0..64, set at link in variant post-build+link-time / pre-compile in variant pre-compile  # Size in bits.
        enumeration ComDataInvalidAction: {NOTIFY, REPLACE}, set at link in variant post-build+link-time / pre-compile in variant pre-compile  # This parameter defines the action performed upon reception of an invalid signal. Relating to signal groups the action in case if one of the included signals is an invalid signal. If Replace is used the ComSignalInitValue will be used for the replacement.
        function name ComErrorNotification [0..1]: set at link in variant post-build+link-time / pre-compile in variant pre-compile  # Only valid on sender side: Name of Com_CbkTxErr callback function to be called. If this parameter is omitted no error notification shall take place.
        integer ComFirstTimeoutFactor [0..1]: set at link in variant post-build+link-time / pre-compile in variant pre-compile  # Defines the first timeout period for the deadline monitoring. Details can be found in [17]. Note: See also COM263 for the configuration of the remaining timeout periods. Depending on the implementation, this timeout may be implemented as a 32-bit or a 16-bit counter.
        integer ComHandleId: set at link in variant post-build+link-time / pre-compile in variant pre-compile, symbolic-name-value=true  # The numerical value used as the ID. For signals it is required by the API calls Com_UpdateShadowSignal, Com_ReceiveShadowSignal and Com_InvalidateShadowSignal. For signals groups it is required by the Com_SendSignalGroup and Com_ReceiveSignalGroup calls.
        function name ComInvalidNotification [0..1]: set at link in variant post-build+link-time / pre-compile in variant pre-compile  # Only valid on receiver side: Name of Com_CbkRxInv callback function to be called. Name of the function which notifies the RTE about the reception of an invalidated signal/ signal group. Only applicable if ComSignalDataInvalidAction is configured to Notify.
        function name ComNotification [0..1]: set at link in variant post-build+link-time / pre-compile in variant pre-compile  # On sender side: Name of Com_CbkTxAck callback function to be called. On receiver side: Name of Com_CbkRxAck callback function to be called. If this parameter is omitted no notification shall take place.
        enumeration ComRxDataTimeoutAction [0..1]: {NONE, REPLACE}, set at link in variant post-build+link-time / pre-compile in variant pre-compile  # COM412: This parameter defines the action performed upon a reception timeout violation. COM500: If this parameter is omitted or configured to None no replacement shall take place. COM470: Relating to signals: When this parameter is set to Replace, the replacement value used shall be the ComInitValue. COM513: Relating to signal groups: When this parameter is set to Replace, all included signals shall be set to their ComInitValue.
        integer ComSignalDataInvalidValue: set at link in variant post-build+link-time / pre-compile in variant pre-compile  # COM391: On receiver side: When this value is received it is recognized as the invalid value and the appropriate invalid action (as specified by ComDataInvalidAction) is performed. COM501: On sender side: This configures the data invalid value that is used by a call to Com_InvalidateSignal.
        enumeration ComSignalEndianess: {BIG_ENDIAN, LITTLE_ENDIAN, OPAQUE}, set at post-build in variant post-build / link in variant link-time / pre-compile in variant pre-compile  # Defines the endianness of the signal's network representation.
        integer ComSignalInitValue [0..1]: set at post-build in variant post-build / link in variant link-time / pre-compile in variant pre-compile, default-value=0  # COM170: Initial value for this signal. The default value is 0. The lower n-bits of the configured Integer shall be used as init-value for an n-bit sized signal type. COM483: If the signal is of type UINT[n], the Integer's least significant byte shall be assigned to the byte array’s last byte. The second-least significant byte shall be assigned to the byte array’s last but one byte, and so on.
        integer ComSignalLength [0..1]: 1..8, set at link in variant post-build+link-time / pre-compile in variant pre-compile  # The ComSignalLength specifies the n (in Bytes: 1..8) of the type UINT8[n]. For other types it will be ignored.
        enumeration ComSignalType: {BOOLEAN, SINT16, SINT32, SINT8, UINT16, UINT32, UINT8, UINT8_N}, set at post-build in variant post-build / link in variant link-time / pre-compile in variant pre-compile  # The AUTOSAR type of the signal. Whether or not the signal is signed or unsigned can be found by examining the value of this attribute. This type could also be used to reserved appropriate storage in AUTOSAR COM.
        integer ComTimeoutFactor [0..1]: set at link in variant post-build+link-time / pre-compile in variant pre-compile  # COM263: Defines the timeout period for the deadline monitoring. Details can be found in [17]. Note: The period for the ComFirstTimeoutFactor could differ from the ComTimeoutFactor. Depending on the implementation, this timeout may be implemented as a 32-bit or a 16-bit counter. COM264: If deadline monitoring is used on a signal with an update-bit this defines the timeout for deadline monitoring. COM333: If the timeout is omitted or configured to 0 than no timeout monitoring shall take place. In this case ComFirstTimeoutFactor shall be ignored.
        function name ComTimeoutNotification [0..1]: set at link in variant post-build+link-time / pre-compile in variant pre-compile  # On sender side: Name of Com_CbkTxTOut callback function to be called. On receiver side: Name of Com_CbkRxTOut callback function to be called.
        enumeration ComTransferProperty [0..1]: {PENDING, TRIGGERED, TRIGGERED_ON_CHANGE, TRIGGERED_ON_CHANGE_WITHOUT_REPETITION, TRIGGERED_WITHOUT_REPETITION}, set at post-build in variant post-build / link in variant link-time / pre-compile in variant pre-compile  # Derived from [18].
        integer ComUpdateBitPosition [0..1]: 0..63, set at post-build in variant post-build / link in variant link-time / pre-compile in variant pre-compile  # Bit position of update-bit inside I-PDU. If this attribute is omitted then there is no update-bit. This setting must be consistently on sender and on receiver side.
        foreign reference SystemTemplateSystemSignalRef: destination-type=ISignalToIPduMapping  # Reference to the ISignalToIPduMapping that contains a reference to the ISignal (System Template) which this ComSignal (or ComGroupSignal) represents.
        container ComFilter [0..1]  # This container contains the configuration parameters of COM Filters. Note: On sender side the container is used to specify the transmission mode conditions.
          enumeration ComFilterAlgorithm: {ALWAYS, MASKED_NEW_DIFFERS_MASKED_OLD, MASKED_NEW_DIFFERS_X, MASKED_NEW_EQUALS_X, NEVER, NEW_IS_OUTSIDE, NEW_IS_WITHIN, ONE_EVERY_N}, set at link in variant post-build+link-time / pre-compile in variant pre-compile  # The range of values is specified in the [17] specification, chapter 2.2.2, Reception Filtering.
          integer ComFilterMask [0..1]: set at link in variant post-build+link-time / pre-compile in variant pre-compile  # The name of this attribute corresponds to the parameter name in the [17] specification of Reception Filtering. Only the least significant 32 bits are significant.
          integer ComFilterMax [0..1]: set at link in variant post-build+link-time / pre-compile in variant pre-compile  # The name of this attribute corresponds to the parameter name in the [17] specification of Reception Filtering. Only the least significant 32 bits are significant.
          integer ComFilterMin [0..1]: set at link in variant post-build+link-time / pre-compile in variant pre-compile  # The name of this attribute corresponds to the parameter name in the [17] specification of Reception Filtering. Only the least significant 32 bits are significant.
          integer ComFilterOffset [0..1]: set at link in variant post-build+link-time / pre-compile in variant pre-compile  # The name of this attribute corresponds to the parameter name in the [17] specification of Reception Filtering. Only the least significant 32 bits are significant. Range = 0..(ComFilterPeriodFactor-1)
          integer ComFilterPeriodFactor [0..1]: set at link in variant post-build+link-time / pre-compile in variant pre-compile  # The name of this attribute corresponds to the parameter name in the [17] specification of Reception Filtering. Only the least significant 32 are significant.
          integer ComFilterX [0..1]: set at link in variant post-build+link-time / pre-compile in variant pre-compile  # The name of this attribute corresponds to the parameter name in the [17] specification of Reception Filtering. Only the least significant 32 bits are significant.
      container ComSignalGroup [0..*]  # Contains the configuration parameters of Com signal groups. COM044: The shortName is used as the symbolic name of the signal group (ComSignalGroupName). This name is also used as the handle name for the signal group. This parameter is only stored in the XML file, and must not be used within the implementation.
        integer ComBitPosition: 0..63, set at post-build in variant post-build / link in variant link-time / pre-compile in variant pre-compile  # Starting position within the I-PDU. This parameter refers to the position in the I-PDU and not in the shadow buffer.
        integer ComBitSize: 0..64, set at link in variant post-build+link-time / pre-compile in variant pre-compile  # Size in bits.
        enumeration ComDataInvalidAction: {NOTIFY, REPLACE}, set at link in variant post-build+link-time / pre-compile in variant pre-compile  # This parameter defines the action performed upon reception of an invalid signal. Relating to signal groups the action in case if one of the included signals is an invalid signal. If Replace is used the ComSignalInitValue will be used for the replacement.
        function name ComErrorNotification [0..1]: set at link in variant post-build+link-time / pre-compile in variant pre-compile  # Only valid on sender side: Name of Com_CbkTxErr callback function to be called. If this parameter is omitted no error notification shall take place.
        integer ComFirstTimeoutFactor [0..1]: set at link in variant post-build+link-time / pre-compile in variant pre-compile  # Defines the first timeout period for the deadline monitoring. Details can be found in [17]. Note: See also COM263 for the configuration of the remaining timeout periods. Depending on the implementation, this timeout may be implemented as a 32-bit or a 16-bit counter.
        integer ComHandleId: set at link in variant post-build+link-time / pre-compile in variant pre-compile, symbolic-name-value=true  # The numerical value used as the ID. For signals it is required by the API calls Com_UpdateShadowSignal, Com_ReceiveShadowSignal and Com_InvalidateShadowSignal. For signals groups it is required by the Com_SendSignalGroup and Com_ReceiveSignalGroup calls.
        function name ComInvalidNotification [0..1]: set at link in variant post-build+link-time / pre-compile in variant pre-compile  # Only valid on receiver side: Name of Com_CbkRxInv callback function to be called. Name of the function which notifies the RTE about the reception of an invalidated signal/ signal group. Only applicable if ComSignalDataInvalidAction is configured to Notify.
        function name ComNotification [0..1]: set at link in variant post-build+link-time / pre-compile in variant pre-compile  # On sender side: Name of Com_CbkTxAck callback function to be called. On receiver side: Name of Com_CbkRxAck callback function to be called. If this parameter is omitted no notification shall take place.
        enumeration ComRxDataTimeoutAction [0..1]: {NONE, REPLACE}, set at link in variant post-build+link-time / pre-compile in variant pre-compile  # COM412: This parameter defines the action performed upon a reception timeout violation. COM500: If this parameter is omitted or configured to None no replacement shall take place. COM470: Relating to signals: When this parameter is set to Replace, the replacement value used shall be the ComInitValue. COM513: Relating to signal groups: When this parameter is set to Replace, all included signals shall be set to their ComInitValue.
        integer ComTimeoutFactor [0..1]: set at link in variant post-build+link-time / pre-compile in variant pre-compile  # COM263: Defines the timeout period for the deadline monitoring. Details can be found in [17]. Note: The period for the ComFirstTimeoutFactor could differ from the ComTimeoutFactor. Depending on the implementation, this timeout may be implemented as a 32-bit or a 16-bit counter. COM264: If deadline monitoring is used on a signal with an update-bit this defines the timeout for deadline monitoring. COM333: If the timeout is omitted or configured to 0 than no timeout monitoring shall take place. In this case ComFirstTimeoutFactor shall be ignored.
        function name ComTimeoutNotification [0..1]: set at link in variant post-build+link-time / pre-compile in variant pre-compile  # On sender side: Name of Com_CbkTxTOut callback function to be called. On receiver side: Name of Com_CbkRxTOut callback function to be called.
        enumeration ComTransferProperty [0..1]: {PENDING, TRIGGERED, TRIGGERED_ON_CHANGE, TRIGGERED_ON_CHANGE_WITHOUT_REPETITION, TRIGGERED_WITHOUT_REPETITION}, set at post-build in variant post-build / link in variant link-time / pre-compile in variant pre-compile  # Derived from [18].
        integer ComUpdateBitPosition [0..1]: 0..63, set at post-build in variant post-build / link in variant link-time / pre-compile in variant pre-compile  # Bit position of update-bit inside I-PDU. If this attribute is omitted then there is no update-bit. This setting must be consistently on sender and on receiver side.
        foreign reference SystemTemplateSignalGroupRef: destination-type=ISignalToIPduMapping  # Reference to the ISignalToIPduMapping that contains a reference to the ISignal (SystemTemplate) which this ComSignalGroup represents.
        container ComGroupSignal [0..*]  # COM520: This container contains the configuration parameters of group signals. I.e. signals that are included within a signal group. COM521: The shortName is used as the symbolic name of the signal (ComSignalName). This name is also used as the handle name for the signal. This parameter is only stored in the XML file, and must not be used within the implementation. This container contains the configuration parameters of group signals. I.e. signals that are included within a signal group. The shortName is used as the symbolic name of the signal (ComSignalName). This name is also used as the handle name for the signal. This parameter is only stored in the XML file, and must not be used within the implementation.
          integer ComBitPosition: 0..63, set at post-build in variant post-build / link in variant link-time / pre-compile in variant pre-compile  # Starting position within the I-PDU. This parameter refers to the position in the I-PDU and not in the shadow buffer.
          integer ComBitSize: 0..64, set at link in variant post-build+link-time / pre-compile in variant pre-compile  # Size in bits.
          integer ComHandleId: set at link in variant post-build+link-time / pre-compile in variant pre-compile, symbolic-name-value=true  # The numerical value used as the ID. For signals it is required by the API calls Com_UpdateShadowSignal, Com_ReceiveShadowSignal and Com_InvalidateShadowSignal. For signals groups it is required by the Com_SendSignalGroup and Com_ReceiveSignalGroup calls.
          function name ComInvalidNotification [0..1]: set at link in variant post-build+link-time / pre-compile in variant pre-compile  # Only valid on receiver side: Name of Com_CbkRxInv callback function to be called. Name of the function which notifies the RTE about the reception of an invalidated signal/ signal group. Only applicable if ComSignalDataInvalidAction is configured to Notify.
          integer ComSignalDataInvalidValue: set at link in variant post-build+link-time / pre-compile in variant pre-compile  # COM391: On receiver side: When this value is received it is recognized as the invalid value and the appropriate invalid action (as specified by ComDataInvalidAction) is performed. COM501: On sender side: This configures the data invalid value that is used by a call to Com_InvalidateSignal.
          enumeration ComSignalEndianess: {BIG_ENDIAN, LITTLE_ENDIAN, OPAQUE}, set at post-build in variant post-build / link in variant link-time / pre-compile in variant pre-compile  # Defines the endianness of the signal's network representation.
          integer ComSignalInitValue [0..1]: set at post-build in variant post-build / link in variant link-time / pre-compile in variant pre-compile, default-value=0  # COM170: Initial value for this signal. The default value is 0. The lower n-bits of the configured Integer shall be used as init-value for an n-bit sized signal type. COM483: If the signal is of type UINT[n], the Integer's least significant byte shall be assigned to the byte array’s last byte. The second-least significant byte shall be assigned to the byte array’s last but one byte, and so on.
          integer ComSignalLength [0..1]: 1..8, set at link in variant post-build+link-time / pre-compile in variant pre-compile  # The ComSignalLength specifies the n (in Bytes: 1..8) of the type UINT8[n]. For other types it will be ignored.
          enumeration ComSignalType: {BOOLEAN, SINT16, SINT32, SINT8, UINT16, UINT32, UINT8, UINT8_N}, set at post-build in variant post-build / link in variant link-time / pre-compile in variant pre-compile  # The AUTOSAR type of the signal. Whether or not the signal is signed or unsigned can be found by examining the value of this attribute. This type could also be used to reserved appropriate storage in AUTOSAR COM.
          enumeration ComTransferProperty [0..1]: {PENDING, TRIGGERED, TRIGGERED_ON_CHANGE, TRIGGERED_ON_CHANGE_WITHOUT_REPETITION, TRIGGERED_WITHOUT_REPETITION}, set at link in variant link-time / pre-compile in variant pre-compile / post-build in variant post-build, origin=Vector Informatik, default-value=PENDING  # The transfer behavior when writing to the signal can either be - TRIGGERED: the signal transmission is triggered if the signal is written regardless of the signal value - except if ComTxModeMode is PERIODIC or NONE - TRIGGERED_ON_CHANGE: the signal transmission is triggered if the signal is written and the signal value has changed - except if ComTxModeMode is PERIODIC or NONE - PENDING: writing to the signal does not cause direct transmission. RESTRICTIONS: 'TRIGGERED_ON_CHANGE' is only available, if 'ComTmsSupport' is set to 'true'.
          foreign reference SystemTemplateSystemSignalRef: destination-type=ISignalToIPduMapping  # Reference to the ISignalToIPduMapping that contains a reference to the ISignal (System Template) which this ComSignal (or ComGroupSignal) represents.
          container ComFilter [0..1]  # This container contains the configuration parameters of COM Filters. Note: On sender side the container is used to specify the transmission mode conditions.
            enumeration ComFilterAlgorithm: {ALWAYS, MASKED_NEW_DIFFERS_MASKED_OLD, MASKED_NEW_DIFFERS_X, MASKED_NEW_EQUALS_X, NEVER, NEW_IS_OUTSIDE, NEW_IS_WITHIN, ONE_EVERY_N}, set at link in variant post-build+link-time / pre-compile in variant pre-compile  # The range of values is specified in the [17] specification, chapter 2.2.2, Reception Filtering.
            integer ComFilterMask [0..1]: set at link in variant post-build+link-time / pre-compile in variant pre-compile  # The name of this attribute corresponds to the parameter name in the [17] specification of Reception Filtering. Only the least significant 32 bits are significant.
            integer ComFilterMax [0..1]: set at link in variant post-build+link-time / pre-compile in variant pre-compile  # The name of this attribute corresponds to the parameter name in the [17] specification of Reception Filtering. Only the least significant 32 bits are significant.
            integer ComFilterMin [0..1]: set at link in variant post-build+link-time / pre-compile in variant pre-compile  # The name of this attribute corresponds to the parameter name in the [17] specification of Reception Filtering. Only the least significant 32 bits are significant.
            integer ComFilterOffset [0..1]: set at link in variant post-build+link-time / pre-compile in variant pre-compile  # The name of this attribute corresponds to the parameter name in the [17] specification of Reception Filtering. Only the least significant 32 bits are significant. Range = 0..(ComFilterPeriodFactor-1)
            integer ComFilterPeriodFactor [0..1]: set at link in variant post-build+link-time / pre-compile in variant pre-compile  # The name of this attribute corresponds to the parameter name in the [17] specification of Reception Filtering. Only the least significant 32 are significant.
            integer ComFilterX [0..1]: set at link in variant post-build+link-time / pre-compile in variant pre-compile  # The name of this attribute corresponds to the parameter name in the [17] specification of Reception Filtering. Only the least significant 32 bits are significant.
    container ComGeneral  # Contains the general configuration parameters of the Com module.
      float ComConfigurationTimeBase: set at pre-compile  # The period between successive calls to the Main Functions (Rx, Tx, Routing) of AUTOSAR COM in seconds.
      boolean ComConfigurationUseDet [0..1]: set at pre-compile  # The error hook shall contain code to call the Det. If this parameter is configured COM_DEV_ERROR_DETECT shall be set to ON as output of the configuration tool. (as input for the source code), see COM028.
      boolean ComVersionInfoApi: set at pre-compile  # Activate/Deactivate the version information API (Com_GetVersionInfo). True: version information API activated False: version information API deactivated
  module definition ComM [0..1]: variants pre-compile  # Configuration of the ComM (Communications Manager) module.
    container ComMChannel [1..*]  # This container contains the configuration (parameters) of the bus channel(s). The channel parameters shall be harmonized within the whole communication stack.
      enumeration ComMBusType: {COMM_BUS_TYPE_CAN, COMM_BUS_TYPE_FR, COMM_BUS_TYPE_INTERNAL, COMM_BUS_TYPE_LIN}, set at pre-compile  # Identifies the bus type of the channel.
      integer ComMChannelId: 0..255, set at pre-compile, symbolic-name-value=true  # Channel identification number of the corresponding channel.
      float ComMMainFunctionPeriod: 0.004..0.1, set at pre-compile, default-value=0.02  # Specifies the period in seconds that the MainFunction has to be triggered with. Comment: ComM scheduling shall be at lest as fast as the communication stack and a schedule longer than 100ms makes no sense for communication.
      boolean ComMNoCom: set at pre-compile, default-value=false  # ECU is not allowed to change state of the channel to "Silent Communication" or "Full Communication". true: Enabled - Not allowed to switch to "Silent Communication mode" or "Full Communication mode" false: disabled This is the default/init value corresponding to a runtime variable that can be cahnged using ComM_LimitChannelToNoComMode().
      boolean ComMNoFullCom: set at pre-compile, default-value=false  # ECU is not allowed to change state of the channel to "Full Communication". TRUE - enabled - Not allowed to switch to "Full Communication mode" FALSE - disabled (default) This parameter is the default/init value of a corresponding runtime variable that can be changed using ComM_LimitChannelToNoComMode(). ComMNmVariant != FULL: ComM_LimitChannelToNoComMode() can be used. ComMNmVariant = PASSIVE: ComM_LimitChannelToNoComMode() shall not be used.
      boolean ComMNoWakeup: set at pre-compile, default-value=false  # Defines if an ECU is not allowed to wake-up the channel. true: Enabled (not allowed to wake-up)) false: Disabled This is the default/init value of a runtime variable that can be changed during runtime using ComM_PreventWakeUp().
      enumeration ComMPncGatewayType [0..1]: {COMM_GATEWAY_TYPE_ACTIVE, COMM_GATEWAY_TYPE_PASSIVE, COMM_GATEWAY_TYPE_NONE}, set at pre-compile, default-value=COMM_GATEWAY_TYPE_ACTIVE  # Identifies the Partial Network Gateway behaviour of a ComMChannel.
      symbolic name reference ComMNvmBlockDescriptor: destination=NvmBlockDescriptor  # Reference to NVRAM block containing the none volatile data
      container ComMNetworkManagement  # This container contains the configuration parameters of the networkmanagement.
        float ComMNmLightTimeout [0..1]: 1..255, set at pre-compile, default-value=10  # Defines the timeout (in seconds) after state "ready sleep" is left.
        enumeration ComMNmVariant: {FULL, LIGHT, NONE, PASSIVE}, set at pre-compile, default-value=FULL  # Defines the functionality of the networkmanagement. Shall be harmonized with NM configuration.
      container ComMUserPerChannel [0..*]  # This container contains a list of identifiers that are needed to refer to a user in the system which is linked to a channel.
        reference ComMUserChannel: set at pre-compile, destination=ComMUser  # Reference to the ComMUser that corresponds to this channel user. ImplementationType: COMM_UserHandleType
    container ComMGeneral  # General configuration parameters of the Communication Manager.
      boolean ComMDevErrorDetect: set at pre-compile, default-value=false  # Switches the Development Error Detection and Notification ON or OFF. true: Enabled false: Disabled
      integer ComMEcuGroupClassification: 0..255, set at pre-compile, default-value=3  # Defines whether a mode inhibition affects the ECU or not. Examples: 000: No mode inhibition can be activated 001: Wake up inhibition can be enabled Forcing into "No Communication" mode shall be switched on if ComMNmVariant=PASSIVE.
      boolean ComMModeLimitationEnabled: set at pre-compile, default-value=false  # true if mode limitation functionality shall be enabled. true: Enabled false: Disabled
      boolean ComMNoCom: set at pre-compile, default-value=false  # The ECU is not allowed to change state of the ECU to "Silent Communication" or "Full Communication". true: Enabled (not allowed to switch to Silent Communication mode or Full Communication mode) false: Disabled
      boolean ComMResetAfterForcingNoComm: set at pre-compile, default-value=false  # ComM shall perform a reset after entering "No Communication" mode because of an active mode limitation to "No Communication" mode. true: Enabled false: Disabled
      boolean ComMSynchronousWakeUp: set at pre-compile, default-value=true  # Wake up of one channel shall lead to a wake up of all channels if true. true: Enabled false: Disabled
      float ComMTMinFullComModeDuration: 0.001..65, set at pre-compile, default-value=5  # Minimum time duration in seconds, spent in the Full Communication mode.
      boolean ComMVersionInfoApi: set at pre-compile, default-value=true  # Switches the possibility to read the published information with the service ComM_GetPublishedInformation(). true: Enabled false: Disabled
      boolean ComMWakeupInhibitionEnabled: set at pre-compile, default-value=false  # true if wake up inhibition functionality enabled. true: Enabled false: Disabled
      boolean ComMPncSupport: set at pre-compile, default-value=false  # Enables or disables support of partial networking. False: Partial Networking is disabled True: Partial Networking is enabled
      boolean ComMPncGatewayEnabled [0..1]: set at link, origin=Vector Informatik, default-value=false  # Enables or disables support of Partial Network Gateway. False: Partial Networking Gateway is disabled True: Partial Networking Gateway is enabled
      symbolic name reference ComMGlobalNvmBlockDescriptor: destination=NvmBlockDescriptor  # Reference to NVRAM block containing the none volatile data
    container ComMUser [1..*]  # This container contains a list of identifiers that are needed to refer to a user in the system which is designated to request Communication modes.
      integer ComMUserIdentifier: 0.., set at pre-compile, symbolic-name-value=true  # An identifier that is needed to refer to a user in the system which is designated to request Communication modes. ImplementationType: ComM_UserHandleType
    container ComMConfig: multiple-configuration-container=true
      boolean ComMPncEnabled [0..1]: set at post-build in variant post-build / pre-compile in variant pre-compile, default-value=false  # Defines whether in this configuration set the partial networking is enabled. true: Enabled false: Disabled
      container ComMNetworks [1..*]
        symbolic name reference ComMNetworkHandle: origin=Vector Informatik, destination=ComMChannel
    container ComMPnc [0..*]  # This container contains the configuration of the partial network cluster (PNC).
      integer ComMPncId: 0..47, set at pre-compile, symbolic-name-value=true  # Partial network cluster identification number.
      reference ComMChannelPerPnc [0..*]: set at pre-compile, destination=ComMChannel  # Reference to the ComMChannel that is required for this PNC. ImplementationType: COMM_ChannelType
      reference ComMUserPerPnc [0..*]: set at pre-compile, destination=ComMUser  # Reference to the ComMChannel that is required for this PNC. ImplementationType: COMM_ChannelType
      container ComMPncComSignal [0..*]  # Represents the PncComSignals which are used to communicate the EIRA and ERA status of this PNC.
        enumeration ComMPncComSignalDirection: {RX, TX}, set at link, origin=Vector Informatik  # Indicates the communication direction of this PncComSignal.
        enumeration ComMPncComSignalKind: {EIRA, ERA}, set at link, origin=Vector Informatik  # Indicates whether this PncComSignal represents EIRA or ERA PNC information.
        reference ComMPncComSignalChannelRef [0..1]: set at link, origin=Vector Informatik, destination=ComMChannel  # Reference to the ComMChannel which is used to determine whether this PncComSignal shall participate in the active or passive role (via the parameter ComMPncGatewayType of the ComMChannel).
        symbolic name reference ComMPncComSignalRef: set at link, origin=Vector Informatik, destination=ComSignal  # Reference to the ComSignal which is used to transport the partial network channel request information.
  module definition Crc [0..1]: variants pre-compile  # Configuration of the Crc (Crc routines) module.
    container CrcGeneral  # General configuration of CRC module
      enumeration Crc16Mode: {CRC_16_HARDWARE, CRC_16_RUNTIME, CRC_16_TABLE}, set at pre-compile  # Switch to select one of the available CRC16 calculation methods.
      enumeration Crc32Mode: {CRC_32_HARDWARE, CRC_32_RUNTIME, CRC_32_TABLE}, set at pre-compile  # Switch to select one of the available CRC32 calculation methods.
      boolean CrcVersionInfoApi: set at pre-compile  # Pre-processor switch to enable / disable the API to read out the modules version information. true: Version info API enabled. false: Version info API disabled.
    container CrcPublishedInformation  # Additional published parameters not covered by CommonPublishedInformation container. Note that these parameters do not have any configuration class setting, since they are published information.
      integer CrcInitialValue16  # Initial value for the 16-bit CRC calculation.
      integer CrcInitialValue32  # Initial value for the 32-bit CRC calculation.
