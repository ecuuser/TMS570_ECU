AUTOSAR XML (schema 314)
package /Constant
  133 x constant specification:
    C_CBV_bit0
      value:
        boolean literal C_CBV_bit0: type=DT_CBV_bit0, value=false
    C_CBV_bit1
      value:
        boolean literal C_CBV_bit1: type=DT_CBV_bit1, value=false
    C_CBV_bit2
      value:
        boolean literal C_CBV_bit2: type=DT_CBV_bit2, value=false
    C_CBV_bit3
      value:
        boolean literal C_CBV_bit3: type=DT_CBV_bit3, value=false
    C_CBV_bit4_ActiveWakeupBit
      value:
        boolean literal C_CBV_bit4_ActiveWakeupBit: type=DT_CBV_bit4_ActiveWakeupBit, value=false
    C_CBV_bit5
      value:
        boolean literal C_CBV_bit5: type=DT_CBV_bit5, value=false
    C_CBV_bit6
      value:
        boolean literal C_CBV_bit6: type=DT_CBV_bit6, value=false
    C_CBV_bit7
      value:
        boolean literal C_CBV_bit7: type=DT_CBV_bit7, value=false
    C_CityModeSts
      value:
        boolean literal C_CityModeSts: type=DT_CityModeSts, value=false
    C_CmdIgn_FailSts
      value:
        integer literal C_CmdIgn_FailSts: type=DT_CmdIgn_FailSts, value=0
    C_CmdIgnSts
      value:
        integer literal C_CmdIgnSts: type=DT_CmdIgnSts, value=0
    C_CurrentFailSts_EPS
      value:
        boolean literal C_CurrentFailSts_EPS: type=DT_CurrentFailSts_EPS, value=false
    C_DES_EPS
      value:
        boolean literal C_DES_EPS: type=DT_DES_EPS, value=false
    C_Digit_01
      value:
        integer literal C_Digit_01: type=DT_Digit_01, value=0
    C_Digit_01_EPS
      value:
        integer literal C_Digit_01_EPS: type=DT_Digit_01_EPS, value=0
    C_Digit_02
      value:
        integer literal C_Digit_02: type=DT_Digit_02, value=0
    C_Digit_02_EPS
      value:
        integer literal C_Digit_02_EPS: type=DT_Digit_02_EPS, value=0
    C_Digit_03
      value:
        integer literal C_Digit_03: type=DT_Digit_03, value=0
    C_Digit_03_EPS
      value:
        integer literal C_Digit_03_EPS: type=DT_Digit_03_EPS, value=0
    C_Digit_04
      value:
        integer literal C_Digit_04: type=DT_Digit_04, value=0
    C_Digit_04_EPS
      value:
        integer literal C_Digit_04_EPS: type=DT_Digit_04_EPS, value=0
    C_Digit_05
      value:
        integer literal C_Digit_05: type=DT_Digit_05, value=0
    C_Digit_05_EPS
      value:
        integer literal C_Digit_05_EPS: type=DT_Digit_05_EPS, value=0
    C_Digit_06
      value:
        integer literal C_Digit_06: type=DT_Digit_06, value=0
    C_Digit_06_EPS
      value:
        integer literal C_Digit_06_EPS: type=DT_Digit_06_EPS, value=0
    C_Digit_07
      value:
        integer literal C_Digit_07: type=DT_Digit_07, value=0
    C_Digit_07_EPS
      value:
        integer literal C_Digit_07_EPS: type=DT_Digit_07_EPS, value=0
    C_Digit_08
      value:
        integer literal C_Digit_08: type=DT_Digit_08, value=0
    C_Digit_08_EPS
      value:
        integer literal C_Digit_08_EPS: type=DT_Digit_08_EPS, value=0
    C_Digit_09
      value:
        integer literal C_Digit_09: type=DT_Digit_09, value=0
    C_Digit_09_EPS
      value:
        integer literal C_Digit_09_EPS: type=DT_Digit_09_EPS, value=0
    C_Digit_10
      value:
        integer literal C_Digit_10: type=DT_Digit_10, value=0
    C_Digit_10_EPS
      value:
        integer literal C_Digit_10_EPS: type=DT_Digit_10_EPS, value=0
    C_Digit_11
      value:
        integer literal C_Digit_11: type=DT_Digit_11, value=0
    C_Digit_11_EPS
      value:
        integer literal C_Digit_11_EPS: type=DT_Digit_11_EPS, value=0
    C_ElectricSteeringFailSts
      value:
        boolean literal C_ElectricSteeringFailSts: type=DT_ElectricSteeringFailSts, value=false
    C_ElectricSteeringLamp_FailSts
      value:
        integer literal C_ElectricSteeringLamp_FailSts: type=DT_ElectricSteeringLamp_FailSts, value=0
    C_EngineStopStartSts
      value:
        integer literal C_EngineStopStartSts: type=DT_EngineStopStartSts, value=0
    C_EngineSts
      value:
        integer literal C_EngineSts: type=DT_EngineSts, value=0
    C_EOL_EPS
      value:
        boolean literal C_EOL_EPS: type=DT_EOL_EPS, value=false
    C_GenericFailSts_EPS
      value:
        boolean literal C_GenericFailSts_EPS: type=DT_GenericFailSts_EPS, value=false
    C_INIT_TUNINGSESSIONADDRPTRENUM
      value:
        integer literal C_INIT_TUNINGSESSIONADDRPTRENUM: type=TuningSessionAddrPtrEnum, value=255
    C_LwsAngle
      value:
        integer literal C_LwsAngle: type=DT_LwsAngle, value=7200
    C_LwsAngleType
      value:
        integer literal C_LwsAngleType: type=DT_LwsAngleType, value=0
    C_LwsCalibration
      value:
        boolean literal C_LwsCalibration: type=DT_LwsCalibration, value=false
    C_LwsFailSts
      value:
        integer literal C_LwsFailSts: type=DT_LwsFailSts, value=0
    C_LwsSpeed
      value:
        integer literal C_LwsSpeed: type=DT_LwsSpeed, value=2000
    C_OperationalModeSts
      value:
        integer literal C_OperationalModeSts: type=DT_OperationalModeSts, value=0
    C_SourceNodeIdentifier
      value:
        integer literal C_SourceNodeIdentifier: type=DT_SourceNodeIdentifier, value=0
    C_StayActiveSource_EPS_0
      value:
        boolean literal C_StayActiveSource_EPS_0: type=DT_StayActiveSource_EPS_0, value=false
    C_StayActiveSource_EPS_1
      value:
        boolean literal C_StayActiveSource_EPS_1: type=DT_StayActiveSource_EPS_1, value=false
    C_StayActiveSource_EPS_10
      value:
        boolean literal C_StayActiveSource_EPS_10: type=DT_StayActiveSource_EPS_10, value=false
    C_StayActiveSource_EPS_11
      value:
        boolean literal C_StayActiveSource_EPS_11: type=DT_StayActiveSource_EPS_11, value=false
    C_StayActiveSource_EPS_12
      value:
        boolean literal C_StayActiveSource_EPS_12: type=DT_StayActiveSource_EPS_12, value=false
    C_StayActiveSource_EPS_13
      value:
        boolean literal C_StayActiveSource_EPS_13: type=DT_StayActiveSource_EPS_13, value=false
    C_StayActiveSource_EPS_14
      value:
        boolean literal C_StayActiveSource_EPS_14: type=DT_StayActiveSource_EPS_14, value=false
    C_StayActiveSource_EPS_15
      value:
        boolean literal C_StayActiveSource_EPS_15: type=DT_StayActiveSource_EPS_15, value=false
    C_StayActiveSource_EPS_2
      value:
        boolean literal C_StayActiveSource_EPS_2: type=DT_StayActiveSource_EPS_2, value=false
    C_StayActiveSource_EPS_3
      value:
        boolean literal C_StayActiveSource_EPS_3: type=DT_StayActiveSource_EPS_3, value=false
    C_StayActiveSource_EPS_4
      value:
        boolean literal C_StayActiveSource_EPS_4: type=DT_StayActiveSource_EPS_4, value=false
    C_StayActiveSource_EPS_5
      value:
        boolean literal C_StayActiveSource_EPS_5: type=DT_StayActiveSource_EPS_5, value=false
    C_StayActiveSource_EPS_6
      value:
        boolean literal C_StayActiveSource_EPS_6: type=DT_StayActiveSource_EPS_6, value=false
    C_StayActiveSource_EPS_7
      value:
        boolean literal C_StayActiveSource_EPS_7: type=DT_StayActiveSource_EPS_7, value=false
    C_StayActiveSource_EPS_8
      value:
        boolean literal C_StayActiveSource_EPS_8: type=DT_StayActiveSource_EPS_8, value=false
    C_StayActiveSource_EPS_9
      value:
        boolean literal C_StayActiveSource_EPS_9: type=DT_StayActiveSource_EPS_9, value=false
    C_SteeringLoad
      value:
        boolean literal C_SteeringLoad: type=DT_SteeringLoad, value=true
    C_StopStartSts
      value:
        integer literal C_StopStartSts: type=DT_StopStartSts, value=0
    C_VehicleSpeedVSOSig
      value:
        integer literal C_VehicleSpeedVSOSig: type=DT_VehicleSpeedVSOSig, value=0
    D_100MS_SEC_F32
      value:
        real literal D_100MS_SEC_F32: type=Float, value=0.1
    D_180OVRPI_ULS_F32
      value:
        real literal D_180OVRPI_ULS_F32: type=Float, value=57.295779513082
    D_2MS_SEC_F32
      value:
        real literal D_2MS_SEC_F32: type=Float, value=0.002
    D_2PI_ULS_F32
      value:
        real literal D_2PI_ULS_F32: type=Float, value=6.2831853071796
    D_APASTATEINIT_CNT_U08
      value:
        integer literal D_APASTATEINIT_CNT_U08: type=APA_State_enum, value=0
    D_BATTSWDVLTGCORRSTATINIT_CNT_ENUM
      value:
        integer literal D_BATTSWDVLTGCORRSTATINIT_CNT_ENUM: type=BattSwdVltgCorrSts_Cnt_enum, value=0
    D_CCWEOTINIT_HWDEG_F32
      value:
        real literal D_CCWEOTINIT_HWDEG_F32: type=Float, value=-360
    D_CITYUSERENABLEDISABLE_ENUM
      value:
        integer literal D_CITYUSERENABLEDISABLE_ENUM: type=CityUserEnableDisable, value=0
    D_CMPVEHLATAINIT_CNT_U16
      value:
        integer literal D_CMPVEHLATAINIT_CNT_U16: type=UInt16, value=1022
    D_CWEOTINIT_HWDEG_F32
      value:
        real literal D_CWEOTINIT_HWDEG_F32: type=Float, value=360
    D_ESCSTATEINIT_CNT_U08
      value:
        integer literal D_ESCSTATEINIT_CNT_U08: type=ESC_State_enum, value=0
    D_FALSE_CNT_LGC
      value:
        boolean literal D_FALSE_CNT_LGC: type=Boolean, value=false
    D_FETFAULTPHASEINIT_CNT_ENUM
      value:
        integer literal D_FETFAULTPHASEINIT_CNT_ENUM: type=FETPHASETYPE_ENUM, value=0
    D_FETFAULTTYPEINIT_CNT_ENUM
      value:
        integer literal D_FETFAULTTYPEINIT_CNT_ENUM: type=FETFAULTTYPE_ENUM, value=0
    D_FIFTEEN_CNT_U16
      value:
        integer literal D_FIFTEEN_CNT_U16: type=UInt16, value=15
    D_FLOATZERO_ULS_F32
      value:
        real literal D_FLOATZERO_ULS_F32: type=Float, value=0
    D_FOUR_CNT_U08
      value:
        integer literal D_FOUR_CNT_U08: type=UInt8, value=4
    D_HAPTICSTATEINIT_CNT_U08
      value:
        integer literal D_HAPTICSTATEINIT_CNT_U08: type=Haptic_State_enum, value=1
    D_LKASTATEINIT_CNT_U08
      value:
        integer literal D_LKASTATEINIT_CNT_U08: type=LKA_State_enum, value=0
    D_LOASTATEINIT_CNT_ENUM
      value:
        integer literal D_LOASTATEINIT_CNT_ENUM: type=LOA_State_enum, value=0
    D_MANUFMODEINIT_CNT_ENUM
      value:
        integer literal D_MANUFMODEINIT_CNT_ENUM: type=ManufModeType, value=0
    D_MSECPERSEC_ULS_F32
      value:
        real literal D_MSECPERSEC_ULS_F32: type=Float, value=1000
    D_MTRPOLESDIV2_CNT_U8
      value:
        integer literal D_MTRPOLESDIV2_CNT_U8: type=UInt8, value=3
    D_MTRRAMPRATEFALL_MTRNMPS_F32
      value:
        real literal D_MTRRAMPRATEFALL_MTRNMPS_F32: type=Float, value=-4400
    D_MTRRAMPRATERISE_MTRNMPS_F32
      value:
        real literal D_MTRRAMPRATERISE_MTRNMPS_F32: type=Float, value=4400
    D_MTRTRQCMDHILMT_MTRNM_F32
      value:
        real literal D_MTRTRQCMDHILMT_MTRNM_F32: type=Float, value=8.8
    D_MTRTRQCMDLOLMT_MTRNM_F32
      value:
        real literal D_MTRTRQCMDLOLMT_MTRNM_F32: type=Float, value=-8.8
    D_NEGONE_CNT_S16
      value:
        integer literal D_NEGONE_CNT_S16: type=SInt16, value=-1
    D_NEGONE_CNT_S32
      value:
        integer literal D_NEGONE_CNT_S32: type=SInt32, value=-1
    D_NEGONE_CNT_S8
      value:
        integer literal D_NEGONE_CNT_S8: type=SInt8, value=-1
    D_NORMALINIT_CNT_U16
      value:
        integer literal D_NORMALINIT_CNT_U16: type=EnergyModeStateType, value=0
    D_ONE_CNT_S16
      value:
        integer literal D_ONE_CNT_S16: type=SInt16, value=1
    D_ONE_CNT_S32
      value:
        integer literal D_ONE_CNT_S32: type=SInt32, value=1
    D_ONE_CNT_S8
      value:
        integer literal D_ONE_CNT_S8: type=SInt8, value=1
    D_ONE_CNT_U16
      value:
        integer literal D_ONE_CNT_U16: type=UInt16, value=1
    D_ONE_CNT_U32
      value:
        integer literal D_ONE_CNT_U32: type=UInt32, value=1
    D_ONE_CNT_U8
      value:
        integer literal D_ONE_CNT_U8: type=UInt8, value=1
    D_ONE_ULS_F32
      value:
        real literal D_ONE_ULS_F32: type=Float, value=1
    D_PI_ULS_F32
      value:
        real literal D_PI_ULS_F32: type=Float, value=3.1415926535898
    D_PIOVR180_ULS_F32
      value:
        real literal D_PIOVR180_ULS_F32: type=Float, value=0.0174532925199
    D_PROXIVALID
      value:
        boolean literal D_PROXIVALID: type=ProxiValid_Cnt_lgc, value=false
    D_QUADRANT1_CNT_U8
      value:
        integer literal D_QUADRANT1_CNT_U8: type=UInt8, value=1
    D_QUADRANT2_CNT_U8
      value:
        integer literal D_QUADRANT2_CNT_U8: type=UInt8, value=2
    D_QUADRANT3_CNT_U8
      value:
        integer literal D_QUADRANT3_CNT_U8: type=UInt8, value=3
    D_QUADRANT4_CNT_U8
      value:
        integer literal D_QUADRANT4_CNT_U8: type=UInt8, value=4
    D_RADPERREV_ULS_F32
      value:
        real literal D_RADPERREV_ULS_F32: type=Float, value=6.28318530718
    D_SEVEN_CNT_U16
      value:
        integer literal D_SEVEN_CNT_U16: type=UInt16, value=7
    D_SFINVMILLI_ULS_F32
      value:
        real literal D_SFINVMILLI_ULS_F32: type=Double, value=1000
    D_SIGQLFRNORES_CNT_ENUM
      value:
        integer literal D_SIGQLFRNORES_CNT_ENUM: type=SigQlfr_State_enum, value=0
    D_THREE_CNT_U08
      value:
        integer literal D_THREE_CNT_U08: type=UInt8, value=3
    D_TRQOSCFREQINIT_F32
      value:
        real literal D_TRQOSCFREQINIT_F32: type=Float, value=50
    D_TRQOSCFREQINIT_HZ_F32
      value:
        real literal D_TRQOSCFREQINIT_HZ_F32: type=Float, value=50
    D_TRUE_CNT_LGC
      value:
        boolean literal D_TRUE_CNT_LGC: type=Boolean, value=true
    D_TWO_CNT_U08
      value:
        integer literal D_TWO_CNT_U08: type=UInt8, value=2
    D_VECUMIN_VOLTS_F32
      value:
        real literal D_VECUMIN_VOLTS_F32: type=Float, value=5
    D_VEHWHLBASEINIT_MM_F32
      value:
        real literal D_VEHWHLBASEINIT_MM_F32: type=Float, value=3000
    D_ZERO_CNT_S16
      value:
        integer literal D_ZERO_CNT_S16: type=SInt16, value=0
    D_ZERO_CNT_S32
      value:
        integer literal D_ZERO_CNT_S32: type=SInt32, value=0
    D_ZERO_CNT_S8
      value:
        integer literal D_ZERO_CNT_S8: type=SInt8, value=0
    D_ZERO_CNT_U16
      value:
        integer literal D_ZERO_CNT_U16: type=UInt16, value=0
    D_ZERO_CNT_U32
      value:
        integer literal D_ZERO_CNT_U32: type=UInt32, value=0
    D_ZERO_CNT_U8
      value:
        integer literal D_ZERO_CNT_U8: type=UInt8, value=0
    D_ZERO_ULS_F32
      value:
        real literal D_ZERO_ULS_F32: type=Float, value=0
    T_SINELKPTBL_ULS_F32
      value:
        array specification T_SINELKPTBL_ULS_F32: type=DT_SinTanLkpTbl_f32
          193 x real literal, all with type=Float:
            Float_0: value=0
            Float_1: value=0.00818114
            Float_2: value=0.016361732
            Float_3: value=0.024541229
            Float_4: value=0.032719083
            Float_5: value=0.040894747
            Float_6: value=0.049067674
            Float_7: value=0.057237317
            Float_8: value=0.065403129
            Float_9: value=0.073564564
            Float_10: value=0.081721074
            Float_11: value=0.089872115
            Float_12: value=0.09801714
            Float_13: value=0.106155605
            Float_14: value=0.114286965
            Float_15: value=0.122410675
            Float_16: value=0.130526192
            Float_17: value=0.138632973
            Float_18: value=0.146730475
            Float_19: value=0.154818155
            Float_20: value=0.162895473
            Float_21: value=0.170961889
            Float_22: value=0.179016861
            Float_23: value=0.187059852
            Float_24: value=0.195090322
            Float_25: value=0.203107734
            Float_26: value=0.211111552
            Float_27: value=0.21910124
            Float_28: value=0.227076263
            Float_29: value=0.235036087
            Float_30: value=0.24298018
            Float_31: value=0.250908009
            Float_32: value=0.258819045
            Float_33: value=0.266712758
            Float_34: value=0.274588618
            Float_35: value=0.2824461
            Float_36: value=0.290284677
            Float_37: value=0.298103825
            Float_38: value=0.30590302
            Float_39: value=0.31368174
            Float_40: value=0.321439465
            Float_41: value=0.329175676
            Float_42: value=0.336889853
            Float_43: value=0.344581482
            Float_44: value=0.352250048
            Float_45: value=0.359895037
            Float_46: value=0.367515937
            Float_47: value=0.375112238
            Float_48: value=0.382683432
            Float_49: value=0.390229013
            Float_50: value=0.397748475
            Float_51: value=0.405241314
            Float_52: value=0.41270703
            Float_53: value=0.420145122
            Float_54: value=0.427555093
            Float_55: value=0.434936447
            Float_56: value=0.44228869
            Float_57: value=0.44961133
            Float_58: value=0.456903876
            Float_59: value=0.46416584
            Float_60: value=0.471396737
            Float_61: value=0.478596082
            Float_62: value=0.485763394
            Float_63: value=0.492898192
            Float_64: value=0.5
            Float_65: value=0.507068342
            Float_66: value=0.514102744
            Float_67: value=0.521102737
            Float_68: value=0.528067851
            Float_69: value=0.53499762
            Float_70: value=0.541891581
            Float_71: value=0.548749271
            Float_72: value=0.555570233
            Float_73: value=0.562354009
            Float_74: value=0.569100146
            Float_75: value=0.575808191
            Float_76: value=0.582477697
            Float_77: value=0.589108216
            Float_78: value=0.595699305
            Float_79: value=0.602250522
            Float_80: value=0.608761429
            Float_81: value=0.615231591
            Float_82: value=0.621660573
            Float_83: value=0.628047947
            Float_84: value=0.634393284
            Float_85: value=0.64069616
            Float_86: value=0.646956153
            Float_87: value=0.653172843
            Float_88: value=0.659345815
            Float_89: value=0.665474656
            Float_90: value=0.671558955
            Float_91: value=0.677598305
            Float_92: value=0.683592302
            Float_93: value=0.689540545
            Float_94: value=0.695442635
            Float_95: value=0.701298178
            Float_96: value=0.707106781
            Float_97: value=0.712868056
            Float_98: value=0.718581618
            Float_99: value=0.724247083
            Float_100: value=0.729864073
            Float_101: value=0.735432211
            Float_102: value=0.740951125
            Float_103: value=0.746420446
            Float_104: value=0.751839808
            Float_105: value=0.757208847
            Float_106: value=0.762527204
            Float_107: value=0.767794524
            Float_108: value=0.773010453
            Float_109: value=0.778174644
            Float_110: value=0.783286749
            Float_111: value=0.788346428
            Float_112: value=0.79335334
            Float_113: value=0.798307152
            Float_114: value=0.803207532
            Float_115: value=0.80805415
            Float_116: value=0.812846685
            Float_117: value=0.817584813
            Float_118: value=0.822268219
            Float_119: value=0.826896589
            Float_120: value=0.831469612
            Float_121: value=0.835986984
            Float_122: value=0.840448401
            Float_123: value=0.844853565
            Float_124: value=0.849202182
            Float_125: value=0.853493959
            Float_126: value=0.85772861
            Float_127: value=0.861905852
            Float_128: value=0.866025404
            Float_129: value=0.870086991
            Float_130: value=0.874090342
            Float_131: value=0.878035187
            Float_132: value=0.881921264
            Float_133: value=0.885748312
            Float_134: value=0.889516075
            Float_135: value=0.893224301
            Float_136: value=0.896872742
            Float_137: value=0.900461152
            Float_138: value=0.903989293
            Float_139: value=0.907456928
            Float_140: value=0.910863825
            Float_141: value=0.914209756
            Float_142: value=0.917494496
            Float_143: value=0.920717827
            Float_144: value=0.923879533
            Float_145: value=0.926979401
            Float_146: value=0.930017224
            Float_147: value=0.932992799
            Float_148: value=0.935905927
            Float_149: value=0.938756413
            Float_150: value=0.941544065
            Float_151: value=0.944268698
            Float_152: value=0.94693013
            Float_153: value=0.949528181
            Float_154: value=0.952062678
            Float_155: value=0.954533451
            Float_156: value=0.956940336
            Float_157: value=0.95928317
            Float_158: value=0.961561798
            Float_159: value=0.963776066
            Float_160: value=0.965925826
            Float_161: value=0.968010935
            Float_162: value=0.970031253
            Float_163: value=0.971986645
            Float_164: value=0.973876979
            Float_165: value=0.97570213
            Float_166: value=0.977461975
            Float_167: value=0.979156396
            Float_168: value=0.98078528
            Float_169: value=0.982348519
            Float_170: value=0.983846006
            Float_171: value=0.985277642
            Float_172: value=0.986643332
            Float_173: value=0.987942984
            Float_174: value=0.98917651
            Float_175: value=0.990343829
            Float_176: value=0.991444861
            Float_177: value=0.992479535
            Float_178: value=0.993447779
            Float_179: value=0.99434953
            Float_180: value=0.995184727
            Float_181: value=0.995953314
            Float_182: value=0.996655239
            Float_183: value=0.997290457
            Float_184: value=0.997858923
            Float_185: value=0.998360601
            Float_186: value=0.998795456
            Float_187: value=0.99916346
            Float_188: value=0.999464588
            Float_189: value=0.999698819
            Float_190: value=0.999866138
            Float_191: value=0.999966534
            Float_192: value=1
    T_TANLKPTBL_ULS_F32
      value:
        array specification T_TANLKPTBL_ULS_F32: type=DT_SinTanLkpTbl_f32
          193 x real literal, all with type=Float:
            Float_0: value=0.004090638
            Float_1: value=0.012272462
            Float_2: value=0.02045593
            Float_3: value=0.028642137
            Float_4: value=0.036832181
            Float_5: value=0.045027163
            Float_6: value=0.053228185
            Float_7: value=0.061436353
            Float_8: value=0.069652776
            Float_9: value=0.077878569
            Float_10: value=0.086114851
            Float_11: value=0.094362747
            Float_12: value=0.102623388
            Float_13: value=0.110897912
            Float_14: value=0.119187464
            Float_15: value=0.127493199
            Float_16: value=0.135816279
            Float_17: value=0.144157876
            Float_18: value=0.152519173
            Float_19: value=0.160901363
            Float_20: value=0.16930565
            Float_21: value=0.177733252
            Float_22: value=0.1861854
            Float_23: value=0.194663336
            Float_24: value=0.203168319
            Float_25: value=0.211701624
            Float_26: value=0.22026454
            Float_27: value=0.228858373
            Float_28: value=0.237484449
            Float_29: value=0.24614411
            Float_30: value=0.254838719
            Float_31: value=0.26356966
            Float_32: value=0.272338336
            Float_33: value=0.281146175
            Float_34: value=0.289994626
            Float_35: value=0.298885164
            Float_36: value=0.307819289
            Float_37: value=0.316798527
            Float_38: value=0.325824432
            Float_39: value=0.334898586
            Float_40: value=0.344022602
            Float_41: value=0.353198123
            Float_42: value=0.362426827
            Float_43: value=0.371710423
            Float_44: value=0.381050656
            Float_45: value=0.390449308
            Float_46: value=0.399908199
            Float_47: value=0.409429188
            Float_48: value=0.419014177
            Float_49: value=0.42866511
            Float_50: value=0.438383974
            Float_51: value=0.448172804
            Float_52: value=0.458033683
            Float_53: value=0.467968746
            Float_54: value=0.477980176
            Float_55: value=0.488070214
            Float_56: value=0.498241156
            Float_57: value=0.508495358
            Float_58: value=0.518835235
            Float_59: value=0.529263268
            Float_60: value=0.539782003
            Float_61: value=0.550394056
            Float_62: value=0.561102113
            Float_63: value=0.571908936
            Float_64: value=0.582817365
            Float_65: value=0.593830322
            Float_66: value=0.604950811
            Float_67: value=0.616181926
            Float_68: value=0.627526852
            Float_69: value=0.638988871
            Float_70: value=0.650571362
            Float_71: value=0.662277811
            Float_72: value=0.674111811
            Float_73: value=0.686077068
            Float_74: value=0.698177407
            Float_75: value=0.710416776
            Float_76: value=0.722799253
            Float_77: value=0.735329049
            Float_78: value=0.748010517
            Float_79: value=0.760848156
            Float_80: value=0.77384662
            Float_81: value=0.787010724
            Float_82: value=0.80034545
            Float_83: value=0.813855957
            Float_84: value=0.827547589
            Float_85: value=0.841425884
            Float_86: value=0.855496581
            Float_87: value=0.869765633
            Float_88: value=0.884239215
            Float_89: value=0.898923737
            Float_90: value=0.913825852
            Float_91: value=0.928952473
            Float_92: value=0.944310785
            Float_93: value=0.959908255
            Float_94: value=0.97575265
            Float_95: value=0.991852054
            Float_96: value=1.008214881
            Float_97: value=1.024849894
            Float_98: value=1.041766226
            Float_99: value=1.058973397
            Float_100: value=1.076481336
            Float_101: value=1.094300405
            Float_102: value=1.112441422
            Float_103: value=1.130915688
            Float_104: value=1.149735011
            Float_105: value=1.168911743
            Float_106: value=1.188458804
            Float_107: value=1.208389721
            Float_108: value=1.228718659
            Float_109: value=1.249460468
            Float_110: value=1.270630717
            Float_111: value=1.292245742
            Float_112: value=1.314322696
            Float_113: value=1.336879599
            Float_114: value=1.359935394
            Float_115: value=1.383510008
            Float_116: value=1.407624417
            Float_117: value=1.432300717
            Float_118: value=1.4575622
            Float_119: value=1.483433437
            Float_120: value=1.509940366
            Float_121: value=1.53711039
            Float_122: value=1.564972483
            Float_123: value=1.593557306
            Float_124: value=1.622897326
            Float_125: value=1.65302696
            Float_126: value=1.683982719
            Float_127: value=1.715803371
            Float_128: value=1.74853012
            Float_129: value=1.782206799
            Float_130: value=1.816880088
            Float_131: value=1.852599743
            Float_132: value=1.889418859
            Float_133: value=1.927394157
            Float_134: value=1.966586293
            Float_135: value=2.007060212
            Float_136: value=2.048885533
            Float_137: value=2.092136977
            Float_138: value=2.136894845
            Float_139: value=2.183245548
            Float_140: value=2.231282201
            Float_141: value=2.281105287
            Float_142: value=2.332823403
            Float_143: value=2.386554093
            Float_144: value=2.442424793
            Float_145: value=2.500573891
            Float_146: value=2.561151937
            Float_147: value=2.624323002
            Float_148: value=2.690266237
            Float_149: value=2.759177648
            Float_150: value=2.831272122
            Float_151: value=2.906785762
            Float_152: value=2.985978571
            Float_153: value=3.069137557
            Float_154: value=3.156580334
            Float_155: value=3.248659312
            Float_156: value=3.345766601
            Float_157: value=3.448339762
            Float_158: value=3.556868595
            Float_159: value=3.671903171
            Float_160: value=3.7940634
            Float_161: value=3.924050484
            Float_162: value=4.062660691
            Float_163: value=4.210802034
            Float_164: value=4.369514589
            Float_165: value=4.539995414
            Float_166: value=4.723629328
            Float_167: value=4.92202723
            Float_168: value=5.137074201
            Float_169: value=5.370990435
            Float_170: value=5.626409169
            Float_171: value=5.90647743
            Float_172: value=6.214987771
            Float_173: value=6.556552741
            Float_174: value=6.936839169
            Float_175: value=7.362887641
            Float_176: value=7.843555652
            Float_177: value=8.390144119
            Float_178: value=9.01730236
            Float_179: value=9.744367451
            Float_180: value=10.59740238
            Float_181: value=11.61239886
            Float_182: value=12.84050299
            Float_183: value=14.35692958
            Float_184: value=16.27700796
            Float_185: value=18.78703932
            Float_186: value=22.20881656
            Float_187: value=27.15017067
            Float_188: value=34.91359651
            Float_189: value=48.88558064
            Float_190: value=81.48324021
            Float_191: value=244.460629
            Float_192: value=244.460629
