AUTOSAR XML (schema 314)
standard types defined: Boolean, SInt16, SInt32, SInt8, UInt16, UInt32, UInt8, Double, Float
package /DataType
  45 x array type:
    AvgFricLrnRangeCounterSubType
      element AvgFricLrnRangeCounterSubType: type=UInt16, max-number-of-elements=3
    AvgFricLrnRangeCounterType
      element AvgFricLrnRangeCounterType: type=AvgFricLrnRangeCounterSubType, max-number-of-elements=8
    AvgFricLrnThetaSubType
      element AvgFricLrnThetaSubType: type=Float, max-number-of-elements=4
    AvgFricLrnThetaType
      element AvgFricLrnThetaType: type=AvgFricLrnThetaSubType, max-number-of-elements=8
    AvgFricLrnVehLearnedFricType
      element AvgFricLrnVehLearnedFricType: type=Float, max-number-of-elements=4
    CoggingCancTrq
      element CoggingCancTrq: type=UInt16, max-number-of-elements=512
    CoggingCancTrqRplComp
      element CoggingCancTrqRplComp: type=UInt16, max-number-of-elements=9
    CurrTempOffsetTblType
      element CurrTempOffsetTblType: type=SInt16, max-number-of-elements=16
    Dcm_0Byte_Type
      element Dcm_0Byte_Type: type=UInt8, max-number-of-elements=1
    Dcm_10Byte_Type
      element Dcm_10Byte_Type: type=UInt8, max-number-of-elements=10
    Dcm_11Byte_Type
      element Dcm_11Byte_Type: type=UInt8, max-number-of-elements=11
    Dcm_12Byte_Type
      element Dcm_12Byte_Type: type=UInt8, max-number-of-elements=12
    Dcm_14Byte_Type
      element Dcm_14Byte_Type: type=UInt8, max-number-of-elements=14
    Dcm_15Byte_Type
      element Dcm_15Byte_Type: type=UInt8, max-number-of-elements=15
    Dcm_16Byte_Type
      element Dcm_16Byte_Type: type=UInt8, max-number-of-elements=16
    Dcm_176Byte_Type
      element Dcm_176Byte_Type: type=UInt8, max-number-of-elements=176
    Dcm_17Byte_Type
      element Dcm_17Byte_Type: type=UInt8, max-number-of-elements=17
    Dcm_18Byte_Type
      element Dcm_18Byte_Type: type=UInt8, max-number-of-elements=18
    Dcm_1Byte_Type
      element Dcm_1Byte_Type: type=UInt8, max-number-of-elements=1
    Dcm_255Byte_Type
      element Dcm_255Byte_Type: type=UInt8, max-number-of-elements=255
    Dcm_256Byte_Type
      element Dcm_256Byte_Type: type=UInt8, max-number-of-elements=256
    Dcm_25Byte_Type
      element Dcm_25Byte_Type: type=UInt8, max-number-of-elements=25
    Dcm_28Byte_Type
      element Dcm_28Byte_Type: type=UInt8, max-number-of-elements=28
    Dcm_2Byte_Type
      element Dcm_2Byte_Type: type=UInt8, max-number-of-elements=2
    Dcm_322Byte_Type
      element Dcm_322Byte_Type: type=UInt8, max-number-of-elements=322
    Dcm_3Byte_Type
      element Dcm_3Byte_Type: type=UInt8, max-number-of-elements=3
    Dcm_4092Byte_Type
      element Dcm_4092Byte_Type: type=UInt8, max-number-of-elements=4092
    Dcm_4Byte_Type
      element Dcm_4Byte_Type: type=UInt8, max-number-of-elements=4
    Dcm_5Byte_Type
      element Dcm_5Byte_Type: type=UInt8, max-number-of-elements=5
    Dcm_64Byte_Type
      element Dcm_64Byte_Type: type=UInt8, max-number-of-elements=64
    Dcm_67Byte_Type
      element Dcm_67Byte_Type: type=UInt8, max-number-of-elements=67
    Dcm_6Byte_Type
      element Dcm_6Byte_Type: type=UInt8, max-number-of-elements=6
    Dcm_75Byte_Type
      element Dcm_75Byte_Type: type=UInt8, max-number-of-elements=75
    Dcm_7Byte_Type
      element Dcm_7Byte_Type: type=UInt8, max-number-of-elements=7
    Dcm_8Byte_Type
      element Dcm_8Byte_Type: type=UInt8, max-number-of-elements=8
    Dcm_9Byte_Type
      element Dcm_9Byte_Type: type=UInt8, max-number-of-elements=9
    Dcm_SecAccess_1_DataRecType
      element Dcm_SecAccess_1_DataRecType: type=UInt8, max-number-of-elements=1
    Dcm_SecAccess_1_KeyType
      element Dcm_SecAccess_1_KeyType: type=UInt8, max-number-of-elements=4
    Dcm_SecAccess_1_SeedType
      element Dcm_SecAccess_1_SeedType: type=UInt8, max-number-of-elements=4
    DT_Array144_s8
      element DT_Array144_s8: type=SInt8, max-number-of-elements=144
    DT_Array2_u16
      element DT_Array2_u16: type=UInt16, max-number-of-elements=2
    DT_SinTanLkpTbl_f32
      element DT_SinTanLkpTbl_f32: type=Float, max-number-of-elements=193
    HarCompTbl
      element HarCompTbl: type=SInt16, max-number-of-elements=1024
    IPMCoggingCancTrq
      element IPMCoggingCancTrq: type=UInt16, max-number-of-elements=512
    NvM_DestPtr  # DataPtr Type to be used by WriteBlock, ReadBlock and RestoreBlockDefaults operations. This type is used for all NVRAM blocks
      element NvM_DestPtr: type=UInt8, max-number-of-elements=65535
  34 x boolean type:
    CfgDataCodeRequestActive
      invalid-value:
        boolean literal CfgDataCodeRequestActive: type=CfgDataCodeRequestActive, value=false
    DT_CBV_bit{0..3}
    DT_CBV_bit4_ActiveWakeupBit
    DT_CBV_bit{5..7}
    DT_CityModeSts
    DT_CurrentFailSts_EPS
    DT_DES_EPS
    DT_ElectricSteeringFailSts
    DT_EOL_EPS
    DT_GenericFailSts_EPS
    DT_LwsCalibration
    DT_StayActiveSource_EPS_0
    DT_StayActiveSource_EPS_1
    DT_StayActiveSource_EPS_{10..15}
    DT_StayActiveSource_EPS_{2..9}
    DT_SteeringLoad
    ProxiValid_Cnt_lgc
  74 x integer type:
    APA_State_enum: compu {0=APA_TempInhibit, 1=APA_AvailCntrl, 2=APA_Active, 3=APA_PermanentlyFailed, 4=APA_ManufacturingDisable}, lower-limit=0, upper-limit=4
    BattSwdVltgCorrSts_Cnt_enum: compu {0=BSVCS_NOFLT, 1=BSVCS_BATTVLTGSWD2FLT, 2=BSVCS_BATTVLTGSWD1FLT, 3=BSVCS_BATTVLTGFLT, 4=BSVCS_NOCORRLN}, lower-limit=0, upper-limit=4
    CityUserEnableDisable: compu {0=ReturnControlToECU, 1=ResetToDefault, 2=ShortTermAdjustment}, lower-limit=0, upper-limit=3
      invalid-value:
        integer literal CityUserEnableDisable: type=CityUserEnableDisable, value=0
    ComM_InhibitionStatusType: lower-limit=0, upper-limit=0
    ComM_ModeType: compu {0=COMM_NO_COMMUNICATION, 1=COMM_SILENT_COMMUNICATION, 2=COMM_FULL_COMMUNICATION}, lower-limit=0, upper-limit=2
    ComM_NetworkHandleType: lower-limit=0, upper-limit=255
    ComM_UserHandleType: lower-limit=0, upper-limit=255
    Dcm_ConfirmationStatusType: compu {0=DCM_RES_POS_OK, 1=DCM_RES_POS_NOT_OK, 2=DCM_RES_NEG_OK, 3=DCM_RES_NEG_NOT_OK}, lower-limit=0, upper-limit=3
    Dcm_NegativeResponseCodeType:
      compu {16=DCM_E_GENERALREJECT, 17=DCM_E_SERVICENOTSUPPORTED, 18=DCM_E_SUBFUNCTIONNOTSUPPORTED, 19=DCM_E_INCORRECTMESSAGELENGTHORINVALIDFORMAT, 20=DCM_E_RESPONSE_TOO_LONG, 33=DCM_E_BUSYREPEATREQUEST, 34=DCM_E_CONDITIONSNOTCORRECT, 36=DCM_E_REQUESTSEQUENCEERROR, 49=DCM_E_REQUESTOUTOFRANGE, 51=DCM_E_SECURITYACCESSDENIED, 53=DCM_E_INVALIDKEY, 54=DCM_E_EXCEEDNUMBEROFATTEMPTS, 55=DCM_E_REQUIREDTIMEDELAYNOTEXPIRED, 112=DCM_E_UPLOADDOWNLOADNOTACCEPTED, 113=DCM_E_TRANSFERDATASUSPENDED, 114=DCM_E_GENERALPROGRAMMINGFAILURE, 115=DCM_E_WRONGBLOCKSEQUENCECOUNTER, 120=DCM_E_REQUESTCORRECTLYRECEIVED_RESPONSEPENDING, 126=DCM_E_SUBFUNCTIONNOTSUPPORTEDINACTIVESESSION, 127=DCM_E_SERVICENOTSUPPORTEDINACTIVESESSION, 129=DCM_E_RPMTOOHIGH, 130=DCM_E_RPMTOOLOW, 131=DCM_E_ENGINEISRUNNING, 132=DCM_E_ENGINEISNOTRUNNING, 133=DCM_E_ENGINERUNTIMETOOLOW, 134=DCM_E_TEMPERATURETOOHIGH, 135=DCM_E_TEMPERATURETOOLOW, 136=DCM_E_VEHICLESPEEDTOOHIGH, 137=DCM_E_VEHICLESPEEDTOOLOW, 138=DCM_E_THROTTLE_PEDALTOOHIGH, 139=DCM_E_THROTTLE_PEDALTOOLOW, 140=DCM_E_TRANSMISSIONRANGENOTINNEUTRAL, 141=DCM_E_TRANSMISSIONRANGENOTINGEAR, 143=DCM_E_BRAKESWITCH_NOTCLOSED, 144=DCM_E_SHIFTERLEVERNOTINPARK, 145=DCM_E_TORQUECONVERTERCLUTCHLOCKED, 146=DCM_E_VOLTAGETOOHIGH, 147=DCM_E_VOLTAGETOOLOW}
      lower-limit=0
      upper-limit=255
    Dcm_ProtocolType: compu {0=DCM_OBD_ON_CAN, 1=DCM_UDS_ON_CAN, 2=DCM_UDS_ON_FLEXRAY, 3=DCM_ROE_ON_CAN, 4=DCM_ROE_ON_FLEXRAY, 5=DCM_PERIODICTRANS_ON_CAN, 6=DCM_PERIODICTRANS_ON_FLEXRAY}, lower-limit=0, upper-limit=255
    Dcm_SecLevelType: compu {0=DCM_SEC_LEV_LOCKED, 1=DCM_SEC_LEV_L1, 255=DCM_SEC_LEV_ALL}, lower-limit=0, upper-limit=255
    Dcm_SesCtrlType: compu {1=DCM_DEFAULT_SESSION, 2=DCM_PROGRAMMING_SESSION, 3=DCM_EXTENDED_DIAGNOSTIC_SESSION, 4=DCM_SAFETY_SYSTEM_DIAGNOSTIC_SESSION, 64=VEHICLE_MANUFACTURER_END_OF_LINE, 126=NEXTEER_MANUFACTURING_SERVICES, 255=DCM_ALL_SESSION_LEVEL}, lower-limit=1, upper-limit=255
    DT_CmdIgn_FailSts: compu {0=Cx0_Fail_Not_Present, 1=Cx1_Fail_Present, 2=Cx2_SNA}, lower-limit=0, upper-limit=3
      invalid-value:
        integer literal DT_CmdIgn_FailSts: type=DT_CmdIgn_FailSts, value=2
    DT_CmdIgnSts: compu {0=Cx0_Initialization, 1=Cx1_IGN_LK, 3=Cx3_ACC, 4=Cx4_RUN, 5=Cx5_START, 7=Cx7_SNA}, lower-limit=0, upper-limit=7
      invalid-value:
        integer literal DT_CmdIgnSts: type=DT_CmdIgnSts, value=7
    DT_Digit_01: lower-limit=0, upper-limit=15
    DT_Digit_01_EPS: lower-limit=0, upper-limit=15
    DT_Digit_02: lower-limit=0, upper-limit=15
    DT_Digit_02_EPS: lower-limit=0, upper-limit=15
    DT_Digit_03: lower-limit=0, upper-limit=15
    DT_Digit_03_EPS: lower-limit=0, upper-limit=15
    DT_Digit_04: lower-limit=0, upper-limit=15
    DT_Digit_04_EPS: lower-limit=0, upper-limit=15
    DT_Digit_05: lower-limit=0, upper-limit=15
    DT_Digit_05_EPS: lower-limit=0, upper-limit=15
    DT_Digit_06: lower-limit=0, upper-limit=15
    DT_Digit_06_EPS: lower-limit=0, upper-limit=15
    DT_Digit_07: lower-limit=0, upper-limit=15
    DT_Digit_07_EPS: lower-limit=0, upper-limit=15
    DT_Digit_08: lower-limit=0, upper-limit=15
    DT_Digit_08_EPS: lower-limit=0, upper-limit=15
    DT_Digit_09: lower-limit=0, upper-limit=15
    DT_Digit_09_EPS: lower-limit=0, upper-limit=15
    DT_Digit_10: lower-limit=0, upper-limit=15
    DT_Digit_10_EPS: lower-limit=0, upper-limit=15
    DT_Digit_11: lower-limit=0, upper-limit=15
    DT_Digit_11_EPS: lower-limit=0, upper-limit=15
    DT_ElectricSteeringLamp_FailSts: compu {0=Cx0_OFF_Fail_Not_Present, 1=Cx1_OFF_Fail_Present, 2=Cx2_ON_Fail_Not_Present, 3=Cx3_Not_Used}, lower-limit=0, upper-limit=3
    DT_EngineStopStartSts: compu {0=Cx0_Engine_Stop, 1=Cx1_Engine_Not_In_Stop, 2=Cx2_Engine_Stall, 3=Cx3_Engine_Stopping}, lower-limit=0, upper-limit=3
    DT_EngineSts: compu {0=Cx0_Engine_Off, 1=Cx1_Engine_Cranking, 2=Cx2_Engine_On, 3=Cx3_SNA}, lower-limit=0, upper-limit=3
      invalid-value:
        integer literal DT_EngineSts: type=DT_EngineSts, value=3
    DT_LwsAngle: compu {phys=raw*0.1-720; unit deg}, lower-limit=0, upper-limit=14400
    DT_LwsAngleType: compu {0=Cx0_Absolute, 1=Cx1_Relative, 2=Cx2_SNA}, lower-limit=0, upper-limit=3
      invalid-value:
        integer literal DT_LwsAngleType: type=DT_LwsAngleType, value=2
    DT_LwsFailSts: compu {0=Cx0_Fail_Not_Present, 1=Cx1_Fail_Present_Ignition_Latched, 2=Cx2_Fail_Present_Recoverable, 3=Cx3_Fail_Present_Battery_Discon}, lower-limit=0, upper-limit=3
    DT_LwsSpeed: compu {phys=raw-2000; unit degps}, lower-limit=0, upper-limit=4095
    DT_OperationalModeSts: compu {0=Cx0_Normal, 1=Cx1_City}, lower-limit=0, upper-limit=15
    DT_SourceNodeIdentifier: lower-limit=0, upper-limit=255
    DT_StopStartSts: compu {0=Cx0_OFF, 1=Cx1_ON, 2=Cx2_Functional_Disable_Request, 3=Cx3_Safety_Disable_Request}, lower-limit=0, upper-limit=3
    DT_VehicleSpeedVSOSig: compu {phys=raw*0.0625; unit kph}, lower-limit=0, upper-limit=8191
    EnergyModeStateType: compu {0=NORMAL, 1=PRODUCTION, 2=TRANSPORTATION, 3=FLASH}, lower-limit=0, upper-limit=3
    ESC_State_enum: compu {0=ESC_Inactive, 1=ESC_Active, 2=ESC_TemporarilyLimited, 3=ESC_PermanentlyFailed, 4=ESC_ManufacturingDisable}, lower-limit=0, upper-limit=4
    FETFAULTTYPE_ENUM: compu {0=NOFAULT, 1=LOWER, 2=UPPER}, lower-limit=0, upper-limit=255
    FETPHASETYPE_ENUM: compu {0=NOPHASE, 1=PHASEA, 2=PHASEB, 3=PHASEC}, lower-limit=0, upper-limit=255
    FltInjectionLocType:
      compu {1=FLTINJ_ASSIST, 2=FLTINJ_RETURN, 3=FLTINJ_DAMPING, 4=FLTINJ_ASSTSUMNLMT, 7=FLTINJ_AVGFRICLRN, 12=FLTINJ_HYSTCOMP, 14=FLTINJ_INERTIACOMP, 30=FLTINJ_TRQBASEDINRTCOMP, 29=FLTINJ_STABILITYCOMP, 33=FLTINJ_SRLCOMVEHSPD_SGNLCOND, 34=FLTINJ_ASSTFIREWALL, 150=FLTINJ_DDASTFACTRQST_DRVDYNCTRL, 151=FLTINJ_DDDMPFACTRQST_DRVDYNCTRL, 152=FLTINJ_DDRTNFACTRQST_DRVDYNCTRL, 38=FLTINJ_ASSTEOTGAIN_LMTCOD, 153=FLTINJ_OUTPUTRAMPMULT_LMTCOD, 154=FLTINJ_ASSTEOTLIMIT_LMTCOD, 8=FLTINJ_VECU_BATTERYVOLTAGE, 27=FLTINJ_EOTDAMPING_ETDMPFW, 155=FLTINJ_SRLCOMVEHLONACCEL_SGNLCOND, 156=FLTINJ_ANAHWTORQUE, 160=FLTINJ_MTRVEL, 101=FLTINJ_TRQARBLIM_LKACMD, 91=FLTINJ_TRQOVLSTA_LKAFAULT, 200=FLTINJ_PRKASTMFGSERVCH2_PRKASSISTCMD, 201=FLTINJ_PRKASTMFGSERVCH2_LRNPNCNTR, 41=FLTINJ_DIGHWTRQSENT_T1FAULT, 42=FLTINJ_DIGHWTRQSENT_T2FAULT, 46=FLTINJ_GCCDIAG_HWTRQ, 146=FLTINJ_GCCDIAG_VEHSPD, 246=FLTINJ_GCCDIAG_MTRTRQ, 100=FLTINJ_SRLCOMVEHYAWRATE_SGNLCOND, 255=FLTINJ_SRLCOMVEHLATACCEL_SGNLCOND, 25=FLTINJ_SUPPPWRLMT_CUSTPL, 43=FLTINJ_TRQOSC_PREFINALCOMMAND}
      lower-limit=0
      upper-limit=255
    Haptic_State_enum: compu {0=Haptic_Inactive, 1=Haptic_Active, 2=Haptic_Waiting}, lower-limit=0, upper-limit=2
    IoHwAb_BoolType: lower-limit=0, upper-limit=1
    LKA_State_enum: compu {0=LKA_Inactive, 1=LKA_Active, 2=LKA_TemporarilyLimited, 3=LKA_PermanentlyFailed, 4=LKA_ManufacturingDisable}, lower-limit=0, upper-limit=4
    LOA_State_enum: compu {0=LOAST_NORM, 1=LOAST_REDCD, 2=LOAST_SWBASDMTGTN, 3=LOAST_FADEOUT, 4=LOAST_CTRLDSHTDWNREQD, 5=LOAST_RPDSHTDWNREQD}, lower-limit=0, upper-limit=5
    ManufModeType: compu {0=ProductionMode, 1=ManufacturingMode, 2=EngineeringMode}, lower-limit=0, upper-limit=2
    MtrCurrOffProcessFlag: compu {0=CURROFF_INIT, 1=CURROFF_PROCESSING, 2=CURROFF_PASS, 3=CURROFF_FAIL}, lower-limit=0, upper-limit=4
    NTCNumber:
      compu {1=NTC_Num_FlashWrapperLgcFlt, 2=NTC_Num_FlashECCCorr, 3=NTC_Num_FlashECCMemFlt, 4=NTC_Num_FlashCRCMemFault, 6=NTC_Num_NvMBlkDftActA, 7=NTC_Num_NvMBlkDftActB, 8=NTC_Num_NvMBlkDftActC, 9=NTC_Num_CurrentSensorCalOutOfRange, 10=NTC_Num_EEPROMDiag, 11=NTC_Num_EEPROMDiagMtrStr, 12=NTC_Num_PriSnsrTrqStorFlt, 13=NTC_Num_EEPROMDiagPosTrimStr, 14=NTC_Num_SecSnsrTrqStorFlt, 15=NTC_Num_EEPROMDiagPolarityStr, 16=NTC_Num_RAMDiag_GeneralFlt, 17=NTC_Num_RAMDiag_WrprLgcFlt, 18=NTC_Num_RAMDiag_ECCCorrIndFlt, 19=NTC_Num_RAMDiag_ECCMemFlt, 20=NTC_Num_RAMDiag_CRCMemFlt, 23=NTC_Num_RAMDiag_VIMRamFlt, 24=NTC_Num_RAMDiag_NHET1RamFlt, 25=NTC_Num_RAMDiag_NHET2RamFlt, 26=NTC_Num_RAMDiag_ADC1RamFlt, 27=NTC_Num_RAMDiag_DCANRamFault, 28=NTC_Num_RAMDiag_ADC2RamFlt, 29=NTC_Num_RAMDiag_HETTU1RamFlt, 30=NTC_Num_RAMDiag_HETTU2RamFlt, 32=NTC_Num_CPU_RegVer, 33=NTC_Num_CPU_CoreInitFlt, 34=NTC_Num_CPU_CoreRunTimeFlt, 35=NTC_Num_CPU_ClockMon, 36=NTC_Num_CPU_eFuseFlt, 37=NTC_Num_CPU_MPUViolation, 40=NTC_Num_CPU_FactPrcsErr, 41=NTC_Num_PropExeDiag_InitDiag, 42=NTC_Num_PrgFlwDeadlnFlt, 43=NTC_Num_PropExeDiag_RunTimeDiag, 44=NTC_Num_PropExeDiag_COPTimeout, 48=NTC_Num_PropExeDiag_PrefetchAbort, 49=NTC_Num_PropExeDiag_DataAbort, 50=NTC_Num_PerDiag_ADC1Flt, 51=NTC_Num_PerDiag_ADC2Flt, 52=NTC_Num_PerDiag_ADCCrossChkFlt, 53=NTC_Num_PerDiag_IllegalAccess, 54=NTC_Num_PerDiag_DMAFlt, 55=NTC_Num_PeripheralStartupFlt, 63=NTC_Num_PerDiag_CPUWarning, 64=NTC_Num_TmpMonFunc, 65=NTC_Num_TmpMonRunTimeFlt, 66=NTC_Num_PowerRelayInitFlt, 67=NTC_Num_PrechargeFailure, 68=NTC_Num_PowerRelayRunFlt, 69=NTC_Num_Thermistor, 70=NTC_Num_RefSupplyVltg, 71=NTC_Num_TrcvrInterfaceFlt, 72=NTC_Num_CPUSupplyOvervoltage, 76=NTC_Num_GateDrvFltInProcess, 77=NTC_Num_GateDrvFlt, 78=NTC_Num_OnStateSingleFET, 79=NTC_Num_OnStateMultiFET, 80=NTC_Num_PhaseVoltageVerf, 81=NTC_Num_PhaseDscnt, 82=NTC_Num_DigPhaseVoltageVerf, 83=NTC_Num_PhaseDscntFailedDisable, 84=NTC_Num_CurrentMeas1, 85=NTC_Num_CurrentMeas2, 86=NTC_Num_CurrentMeasCrossChk, 87=NTC_Num_PDSupplyOverVoltage, 88=NTC_Num_ChargePumpUnderVoltage, 96=NTC_Num_HwTrqSensor, 97=NTC_Num_AnaVsDigHwTrq, 98=NTC_Num_TrqSensorRecoveryFlt, 100=NTC_Num_TrqSensorScaleInvalid, 101=NTC_Num_T1vsT2, 102=NTC_Num_T1OutofRange, 103=NTC_Num_T2OutofRange, 104=NTC_Num_DigT1vsT2, 105=NTC_Num_DigT1OutofRange, 106=NTC_Num_DigT2OutofRange, 107=NTC_Num_RedT1vsT2, 108=NTC_Num_HWACrossChecks, 109=NTC_Num_HWASnsrCommFault, 110=NTC_Num_HWASensorRel, 111=NTC_Num_HWASensorAbs, 112=NTC_Num_PriMSB_SinCosCorr, 113=NTC_Num_SecMSB_SinCosCorr, 114=NTC_Num_PriVsSec_SinCosCorr, 115=NTC_Num_DigMSBFlt, 116=NTC_Num_MtrVelFlt, 117=NTC_Num_HWAtoMtrAngleCorr, 118=NTC_Num_RedPriVsSec_SinCosCorr, 128=NTC_Num_TurnCntr_PosLoss, 129=NTC_Num_TurnCntr_MicroProcFlt, 130=NTC_Num_TurnCntr_SensorPosFlt, 131=NTC_Num_TurnCntr_SpiComFlt, 132=NTC_Num_TurnCntr_HighQuiescCur, 133=NTC_Num_TurnCntr_MainResets, 134=NTC_Num_TurnCntr_PosLossNotSpdDep, 144=NTC_Num_KinematicIntDiag, 145=NTC_Num_HighFriction, 148=NTC_Num_DutyCycleExceeded, 149=NTC_Num_AbsTempThermLimit, 160=NTC_Num_LatchActive, 168=NTC_Num_OpTrqVsHwTrq, 169=NTC_Num_CurrentReas, 170=NTC_Num_LoaRpdShutdn, 176=NTC_Num_OpVoltage, 177=NTC_Num_ExVoltageLow, 178=NTC_Num_ReducedAsstLowVoltage, 180=NTC_Num_ExVoltageHigh, 181=NTC_Num_OpVoltageOvrMax, 182=NTC_Num_BattTransOverVolt, 184=NTC_Num_IgnConfDiag, 185=NTC_Num_TurnCntr_LowBattery, 191=NTC_Num_EEPROMCloseFailed, 192=NTC_Num_SigPath1CrossChk, 193=NTC_Num_SigPath2CrossChk, 194=NTC_Num_SigPath3CrossChk, 195=NTC_Num_SigPath4CrossChk, 196=NTC_Num_SigPath5CrossChk, 197=NTC_Num_DampingFWReached, 198=NTC_Num_AssistFWReached, 199=NTC_Num_ReturnFWReached, 200=NTC_Num_DampingFWFltMode, 201=NTC_Num_AssistFWFltMode, 202=NTC_Num_VBICFltMode, 203=NTC_Num_StaMdsSysC, 204=NTC_NUM_SysFailureForRotVel, 205=NTC_NUM_SysFailForRedntRotVel, 206=NTC_Num_SysFailureForTrqSnsr, 207=NTC_Num_SysFailureForRedTrqSnsr, 209=NTC_NUM_SysFailureForCtrlVolt, 223=NTC_Num_GlblSgnlOvrwrtDet, 224..255=NTC_Num_VLF_00..NTC_Num_VLF_31, 256=NTC_Num_BusOffCh1, 257=NTC_Num_BusOffCh1NodeMute, 258=NTC_Num_Node1AAbsent, 259=NTC_Num_Node1AFaulty, 260=NTC_Num_Node1BAbsent, 261=NTC_Num_Node1BFaulty, 262=NTC_Num_Node1CAbsent, 263=NTC_Num_Node1CFaulty, 264=NTC_Num_Node1DAbsent, 265=NTC_Num_Node1DFaulty, 266=NTC_Num_Node1EAbsent, 267=NTC_Num_Node1EFaulty, 268=NTC_Num_Node1FAbsent, 269=NTC_Num_Node1FFaulty, 270=NTC_Num_Node1GAbsent, 271=NTC_Num_Node1GFaulty, 272=NTC_Num_BusOffCh2, 273=NTC_Num_Node2AAbsent, 274=NTC_Num_Node2AFaulty, 275=NTC_Num_Node2BAbsent, 276=NTC_Num_Node2BFaulty, 277=NTC_Num_Node2CAbsent, 278=NTC_Num_Node2CFaulty, 279=NTC_Num_Node2DAbsent, 280=NTC_Num_Node2DFaulty, 281=NTC_Num_Node2EAbsent, 282=NTC_Num_Node2EFaulty, 283=NTC_Num_Node2FAbsent, 284=NTC_Num_Node2FFaulty, 285=NTC_Num_Node2GAbsent, 286=NTC_Num_Node2GFaulty, 288=NTC_Num_InvalidMsg_M, 289=NTC_Num_MissingMsg_M, 290=NTC_Num_CRCFltMsg_M, 291=NTC_Num_PgrsCntFltMsg_M, 292=NTC_Num_DataRngFltMsg_M, 293=NTC_Num_DataRateFltMsg_M, 294=NTC_Num_DataOtherFltMsg_M, 295=NTC_Num_DataOther2FltMsg_M, 296=NTC_Num_InvalidMsg_N, 297=NTC_Num_MissingMsg_N, 298=NTC_Num_CRCFltMsg_N, 299=NTC_Num_PgrsCntFltMsg_N, 300=NTC_Num_DataRngFltMsg_N, 301=NTC_Num_DataRateFltMsg_N, 302=NTC_Num_DataOtherFltMsg_N, 303=NTC_Num_DataOtherFlt2Msg_N, 304=NTC_Num_InvalidMsg_O, 305=NTC_Num_MissingMsg_O, 306=NTC_Num_CRCFltMsg_O, 307=NTC_Num_PgrsCntFltMsg_O, 308=NTC_Num_DataRngFltMsg_O, 309=NTC_Num_DataRateFltMsg_O, 310=NTC_Num_DataOtherFltMsg_O, 312=NTC_Num_InvalidMsg_P, 313=NTC_Num_MissingMsg_P, 314=NTC_Num_CRCFltMsg_P, 315=NTC_Num_PgrsCntFltMsg_P, 316=NTC_Num_DataRngFltMsg_P, 317=NTC_Num_DataRateFltMsg_P, 318=NTC_Num_DataOtherFltMsg_P, 320=NTC_Num_InvalidMsg_Q, 321=NTC_Num_MissingMsg_Q, 322=NTC_Num_CRCFltMsg_Q, 323=NTC_Num_PgrsCntFltMsg_Q, 324=NTC_Num_DataRngFltMsg_Q, 325=NTC_Num_DataRateFltMsg_Q, 326=NTC_Num_DataOtherFltMsg_Q, 328=NTC_Num_InvalidMsg_R, 329=NTC_Num_MissingMsg_R, 330=NTC_Num_CRCFltMsg_R, 331=NTC_Num_PgrsCntFltMsg_R, 332=NTC_Num_DataRngFltMsg_R, 333=NTC_Num_DataRateFltMsg_R, 334=NTC_Num_DataOtherFltMsg_R, 335=NTC_Num_DataOtherFlt2Msg_R, 336=NTC_Num_InvalidMsg_S, 337=NTC_Num_MissingMsg_S, 338=NTC_Num_CRCFltMsg_S, 339=NTC_Num_PgrsCntFltMsg_S, 340=NTC_Num_DataRngFltMsg_S, 341=NTC_Num_DataRateFltMsg_S, 342=NTC_Num_DataOtherFltMsg_S, 344=NTC_Num_InvalidMsg_T, 345=NTC_Num_MissingMsg_T, 346=NTC_Num_CRCFltMsg_T, 347=NTC_Num_PgrsCntFltMsg_T, 348=NTC_Num_DataRngFltMsg_T, 349=NTC_Num_DataRateFltMsg_T, 350=NTC_Num_DataOtherFltMsg_T, 352=NTC_Num_InvalidMsg_U, 353=NTC_Num_MissingMsg_U, 354=NTC_Num_CRCFltMsg_U, 355=NTC_Num_PgrsCntFltMsg_U, 356=NTC_Num_DataRngFltMsg_U, 357=NTC_Num_DataRateFltMsg_U, 358=NTC_Num_DataOtherFltMsg_U, 360=NTC_Num_InvalidMsg_V, 361=NTC_Num_MissingMsg_V, 362=NTC_Num_CRCFltMsg_V, 363=NTC_Num_PgrsCntFltMsg_V, 364=NTC_Num_DataRngFltMsg_V, 365=NTC_Num_DataRateFltMsg_V, 366=NTC_Num_DataOtherFltMsg_V, 368=NTC_Num_InvalidMsg_W, 369=NTC_Num_MissingMsg_W, 370=NTC_Num_CRCFltMsg_W, 371=NTC_Num_PgrsCntFltMsg_W, 372=NTC_Num_DataRngFltMsg_W, 373=NTC_Num_DataRateFltMsg_W, 374=NTC_Num_DataOtherFltMsg_W, 376=NTC_Num_InvalidMsg_X, 377=NTC_Num_MissingMsg_X, 378=NTC_Num_CRCFltMsg_X, 379=NTC_Num_PgrsCntFltMsg_X, 380=NTC_Num_DataRngFltMsg_X, 381=NTC_Num_DataRateFltMsg_X, 382=NTC_Num_DataOtherFltMsg_X, 384=NTC_Num_InvalidMsg_Y, 385=NTC_Num_MissingMsg_Y, 386=NTC_Num_CRCFltMsg_Y, 387=NTC_Num_PgrsCntFltMsg_Y, 388=NTC_Num_DataRngFltMsg_Y, 389=NTC_Num_DataRateFltMsg_Y, 390=NTC_Num_DataOtherFltMsg_Y, 392=NTC_Num_InvalidMsg_Z, 393=NTC_Num_MissingMsg_Z, 394=NTC_Num_CRCFltMsg_Z, 395=NTC_Num_PgrsCntFltMsg_Z, 396=NTC_Num_DataRngFltMsg_Z, 397=NTC_Num_DataRateFltMsg_Z, 398=NTC_Num_DataOtherFltMsg_Z, 399=NTC_Num_DSTXORActive, 400=NTC_Num_InvalidMsg_AA, 401=NTC_Num_MissingMsg_AA, 402=NTC_Num_CRCFltMsg_AA, 403=NTC_Num_PgrsCntFltMsg_AA, 404=NTC_Num_DataRngFltMsg_AA, 405=NTC_Num_DataRateFltMsg_AA, 406=NTC_Num_DataOtherFltMsg_AA, 408=NTC_Num_InvalidMsg_AB, 409=NTC_Num_MissingMsg_AB, 410=NTC_Num_CRCFltMsg_AB, 411=NTC_Num_PgrsCntFltMsg_AB, 412=NTC_Num_DataRngFltMsg_AB, 413=NTC_Num_DataRateFltMsg_AB, 414=NTC_Num_DataOtherFltMsg_AB, 416=NTC_Num_InvalidMsg_AC, 417=NTC_Num_MissingMsg_AC, 418=NTC_Num_CRCFltMsg_AC, 419=NTC_Num_PgrsCntFltMsg_AC, 420=NTC_Num_DataRngFltMsg_AC, 421=NTC_Num_DataRateFltMsg_AC, 422=NTC_Num_DataOtherFltMsg_AC, 424=NTC_Num_InvalidMsg_AD, 425=NTC_Num_MissingMsg_AD, 426=NTC_Num_CRCFltMsg_AD, 427=NTC_Num_PgrsCntFltMsg_AD, 428=NTC_Num_DataRngFltMsg_AD, 429=NTC_Num_DataRateFltMsg_AD, 430=NTC_Num_DataOtherFltMsg_AD, 432=NTC_Num_InvalidMsg_AE, 433=NTC_Num_MissingMsg_AE, 434=NTC_Num_CRCFltMsg_AE, 435=NTC_Num_PgrsCntFltMsg_AE, 436=NTC_Num_DataRngFltMsg_AE, 437=NTC_Num_DataRateFltMsg_AE, 438=NTC_Num_DataOtherFltMsg_AE, 440=NTC_Num_InvalidMsg_AF, 441=NTC_Num_MissingMsg_AF, 442=NTC_Num_CRCFltMsg_AF, 443=NTC_Num_PgrsCntFltMsg_AF, 444=NTC_Num_DataRngFltMsg_AF, 445=NTC_Num_DataRateFltMsg_AF, 446=NTC_Num_DataOtherFltMsg_AF, 448=NTC_Num_InvalidMsg_AG, 449=NTC_Num_MissingMsg_AG, 450=NTC_Num_CRCFltMsg_AG, 451=NTC_Num_PgrsCntFltMsg_AG, 452=NTC_Num_DataRngFltMsg_AG, 453=NTC_Num_DataRateFltMsg_AG, 454=NTC_Num_DataOtherFltMsg_AG, 456=NTC_Num_InvalidMsg_AH, 457=NTC_Num_MissingMsg_AH, 458=NTC_Num_CRCFltMsg_AH, 459=NTC_Num_PgrsCntFltMsg_AH, 460=NTC_Num_DataRngFltMsg_AH, 461=NTC_Num_DataRateFltMsg_AH, 462=NTC_Num_DataOtherFltMsg_AH, 464=NTC_Num_InvalidMsg_ParkAssistParallel (For C1XX), 465=NTC_Num_FlexrayCommunicationError, 466=NTC_Num_InvalidMsg_AI, 467=NTC_Num_MissingMsg_AI, 472=NTC_Num_InvalidMsg_AJ, 473=NTC_Num_MissingMsg_AJ, 480=NTC_Num_InvalidMsg_AK, 481=NTC_Num_MissingMsg_AK, 489=NTC_Num_MissingMsg_AL, 496=NTC_Num_SysConsistencyVerf, 497=NTC_Num_ConfigMisMatch, 498=NTC_Num_CalNotPrgmd, 499=NTC_Num_TunSetNotPrgmd, 501=NTC_Num_EOLVehTunNtPerf, 502=NTC_Num_MtrSensorNotTrimmed, 504=NTC_Num_HWASensorNotTrimmed, 505=NTC_Num_HWASensorTrimNoAttempt, 506=NTC_Num_TrqSensorScaleNotSet, 507=NTC_Num_TrqSensorNotTrimmed, 509=NTC_Num_DigTrqSensorScaleNotSet, 510=NTC_Num_DigTrqSensorNotTrimmed, 500=NTC_Num_EEPROMtoFeeCpyError, 171=NTC_Num_LoaCtrldShutdn, 172=NTC_Num_LoaMgr_HwTqIdptSigTooLow, 173=NTC_Num_LoaMgr_MotAgIdptSigTooLow, 174=NTC_Num_LoaMgr_MotCurrIdptSigTooLow, 175=NTC_Num_LoaMgr_IvtrIdptSigTooLow, 508=NTC_Num_AnaHWDiffTqOfstNotTrmd, 511=NTC_Num_SENTHWDiffTqOfstNotTrmd, 73=NTC_Num_BattVltgMeasdCorrlnFlt, 74=NTC_Num_IvtrPwrDiscnctFailr, 92=NTC_Num_Inv2GateDrvFltInProcess, 93=NTC_Num_Inv2GateDrvFlt, 94=NTC_Num_Inv2OnStateSingleFET, 75=NTC_Num_PowerRelayInit2Flt}
      lower-limit=0
      upper-limit=511
    NvM_BlockIdType: lower-limit=1, upper-limit=32767  # It is the type to be used in the "Port Defined Arguments". According to the NVM API it must result in an uint16 data type; thus the upper limit does not correspond to the number of configured blocks. Therefore the this type is common to all NVM SWC Descriptions. The upper limit is the theoretical maximum number of NVRAM blocks, if NVM_DATASET_SELECTION_BITS equals to 1. (It cannot be 0 since block Id 1 is fixed to be a REDUNDANT NVRAM Block - it consists of two NV blocks)
    NvM_RequestResultType: compu {0=NVM_REQ_OK, 1=NVM_REQ_NOT_OK, 2=NVM_REQ_PENDING, 3=NVM_REQ_INTEGRITY_FAILED, 4=NVM_REQ_BLOCK_SKIPPED, 5=NVM_REQ_NV_INVALIDATED}, lower-limit=0, upper-limit=5
    NxtrDiagMgrStatus: compu {0=NTC_STATUS_PASSED, 1=NTC_STATUS_FAILED, 2=NTC_STATUS_PREPASSED, 3=NTC_STATUS_PREFAILED}, lower-limit=0, upper-limit=255
    NxtrOpCycle: compu {0=NxtrDefaultOpCycle}, lower-limit=0, upper-limit=0
    NxtrOpCycleState: compu {1=NXTR_CYCLE_STATE_START, 2=NXTR_CYCLE_STATE_END}, lower-limit=1, upper-limit=2
    SigQlfr_State_enum: compu {0=SIGQLFR_NORES, 1=SIGQLFR_PASS, 2=SIGQLFR_FAIL}, lower-limit=0, upper-limit=2
    SInt4: lower-limit=-8, upper-limit=7  # SInt4 represents integers with a minimum value of -8 and a maximum value of 7. The order-relation on SInt4 is: x < y if y - x is positive. SInt4 has a lexical representation consisting of an optional sign followed by a finite-length sequence of decimal digits (#x30-#x39). If the sign is omitted, "+" is assumed. For example: -1, 0, 2, +4.
    StaMd_Users: compu {0=STAMD_STOPCTRL, 1=STAMD_VEHPWRMD, 2=STAMD_DIAGMGR, 3=STAMD_PHSDSCNCT, 4=STAMD_MTRDRVR, 5=STAMD_TMPRLMON, 6=STAMD_HWPWUP, 7=STAMD_MTRPOSDIAG}, lower-limit=0, upper-limit=15
    TuningSessionAddrPtrEnum: compu {0=TUN_SESSION_PTR_PERS, 1=TUN_SESSION_PTR_SETS, 2=TUN_SESSION_PTR_COMMON, 255=TUN_SESSION_PTR_DISABLED}, lower-limit=0, upper-limit=255
    UInt4: lower-limit=0, upper-limit=15  # UInt4 represents integers with a minimum value of 0 and a maximum value of 15. The order-relation on UInt4 is: x < y if y - x is positive. UInt4 has a lexical representation consisting of a finite-length sequence of decimal digits (#x30-#x39). For example: 1, 0, 12, +10.
    WdgM_CheckpointIdType: lower-limit=0, upper-limit=65535
    WdgM_GlobalStatusType: compu {0=WDGM_GLOBAL_STATUS_OK, 1=WDGM_GLOBAL_STATUS_FAILED, 2=WDGM_GLOBAL_STATUS_EXPIRED, 3=WDGM_GLOBAL_STATUS_STOPPED, 4=WDGM_GLOBAL_STATUS_DEACTIVATED}, lower-limit=0, upper-limit=255
    WdgM_LocalStatusType: compu {0=WDGM_LOCAL_STATUS_OK, 1=WDGM_LOCAL_STATUS_FAILED, 2=WDGM_LOCAL_STATUS_EXPIRED, 4=WDGM_LOCAL_STATUS_DEACTIVATED}, lower-limit=0, upper-limit=255
    WdgM_ModeType: lower-limit=0, upper-limit=255
    WdgM_SupervisedEntityIdType: lower-limit=0, upper-limit=65535
  17 x record type:
    AvgFricLrnType
      8 x record element:
        FricOffset_HwNm_f32: type=Float
        EOLFric_HwNm_f32: type=Float
        EnableFricOffsetOutput_Cnt_lgc: type=Boolean
        EnableFricLearning_Cnt_lgc: type=Boolean
        OpMode_Cnt_enum: type=UInt8
        RangeCounter_Cnt_u16: type=AvgFricLrnRangeCounterType
        Theta_HwNm_f32: type=AvgFricLrnThetaType
        VehLearnedFric_HwNm_f32: type=AvgFricLrnVehLearnedFricType
    CurrTempOffsetType
      record element CurrTempOffsetX_DegC_s10p5: type=CurrTempOffsetTblType
      record element CurrOffsetY1_Volts_s4p11: type=CurrTempOffsetTblType
      record element CurrOffsetY2_Volts_s4p11: type=CurrTempOffsetTblType
    DiagSettings_Str
      record element Threshold: type=UInt16
      record element PStep: type=UInt16
      record element NStep: type=UInt16
    DigColPsEOLType
      6 x record element:
        ColTrim_Deg_f32: type=Float
        R_ColTrim_Cnt_u32: type=UInt32
        SpurTrim_Deg_f32: type=Float
        R_SpurTrim_Cnt_u32: type=UInt32
        TrimComp_Cnt_u16: type=UInt16
        R_TrimCom_Cnt_u16: type=UInt16
    DigHwTrqSENTTrim_DataType
      record element k_EOLHwTrqTrim_HwNm_f32: type=Float
      record element k_EOLHwTrqTrimPerformed_Cnt_Lgc: type=Boolean
    DigMSBEOLType
      5 x record element:
        MtrPosBEMF_Rev_u0p16: type=UInt16
        MtrPosBEMFRedundant_Rev_u0p16: type=UInt16
        MtrPos1HarCompTbl_Rev_s2p13: type=HarCompTbl
        MtrPos2HarCompTbl_Rev_s2p13: type=HarCompTbl
        CRC_Cnt_u16: type=UInt16
    EOLHwPosTrimType
      record element EOLVehCntrOffset_HwDeg_f32: type=Float
      record element EOLHwPosTrimPerformed_Cnt_u16: type=UInt16
    EOLNomMtrParamType
      record element NomKe_VpRadpS_f32: type=Float
      record element NomRmtr_Ohm_f32: type=Float
    EOTLearned_DataType
      4 x record element:
        CWEOTPosition_HwDeg_f32: type=Float
        CCWEOTPosition_HwDeg_f32: type=Float
        CWEOTFound_Cnt_lgc: type=Boolean
        CCWEOTFound_Cnt_lgc: type=Boolean
    MtrPos2Cal_DataType
      6 x record element:
        Sin2Offset_Volts_u3p13: type=UInt16
        Sin2AmpRec_Uls_u3p13: type=UInt16
        Cos2Offset_Volts_u3p13: type=UInt16
        Cos2AmpRec_Uls_u3p13: type=UInt16
        SinDelta2_Uls_s2p13: type=SInt16
        CosDelta2Rec_Uls_u3p13: type=UInt16
    MtrPos3Cal_DataType
      7 x record element:
        BEMFCal_Rev_u0p16: type=UInt16
        Sin3Offset_Volts_u3p13: type=UInt16
        Sin3AmpRec_Uls_u3p13: type=UInt16
        Cos3Offset_Volts_u3p13: type=UInt16
        Cos3AmpRec_Uls_u3p13: type=UInt16
        SinDelta3_Uls_s2p13: type=SInt16
        CosDelta3Rec_Uls_u3p13: type=UInt16
    MtrPosCal_DataType
      14 x record element:
        BEMFCal_Rev_u0p16: type=UInt16
        R_BEMFCal_Rev_u0p16: type=UInt16
        Sin1Offset_Volts_u3p13: type=UInt16
        Sin1AmpRec_Uls_u3p13: type=UInt16
        Cos1Offset_Volts_u3p13: type=UInt16
        Cos1AmpRec_Uls_u3p13: type=UInt16
        SinDelta1_Uls_s2p13: type=SInt16
        CosDelta1Rec_Uls_u3p13: type=UInt16
        Sin1OffCorr_Volts_s2p13: type=SInt16
        Sin1GainCorr_Uls_u1p15: type=UInt16
        Cos1OffCorr_Volts_s2p13: type=SInt16
        Cos1GainCorr_Uls_u1p15: type=UInt16
        SinHarTbl_Cnt_sm6p13: type=DT_Array144_s8
        CosHarTbl_Cnt_sm6p13: type=DT_Array144_s8
    OvervoltageDataType
      record element MaxBattVoltage_Volts_f32: type=Float
      record element OvervoltageCounter_Cnt_u16: type=UInt16
    PhaseCurrCal_DataType
      7 x record element, all with type=Float:
        EOLMtrCurrVcalCmd_VoltCnts_f32
        EOLMtrCurr1OffsetLo_Volts_f32
        EOLPhscurr1Gain_AmpspVolt_f32
        EOLPhscurr2Gain_AmpspVolt_f32
        EOLMtrCurr2OffsetLo_Volts_f32
        EOLMtrCurr1OffsetDiff_Volts_f32
        EOLMtrCurr2OffsetDiff_Volts_f32
    Polarity_DataType
      record element Polarity_Cnt_b08: type=UInt8
      record element R_Polarity_Cnt_b08: type=UInt8
    ThrmlDutyCycle_FltStVal_Datatype
      4 x record element, all with type=UInt8:
        Filt{3..6}Val_Cnt_u8
    VehDyn_DataType
      record element NVMStoredLastPos_HwDeg_f32: type=Float
      record element NVMStoredLastPosValid_Cnt_lgc: type=Boolean
package /DataType/DataTypeUnits
  unit deg: display-name=deg
  unit degps: display-name=degps
  unit kph: display-name=kph
