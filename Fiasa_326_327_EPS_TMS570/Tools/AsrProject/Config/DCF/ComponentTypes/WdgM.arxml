AUTOSAR XML (schema 314)
package /ComponentType
  internal behavior WdgM_InternalBehavior: component=WdgM
    54 x operation invoked event:
      OIT_ActivateSupervisionEntity_SE000_SE_100ms_10_ActivateSupervisionEntity: start-on-event=ActivateSupervisionEntity, operation=SE000_SE_100ms_10.ActivateSupervisionEntity
      OIT_ActivateSupervisionEntity_SE001_SE_100ms_8_ActivateSupervisionEntity: start-on-event=ActivateSupervisionEntity, operation=SE001_SE_100ms_8.ActivateSupervisionEntity
      OIT_ActivateSupervisionEntity_SE002_SE_100ms_9_ActivateSupervisionEntity: start-on-event=ActivateSupervisionEntity, operation=SE002_SE_100ms_9.ActivateSupervisionEntity
      OIT_ActivateSupervisionEntity_SE003_SE_10ms_10_ActivateSupervisionEntity: start-on-event=ActivateSupervisionEntity, operation=SE003_SE_10ms_10.ActivateSupervisionEntity
      OIT_ActivateSupervisionEntity_SE004_SE_10ms_9_ActivateSupervisionEntity: start-on-event=ActivateSupervisionEntity, operation=SE004_SE_10ms_9.ActivateSupervisionEntity
      OIT_ActivateSupervisionEntity_SE005_SE_4ms_10_ActivateSupervisionEntity: start-on-event=ActivateSupervisionEntity, operation=SE005_SE_4ms_10.ActivateSupervisionEntity
      OIT_ActivateSupervisionEntity_SE006_SE_4ms_9_ActivateSupervisionEntity: start-on-event=ActivateSupervisionEntity, operation=SE006_SE_4ms_9.ActivateSupervisionEntity
      OIT_ActivateSupervisionEntity_SE007_SE_2ms_10_ActivateSupervisionEntity: start-on-event=ActivateSupervisionEntity, operation=SE007_SE_2ms_10.ActivateSupervisionEntity
      OIT_ActivateSupervisionEntity_SE008_SE_2ms_8_ActivateSupervisionEntity: start-on-event=ActivateSupervisionEntity, operation=SE008_SE_2ms_8.ActivateSupervisionEntity
      OIT_ActivateSupervisionEntity_SE009_SE_2ms_9_ActivateSupervisionEntity: start-on-event=ActivateSupervisionEntity, operation=SE009_SE_2ms_9.ActivateSupervisionEntity
      OIT_CheckpointReached_SE000_SE_100ms_10_CP000_ChkPtAp10_100msStart_CP_CheckpointReached: start-on-event=CheckpointReached, operation=SE000_SE_100ms_10_CP000_ChkPtAp10_100msStart_CP.CheckpointReached
      OIT_CheckpointReached_SE000_SE_100ms_10_CP001_ChkPtAp10_100msEnd_CP_CheckpointReached: start-on-event=CheckpointReached, operation=SE000_SE_100ms_10_CP001_ChkPtAp10_100msEnd_CP.CheckpointReached
      OIT_CheckpointReached_SE001_SE_100ms_8_CP000_ChkPtAp8_100msStart_CP_CheckpointReached: start-on-event=CheckpointReached, operation=SE001_SE_100ms_8_CP000_ChkPtAp8_100msStart_CP.CheckpointReached
      OIT_CheckpointReached_SE001_SE_100ms_8_CP001_ChkPtAp8_100msEnd_CP_CheckpointReached: start-on-event=CheckpointReached, operation=SE001_SE_100ms_8_CP001_ChkPtAp8_100msEnd_CP.CheckpointReached
      OIT_CheckpointReached_SE002_SE_100ms_9_CP000_ChkPtAp9_100msStart_CP_CheckpointReached: start-on-event=CheckpointReached, operation=SE002_SE_100ms_9_CP000_ChkPtAp9_100msStart_CP.CheckpointReached
      OIT_CheckpointReached_SE002_SE_100ms_9_CP001_ChkPtAp9_100msEnd_CP_CheckpointReached: start-on-event=CheckpointReached, operation=SE002_SE_100ms_9_CP001_ChkPtAp9_100msEnd_CP.CheckpointReached
      OIT_CheckpointReached_SE003_SE_10ms_10_CP000_ChkPtAp10_10msStart_CP_CheckpointReached: start-on-event=CheckpointReached, operation=SE003_SE_10ms_10_CP000_ChkPtAp10_10msStart_CP.CheckpointReached
      OIT_CheckpointReached_SE003_SE_10ms_10_CP001_ChkPtAp10_10msEnd_CP_CheckpointReached: start-on-event=CheckpointReached, operation=SE003_SE_10ms_10_CP001_ChkPtAp10_10msEnd_CP.CheckpointReached
      OIT_CheckpointReached_SE004_SE_10ms_9_CP000_ChkPtAp9_10msStart_CP_CheckpointReached: start-on-event=CheckpointReached, operation=SE004_SE_10ms_9_CP000_ChkPtAp9_10msStart_CP.CheckpointReached
      OIT_CheckpointReached_SE004_SE_10ms_9_CP001_ChkPtAp9_10msEnd_CP_CheckpointReached: start-on-event=CheckpointReached, operation=SE004_SE_10ms_9_CP001_ChkPtAp9_10msEnd_CP.CheckpointReached
      OIT_CheckpointReached_SE005_SE_4ms_10_CP000_ChkPtAp10_4msStart_CP_CheckpointReached: start-on-event=CheckpointReached, operation=SE005_SE_4ms_10_CP000_ChkPtAp10_4msStart_CP.CheckpointReached
      OIT_CheckpointReached_SE005_SE_4ms_10_CP001_ChkPtAp10_4msEnd_CP_CheckpointReached: start-on-event=CheckpointReached, operation=SE005_SE_4ms_10_CP001_ChkPtAp10_4msEnd_CP.CheckpointReached
      OIT_CheckpointReached_SE006_SE_4ms_9_CP000_ChkPtAp9_4msStart_CP_CheckpointReached: start-on-event=CheckpointReached, operation=SE006_SE_4ms_9_CP000_ChkPtAp9_4msStart_CP.CheckpointReached
      OIT_CheckpointReached_SE006_SE_4ms_9_CP001_ChkPtAp9_4msEnd_CP_CheckpointReached: start-on-event=CheckpointReached, operation=SE006_SE_4ms_9_CP001_ChkPtAp9_4msEnd_CP.CheckpointReached
      OIT_CheckpointReached_SE007_SE_2ms_10_CP000_ChkPtAp10_2msStart_CP_CheckpointReached: start-on-event=CheckpointReached, operation=SE007_SE_2ms_10_CP000_ChkPtAp10_2msStart_CP.CheckpointReached
      OIT_CheckpointReached_SE007_SE_2ms_10_CP001_ChkPtAp10_2msEnd_CP_CheckpointReached: start-on-event=CheckpointReached, operation=SE007_SE_2ms_10_CP001_ChkPtAp10_2msEnd_CP.CheckpointReached
      OIT_CheckpointReached_SE007_SE_2ms_10_CP002_GlbFinal_CP0_CheckpointReached: start-on-event=CheckpointReached, operation=SE007_SE_2ms_10_CP002_GlbFinal_CP0.CheckpointReached
      OIT_CheckpointReached_SE008_SE_2ms_8_CP000_ChkPtAp8_2msStart_CP_CheckpointReached: start-on-event=CheckpointReached, operation=SE008_SE_2ms_8_CP000_ChkPtAp8_2msStart_CP.CheckpointReached
      OIT_CheckpointReached_SE008_SE_2ms_8_CP001_ChkPtAp8_2msEnd_CP_CheckpointReached: start-on-event=CheckpointReached, operation=SE008_SE_2ms_8_CP001_ChkPtAp8_2msEnd_CP.CheckpointReached
      OIT_CheckpointReached_SE009_SE_2ms_9_CP000_ChkPtAp9_2msStart_CP_CheckpointReached: start-on-event=CheckpointReached, operation=SE009_SE_2ms_9_CP000_ChkPtAp9_2msStart_CP.CheckpointReached
      OIT_CheckpointReached_SE009_SE_2ms_9_CP001_ChkPtAp9_2msEnd_CP_CheckpointReached: start-on-event=CheckpointReached, operation=SE009_SE_2ms_9_CP001_ChkPtAp9_2msEnd_CP.CheckpointReached
      OIT_DeactivateSupervisionEntity_SE000_SE_100ms_10_DeactivateSupervisionEntity: start-on-event=DeactivateSupervisionEntity, operation=SE000_SE_100ms_10.DeactivateSupervisionEntity
      OIT_DeactivateSupervisionEntity_SE001_SE_100ms_8_DeactivateSupervisionEntity: start-on-event=DeactivateSupervisionEntity, operation=SE001_SE_100ms_8.DeactivateSupervisionEntity
      OIT_DeactivateSupervisionEntity_SE002_SE_100ms_9_DeactivateSupervisionEntity: start-on-event=DeactivateSupervisionEntity, operation=SE002_SE_100ms_9.DeactivateSupervisionEntity
      OIT_DeactivateSupervisionEntity_SE003_SE_10ms_10_DeactivateSupervisionEntity: start-on-event=DeactivateSupervisionEntity, operation=SE003_SE_10ms_10.DeactivateSupervisionEntity
      OIT_DeactivateSupervisionEntity_SE004_SE_10ms_9_DeactivateSupervisionEntity: start-on-event=DeactivateSupervisionEntity, operation=SE004_SE_10ms_9.DeactivateSupervisionEntity
      OIT_DeactivateSupervisionEntity_SE005_SE_4ms_10_DeactivateSupervisionEntity: start-on-event=DeactivateSupervisionEntity, operation=SE005_SE_4ms_10.DeactivateSupervisionEntity
      OIT_DeactivateSupervisionEntity_SE006_SE_4ms_9_DeactivateSupervisionEntity: start-on-event=DeactivateSupervisionEntity, operation=SE006_SE_4ms_9.DeactivateSupervisionEntity
      OIT_DeactivateSupervisionEntity_SE007_SE_2ms_10_DeactivateSupervisionEntity: start-on-event=DeactivateSupervisionEntity, operation=SE007_SE_2ms_10.DeactivateSupervisionEntity
      OIT_DeactivateSupervisionEntity_SE008_SE_2ms_8_DeactivateSupervisionEntity: start-on-event=DeactivateSupervisionEntity, operation=SE008_SE_2ms_8.DeactivateSupervisionEntity
      OIT_DeactivateSupervisionEntity_SE009_SE_2ms_9_DeactivateSupervisionEntity: start-on-event=DeactivateSupervisionEntity, operation=SE009_SE_2ms_9.DeactivateSupervisionEntity
      OIT_GetGlobalStatus_Global_GetGlobalStatus: start-on-event=GetGlobalStatus, operation=Global.GetGlobalStatus
      OIT_GetLocalStatus_SE000_SE_100ms_10_GetLocalStatus: start-on-event=GetLocalStatus, operation=SE000_SE_100ms_10.GetLocalStatus
      OIT_GetLocalStatus_SE001_SE_100ms_8_GetLocalStatus: start-on-event=GetLocalStatus, operation=SE001_SE_100ms_8.GetLocalStatus
      OIT_GetLocalStatus_SE002_SE_100ms_9_GetLocalStatus: start-on-event=GetLocalStatus, operation=SE002_SE_100ms_9.GetLocalStatus
      OIT_GetLocalStatus_SE003_SE_10ms_10_GetLocalStatus: start-on-event=GetLocalStatus, operation=SE003_SE_10ms_10.GetLocalStatus
      OIT_GetLocalStatus_SE004_SE_10ms_9_GetLocalStatus: start-on-event=GetLocalStatus, operation=SE004_SE_10ms_9.GetLocalStatus
      OIT_GetLocalStatus_SE005_SE_4ms_10_GetLocalStatus: start-on-event=GetLocalStatus, operation=SE005_SE_4ms_10.GetLocalStatus
      OIT_GetLocalStatus_SE006_SE_4ms_9_GetLocalStatus: start-on-event=GetLocalStatus, operation=SE006_SE_4ms_9.GetLocalStatus
      OIT_GetLocalStatus_SE007_SE_2ms_10_GetLocalStatus: start-on-event=GetLocalStatus, operation=SE007_SE_2ms_10.GetLocalStatus
      OIT_GetLocalStatus_SE008_SE_2ms_8_GetLocalStatus: start-on-event=GetLocalStatus, operation=SE008_SE_2ms_8.GetLocalStatus
      OIT_GetLocalStatus_SE009_SE_2ms_9_GetLocalStatus: start-on-event=GetLocalStatus, operation=SE009_SE_2ms_9.GetLocalStatus
      OIT_GetMode_Global_GetMode: start-on-event=GetMode, operation=Global.GetMode
      OIT_GlobalStateChangeCbk_Global_GlobalStateChangeCbk: start-on-event=GlobalStateChangeCbk, operation=Global.GlobalStateChangeCbk
    timing event TMT_MainFunction: start-on-event=MainFunction, period=0.004
    operation invoked event OIT_PerformReset_Global_PerformReset: start-on-event=PerformReset, operation=Global.PerformReset
    operation invoked event OIT_SetMode_MODE_0_CALLER_ID_0_SetMode: start-on-event=SetMode, operation=MODE_0_CALLER_ID_0.SetMode
    port-api-options port-api-option={enable-take-address=false, indirect-api=false, port=Global}:
      port-api-option enable-take-address=false, indirect-api=false, port=MODE_0_CALLER_ID_0:
        port-arg-values:
          integer literal MODE_0: type=WdgM_ModeType, value=0
          integer literal CALLER_0: type=UInt16, value=0
      port-api-option enable-take-address=false, indirect-api=false, port=SE000_SE_100ms_10:
        port-arg-values:
          integer literal SE000_SE_100ms_10_GLS: type=WdgM_SupervisedEntityIdType, value=0
      port-api-option enable-take-address=false, indirect-api=false, port=SE000_SE_100ms_10_CP000_ChkPtAp10_100msStart_CP:
        port-arg-values:
          integer literal SE000_SE_100ms_10_0: type=WdgM_SupervisedEntityIdType, value=0
          integer literal CP000_ChkPtAp10_100msStart_CP: type=WdgM_CheckpointIdType, value=0
      port-api-option enable-take-address=false, indirect-api=false, port=SE000_SE_100ms_10_CP001_ChkPtAp10_100msEnd_CP:
        port-arg-values:
          integer literal SE000_SE_100ms_10_1: type=WdgM_SupervisedEntityIdType, value=0
          integer literal CP001_ChkPtAp10_100msEnd_CP: type=WdgM_CheckpointIdType, value=1
      port-api-option enable-take-address=false, indirect-api=false, port=SE001_SE_100ms_8:
        port-arg-values:
          integer literal SE001_SE_100ms_8_GLS: type=WdgM_SupervisedEntityIdType, value=1
      port-api-option enable-take-address=false, indirect-api=false, port=SE001_SE_100ms_8_CP000_ChkPtAp8_100msStart_CP:
        port-arg-values:
          integer literal SE001_SE_100ms_8_0: type=WdgM_SupervisedEntityIdType, value=1
          integer literal CP000_ChkPtAp8_100msStart_CP: type=WdgM_CheckpointIdType, value=0
      port-api-option enable-take-address=false, indirect-api=false, port=SE001_SE_100ms_8_CP001_ChkPtAp8_100msEnd_CP:
        port-arg-values:
          integer literal SE001_SE_100ms_8_1: type=WdgM_SupervisedEntityIdType, value=1
          integer literal CP001_ChkPtAp8_100msEnd_CP: type=WdgM_CheckpointIdType, value=1
      port-api-option enable-take-address=false, indirect-api=false, port=SE002_SE_100ms_9:
        port-arg-values:
          integer literal SE002_SE_100ms_9_GLS: type=WdgM_SupervisedEntityIdType, value=2
      port-api-option enable-take-address=false, indirect-api=false, port=SE002_SE_100ms_9_CP000_ChkPtAp9_100msStart_CP:
        port-arg-values:
          integer literal SE002_SE_100ms_9_0: type=WdgM_SupervisedEntityIdType, value=2
          integer literal CP000_ChkPtAp9_100msStart_CP: type=WdgM_CheckpointIdType, value=0
      port-api-option enable-take-address=false, indirect-api=false, port=SE002_SE_100ms_9_CP001_ChkPtAp9_100msEnd_CP:
        port-arg-values:
          integer literal SE002_SE_100ms_9_1: type=WdgM_SupervisedEntityIdType, value=2
          integer literal CP001_ChkPtAp9_100msEnd_CP: type=WdgM_CheckpointIdType, value=1
      port-api-option enable-take-address=false, indirect-api=false, port=SE003_SE_10ms_10:
        port-arg-values:
          integer literal SE003_SE_10ms_10_GLS: type=WdgM_SupervisedEntityIdType, value=3
      port-api-option enable-take-address=false, indirect-api=false, port=SE003_SE_10ms_10_CP000_ChkPtAp10_10msStart_CP:
        port-arg-values:
          integer literal SE003_SE_10ms_10_0: type=WdgM_SupervisedEntityIdType, value=3
          integer literal CP000_ChkPtAp10_10msStart_CP: type=WdgM_CheckpointIdType, value=0
      port-api-option enable-take-address=false, indirect-api=false, port=SE003_SE_10ms_10_CP001_ChkPtAp10_10msEnd_CP:
        port-arg-values:
          integer literal SE003_SE_10ms_10_1: type=WdgM_SupervisedEntityIdType, value=3
          integer literal CP001_ChkPtAp10_10msEnd_CP: type=WdgM_CheckpointIdType, value=1
      port-api-option enable-take-address=false, indirect-api=false, port=SE004_SE_10ms_9:
        port-arg-values:
          integer literal SE004_SE_10ms_9_GLS: type=WdgM_SupervisedEntityIdType, value=4
      port-api-option enable-take-address=false, indirect-api=false, port=SE004_SE_10ms_9_CP000_ChkPtAp9_10msStart_CP:
        port-arg-values:
          integer literal SE004_SE_10ms_9_0: type=WdgM_SupervisedEntityIdType, value=4
          integer literal CP000_ChkPtAp9_10msStart_CP: type=WdgM_CheckpointIdType, value=0
      port-api-option enable-take-address=false, indirect-api=false, port=SE004_SE_10ms_9_CP001_ChkPtAp9_10msEnd_CP:
        port-arg-values:
          integer literal SE004_SE_10ms_9_1: type=WdgM_SupervisedEntityIdType, value=4
          integer literal CP001_ChkPtAp9_10msEnd_CP: type=WdgM_CheckpointIdType, value=1
      port-api-option enable-take-address=false, indirect-api=false, port=SE005_SE_4ms_10:
        port-arg-values:
          integer literal SE005_SE_4ms_10_GLS: type=WdgM_SupervisedEntityIdType, value=5
      port-api-option enable-take-address=false, indirect-api=false, port=SE005_SE_4ms_10_CP000_ChkPtAp10_4msStart_CP:
        port-arg-values:
          integer literal SE005_SE_4ms_10_0: type=WdgM_SupervisedEntityIdType, value=5
          integer literal CP000_ChkPtAp10_4msStart_CP: type=WdgM_CheckpointIdType, value=0
      port-api-option enable-take-address=false, indirect-api=false, port=SE005_SE_4ms_10_CP001_ChkPtAp10_4msEnd_CP:
        port-arg-values:
          integer literal SE005_SE_4ms_10_1: type=WdgM_SupervisedEntityIdType, value=5
          integer literal CP001_ChkPtAp10_4msEnd_CP: type=WdgM_CheckpointIdType, value=1
      port-api-option enable-take-address=false, indirect-api=false, port=SE006_SE_4ms_9:
        port-arg-values:
          integer literal SE006_SE_4ms_9_GLS: type=WdgM_SupervisedEntityIdType, value=6
      port-api-option enable-take-address=false, indirect-api=false, port=SE006_SE_4ms_9_CP000_ChkPtAp9_4msStart_CP:
        port-arg-values:
          integer literal SE006_SE_4ms_9_0: type=WdgM_SupervisedEntityIdType, value=6
          integer literal CP000_ChkPtAp9_4msStart_CP: type=WdgM_CheckpointIdType, value=0
      port-api-option enable-take-address=false, indirect-api=false, port=SE006_SE_4ms_9_CP001_ChkPtAp9_4msEnd_CP:
        port-arg-values:
          integer literal SE006_SE_4ms_9_1: type=WdgM_SupervisedEntityIdType, value=6
          integer literal CP001_ChkPtAp9_4msEnd_CP: type=WdgM_CheckpointIdType, value=1
      port-api-option enable-take-address=false, indirect-api=false, port=SE007_SE_2ms_10:
        port-arg-values:
          integer literal SE007_SE_2ms_10_GLS: type=WdgM_SupervisedEntityIdType, value=7
      port-api-option enable-take-address=false, indirect-api=false, port=SE007_SE_2ms_10_CP000_ChkPtAp10_2msStart_CP:
        port-arg-values:
          integer literal SE007_SE_2ms_10_0: type=WdgM_SupervisedEntityIdType, value=7
          integer literal CP000_ChkPtAp10_2msStart_CP: type=WdgM_CheckpointIdType, value=0
      port-api-option enable-take-address=false, indirect-api=false, port=SE007_SE_2ms_10_CP001_ChkPtAp10_2msEnd_CP:
        port-arg-values:
          integer literal SE007_SE_2ms_10_1: type=WdgM_SupervisedEntityIdType, value=7
          integer literal CP001_ChkPtAp10_2msEnd_CP: type=WdgM_CheckpointIdType, value=1
      port-api-option enable-take-address=false, indirect-api=false, port=SE007_SE_2ms_10_CP002_GlbFinal_CP0:
        port-arg-values:
          integer literal SE007_SE_2ms_10_2: type=WdgM_SupervisedEntityIdType, value=7
          integer literal CP002_GlbFinal_CP0: type=WdgM_CheckpointIdType, value=2
      port-api-option enable-take-address=false, indirect-api=false, port=SE008_SE_2ms_8:
        port-arg-values:
          integer literal SE008_SE_2ms_8_GLS: type=WdgM_SupervisedEntityIdType, value=8
      port-api-option enable-take-address=false, indirect-api=false, port=SE008_SE_2ms_8_CP000_ChkPtAp8_2msStart_CP:
        port-arg-values:
          integer literal SE008_SE_2ms_8_0: type=WdgM_SupervisedEntityIdType, value=8
          integer literal CP000_ChkPtAp8_2msStart_CP: type=WdgM_CheckpointIdType, value=0
      port-api-option enable-take-address=false, indirect-api=false, port=SE008_SE_2ms_8_CP001_ChkPtAp8_2msEnd_CP:
        port-arg-values:
          integer literal SE008_SE_2ms_8_1: type=WdgM_SupervisedEntityIdType, value=8
          integer literal CP001_ChkPtAp8_2msEnd_CP: type=WdgM_CheckpointIdType, value=1
      port-api-option enable-take-address=false, indirect-api=false, port=SE009_SE_2ms_9:
        port-arg-values:
          integer literal SE009_SE_2ms_9_GLS: type=WdgM_SupervisedEntityIdType, value=9
      port-api-option enable-take-address=false, indirect-api=false, port=SE009_SE_2ms_9_CP000_ChkPtAp9_2msStart_CP:
        port-arg-values:
          integer literal SE009_SE_2ms_9_0: type=WdgM_SupervisedEntityIdType, value=9
          integer literal CP000_ChkPtAp9_2msStart_CP: type=WdgM_CheckpointIdType, value=0
      port-api-option enable-take-address=false, indirect-api=false, port=SE009_SE_2ms_9_CP001_ChkPtAp9_2msEnd_CP:
        port-arg-values:
          integer literal SE009_SE_2ms_9_1: type=WdgM_SupervisedEntityIdType, value=9
          integer literal CP001_ChkPtAp9_2msEnd_CP: type=WdgM_CheckpointIdType, value=1
    10 x runnable, all with can-be-invoked-concurrently=true:
      ActivateSupervisionEntity: symbol=WdgM_ActivateSupervisionEntity
      CheckpointReached: symbol=WdgM_CheckpointReached
      DeactivateSupervisionEntity: symbol=WdgM_DeactivateSupervisionEntity
      GetGlobalStatus: symbol=WdgM_GetGlobalStatus
      GetLocalStatus: symbol=WdgM_GetLocalStatus
      GetMode: symbol=WdgM_GetMode
      GlobalStateChangeCbk
      MainFunction: symbol=WdgM_MainFunction
      PerformReset: symbol=WdgM_PerformReset
      SetMode: symbol=WdgM_SetMode
  service component type WdgM: category=ServiceComponent
    33 x provide port:
      Global: provided-interface=WdgM_GlobalMode  # P-Port Prototype for Global Mode
        provided-com-specs:
          operation=GetGlobalStatus, queue-length=1
          operation=GetMode, queue-length=1
          operation=GlobalStateChangeCbk, queue-length=1
          operation=LocalStateChangeCbk, queue-length=1
          operation=MainFunction, queue-length=1
          operation=PerformReset, queue-length=1
          operation=SetMode, queue-length=1
      MODE_0_CALLER_ID_0: provided-interface=WdgM_GlobalMode  # P-Port Prototype for Trigger Mode 0 and Caller ID 0
        provided-com-specs:
          operation=GetGlobalStatus, queue-length=1
          operation=GetMode, queue-length=1
          operation=GlobalStateChangeCbk, queue-length=1
          operation=LocalStateChangeCbk, queue-length=1
          operation=MainFunction, queue-length=1
          operation=PerformReset, queue-length=1
          operation=SetMode, queue-length=1
      SE000_SE_100ms_10: provided-interface=WdgM_IndividualMode  # P-Port Prototype for Supervised Entity SE_100ms_10 with ID 0
        provided-com-specs:
          operation=ActivateSupervisionEntity, queue-length=1
          operation=DeactivateSupervisionEntity, queue-length=1
          operation=GetLocalStatus, queue-length=1
      SE000_SE_100ms_10_CP000_ChkPtAp10_100msStart_CP: server-com-spec{operation=CheckpointReached, queue-length=1}, provided-interface=WdgM_AliveSupervision  # P-Port Prototype for Supervised Entity SE_100ms_10 with ID 0 and Checkpoint ChkPtAp10_100msStart_CP with ID 0.
      SE000_SE_100ms_10_CP001_ChkPtAp10_100msEnd_CP: server-com-spec{operation=CheckpointReached, queue-length=1}, provided-interface=WdgM_AliveSupervision  # P-Port Prototype for Supervised Entity SE_100ms_10 with ID 0 and Checkpoint ChkPtAp10_100msEnd_CP with ID 1.
      SE001_SE_100ms_8: provided-interface=WdgM_IndividualMode  # P-Port Prototype for Supervised Entity SE_100ms_8 with ID 1
        provided-com-specs:
          operation=ActivateSupervisionEntity, queue-length=1
          operation=DeactivateSupervisionEntity, queue-length=1
          operation=GetLocalStatus, queue-length=1
      SE001_SE_100ms_8_CP000_ChkPtAp8_100msStart_CP: server-com-spec{operation=CheckpointReached, queue-length=1}, provided-interface=WdgM_AliveSupervision  # P-Port Prototype for Supervised Entity SE_100ms_8 with ID 1 and Checkpoint ChkPtAp8_100msStart_CP with ID 0.
      SE001_SE_100ms_8_CP001_ChkPtAp8_100msEnd_CP: server-com-spec{operation=CheckpointReached, queue-length=1}, provided-interface=WdgM_AliveSupervision  # P-Port Prototype for Supervised Entity SE_100ms_8 with ID 1 and Checkpoint ChkPtAp8_100msEnd_CP with ID 1.
      SE002_SE_100ms_9: provided-interface=WdgM_IndividualMode  # P-Port Prototype for Supervised Entity SE_100ms_9 with ID 2
        provided-com-specs:
          operation=ActivateSupervisionEntity, queue-length=1
          operation=DeactivateSupervisionEntity, queue-length=1
          operation=GetLocalStatus, queue-length=1
      SE002_SE_100ms_9_CP000_ChkPtAp9_100msStart_CP: server-com-spec{operation=CheckpointReached, queue-length=1}, provided-interface=WdgM_AliveSupervision  # P-Port Prototype for Supervised Entity SE_100ms_9 with ID 2 and Checkpoint ChkPtAp9_100msStart_CP with ID 0.
      SE002_SE_100ms_9_CP001_ChkPtAp9_100msEnd_CP: server-com-spec{operation=CheckpointReached, queue-length=1}, provided-interface=WdgM_AliveSupervision  # P-Port Prototype for Supervised Entity SE_100ms_9 with ID 2 and Checkpoint ChkPtAp9_100msEnd_CP with ID 1.
      SE003_SE_10ms_10: provided-interface=WdgM_IndividualMode  # P-Port Prototype for Supervised Entity SE_10ms_10 with ID 3
        provided-com-specs:
          operation=ActivateSupervisionEntity, queue-length=1
          operation=DeactivateSupervisionEntity, queue-length=1
          operation=GetLocalStatus, queue-length=1
      SE003_SE_10ms_10_CP000_ChkPtAp10_10msStart_CP: server-com-spec{operation=CheckpointReached, queue-length=1}, provided-interface=WdgM_AliveSupervision  # P-Port Prototype for Supervised Entity SE_10ms_10 with ID 3 and Checkpoint ChkPtAp10_10msStart_CP with ID 0.
      SE003_SE_10ms_10_CP001_ChkPtAp10_10msEnd_CP: server-com-spec{operation=CheckpointReached, queue-length=1}, provided-interface=WdgM_AliveSupervision  # P-Port Prototype for Supervised Entity SE_10ms_10 with ID 3 and Checkpoint ChkPtAp10_10msEnd_CP with ID 1.
      SE004_SE_10ms_9: provided-interface=WdgM_IndividualMode  # P-Port Prototype for Supervised Entity SE_10ms_9 with ID 4
        provided-com-specs:
          operation=ActivateSupervisionEntity, queue-length=1
          operation=DeactivateSupervisionEntity, queue-length=1
          operation=GetLocalStatus, queue-length=1
      SE004_SE_10ms_9_CP000_ChkPtAp9_10msStart_CP: server-com-spec{operation=CheckpointReached, queue-length=1}, provided-interface=WdgM_AliveSupervision  # P-Port Prototype for Supervised Entity SE_10ms_9 with ID 4 and Checkpoint ChkPtAp9_10msStart_CP with ID 0.
      SE004_SE_10ms_9_CP001_ChkPtAp9_10msEnd_CP: server-com-spec{operation=CheckpointReached, queue-length=1}, provided-interface=WdgM_AliveSupervision  # P-Port Prototype for Supervised Entity SE_10ms_9 with ID 4 and Checkpoint ChkPtAp9_10msEnd_CP with ID 1.
      SE005_SE_4ms_10: provided-interface=WdgM_IndividualMode  # P-Port Prototype for Supervised Entity SE_4ms_10 with ID 5
        provided-com-specs:
          operation=ActivateSupervisionEntity, queue-length=1
          operation=DeactivateSupervisionEntity, queue-length=1
          operation=GetLocalStatus, queue-length=1
      SE005_SE_4ms_10_CP000_ChkPtAp10_4msStart_CP: server-com-spec{operation=CheckpointReached, queue-length=1}, provided-interface=WdgM_AliveSupervision  # P-Port Prototype for Supervised Entity SE_4ms_10 with ID 5 and Checkpoint ChkPtAp10_4msStart_CP with ID 0.
      SE005_SE_4ms_10_CP001_ChkPtAp10_4msEnd_CP: server-com-spec{operation=CheckpointReached, queue-length=1}, provided-interface=WdgM_AliveSupervision  # P-Port Prototype for Supervised Entity SE_4ms_10 with ID 5 and Checkpoint ChkPtAp10_4msEnd_CP with ID 1.
      SE006_SE_4ms_9: provided-interface=WdgM_IndividualMode  # P-Port Prototype for Supervised Entity SE_4ms_9 with ID 6
        provided-com-specs:
          operation=ActivateSupervisionEntity, queue-length=1
          operation=DeactivateSupervisionEntity, queue-length=1
          operation=GetLocalStatus, queue-length=1
      SE006_SE_4ms_9_CP000_ChkPtAp9_4msStart_CP: server-com-spec{operation=CheckpointReached, queue-length=1}, provided-interface=WdgM_AliveSupervision  # P-Port Prototype for Supervised Entity SE_4ms_9 with ID 6 and Checkpoint ChkPtAp9_4msStart_CP with ID 0.
      SE006_SE_4ms_9_CP001_ChkPtAp9_4msEnd_CP: server-com-spec{operation=CheckpointReached, queue-length=1}, provided-interface=WdgM_AliveSupervision  # P-Port Prototype for Supervised Entity SE_4ms_9 with ID 6 and Checkpoint ChkPtAp9_4msEnd_CP with ID 1.
      SE007_SE_2ms_10: provided-interface=WdgM_IndividualMode  # P-Port Prototype for Supervised Entity SE_2ms_10 with ID 7
        provided-com-specs:
          operation=ActivateSupervisionEntity, queue-length=1
          operation=DeactivateSupervisionEntity, queue-length=1
          operation=GetLocalStatus, queue-length=1
      SE007_SE_2ms_10_CP000_ChkPtAp10_2msStart_CP: server-com-spec{operation=CheckpointReached, queue-length=1}, provided-interface=WdgM_AliveSupervision  # P-Port Prototype for Supervised Entity SE_2ms_10 with ID 7 and Checkpoint ChkPtAp10_2msStart_CP with ID 0.
      SE007_SE_2ms_10_CP001_ChkPtAp10_2msEnd_CP: server-com-spec{operation=CheckpointReached, queue-length=1}, provided-interface=WdgM_AliveSupervision  # P-Port Prototype for Supervised Entity SE_2ms_10 with ID 7 and Checkpoint ChkPtAp10_2msEnd_CP with ID 1.
      SE007_SE_2ms_10_CP002_GlbFinal_CP0: server-com-spec{operation=CheckpointReached, queue-length=1}, provided-interface=WdgM_AliveSupervision  # P-Port Prototype for Supervised Entity SE_2ms_10 with ID 7 and Checkpoint GlbFinal_CP0 with ID 2.
      SE008_SE_2ms_8: provided-interface=WdgM_IndividualMode  # P-Port Prototype for Supervised Entity SE_2ms_8 with ID 8
        provided-com-specs:
          operation=ActivateSupervisionEntity, queue-length=1
          operation=DeactivateSupervisionEntity, queue-length=1
          operation=GetLocalStatus, queue-length=1
      SE008_SE_2ms_8_CP000_ChkPtAp8_2msStart_CP: server-com-spec{operation=CheckpointReached, queue-length=1}, provided-interface=WdgM_AliveSupervision  # P-Port Prototype for Supervised Entity SE_2ms_8 with ID 8 and Checkpoint ChkPtAp8_2msStart_CP with ID 0.
      SE008_SE_2ms_8_CP001_ChkPtAp8_2msEnd_CP: server-com-spec{operation=CheckpointReached, queue-length=1}, provided-interface=WdgM_AliveSupervision  # P-Port Prototype for Supervised Entity SE_2ms_8 with ID 8 and Checkpoint ChkPtAp8_2msEnd_CP with ID 1.
      SE009_SE_2ms_9: provided-interface=WdgM_IndividualMode  # P-Port Prototype for Supervised Entity SE_2ms_9 with ID 9
        provided-com-specs:
          operation=ActivateSupervisionEntity, queue-length=1
          operation=DeactivateSupervisionEntity, queue-length=1
          operation=GetLocalStatus, queue-length=1
      SE009_SE_2ms_9_CP000_ChkPtAp9_2msStart_CP: server-com-spec{operation=CheckpointReached, queue-length=1}, provided-interface=WdgM_AliveSupervision  # P-Port Prototype for Supervised Entity SE_2ms_9 with ID 9 and Checkpoint ChkPtAp9_2msStart_CP with ID 0.
      SE009_SE_2ms_9_CP001_ChkPtAp9_2msEnd_CP: server-com-spec{operation=CheckpointReached, queue-length=1}, provided-interface=WdgM_AliveSupervision  # P-Port Prototype for Supervised Entity SE_2ms_9 with ID 9 and Checkpoint ChkPtAp9_2msEnd_CP with ID 1.
  swc implementation WdgM_Implementation: behavior=WdgM_InternalBehavior
    code-descriptors:
      code Code: type=SRC
