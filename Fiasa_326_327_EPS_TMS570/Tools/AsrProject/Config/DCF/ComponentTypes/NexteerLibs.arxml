AUTOSAR XML (schema 314)
package /ComponentType
  internal behavior NexteerLibs_InternalBehavior: component=NexteerLibs, port-api-option{enable-take-address=false, indirect-api=false, port=SystemTime}
    6 x operation invoked event:
      OIT_DtrmnElapsedTime_mS_u16_SystemTime_DtrmnElapsedTime_mS_u16: start-on-event=DtrmnElapsedTime_mS_u16, operation=SystemTime.DtrmnElapsedTime_mS_u16
      OIT_DtrmnElapsedTime_mS_u32_SystemTime_DtrmnElapsedTime_mS_u32: start-on-event=DtrmnElapsedTime_mS_u32, operation=SystemTime.DtrmnElapsedTime_mS_u32
      OIT_DtrmnElapsedTime_uS_u16_SystemTime_DtrmnElapsedTime_uS_u16: start-on-event=DtrmnElapsedTime_uS_u16, operation=SystemTime.DtrmnElapsedTime_uS_u16
      OIT_DtrmnElapsedTime_uS_u32_SystemTime_DtrmnElapsedTime_uS_u32: start-on-event=DtrmnElapsedTime_uS_u32, operation=SystemTime.DtrmnElapsedTime_uS_u32
      OIT_GetSystemTime_mS_u32_SystemTime_GetSystemTime_mS_u32: start-on-event=GetSystemTime_mS_u32, operation=SystemTime.GetSystemTime_mS_u32
      OIT_GetSystemTime_uS_u32_SystemTime_GetSystemTime_uS_u32: start-on-event=GetSystemTime_uS_u32, operation=SystemTime.GetSystemTime_uS_u32
    timing event TMT_SystemTime_Per1: start-on-event=SystemTime_Per1, period=0.002
    inter runnable variable Time_mS_u32: type=UInt32, communication-approach=EXPLICIT, init-value=D_ZERO_CNT_U32
    7 x runnable:
      DtrmnElapsedTime_mS_u16: can-be-invoked-concurrently=true, read-variable=Time_mS_u32
      DtrmnElapsedTime_mS_u32: can-be-invoked-concurrently=true, read-variable=Time_mS_u32
      DtrmnElapsedTime_uS_u16: can-be-invoked-concurrently=true
      DtrmnElapsedTime_uS_u32: can-be-invoked-concurrently=true
      GetSystemTime_mS_u32: can-be-invoked-concurrently=true, read-variable=Time_mS_u32
      GetSystemTime_uS_u32: can-be-invoked-concurrently=true
      SystemTime_Per1: read-variable=Time_mS_u32, written-variable=Time_mS_u32
  service component type NexteerLibs: category=ServiceComponent
    provide port SystemTime: provided-interface=SystemTime
      provided-com-specs:
        operation=DtrmnElapsedTime_mS_u16, queue-length=1
        operation=DtrmnElapsedTime_mS_u32, queue-length=1
        operation=DtrmnElapsedTime_uS_u16, queue-length=1
        operation=DtrmnElapsedTime_uS_u32, queue-length=1
        operation=GetSystemTime_mS_u32, queue-length=1
        operation=GetSystemTime_uS_u32, queue-length=1
  swc implementation NexteerLibs_Implementation: behavior=NexteerLibs_InternalBehavior
    code-descriptors:
      code Code: type=SRC
