AUTOSAR XML (schema 314)
package /ComponentType
  complex device driver component type Cd_Nhet1
    provide port DigHwTrqT1: unqueued-sender-com-spec{data-element=HwNm_f32, can-invalidate=false, init-value=D_ZERO_ULS_F32}, provided-interface=HwTrq_HwNm_f32
    provide port DigHwTrqT2: unqueued-sender-com-spec{data-element=HwNm_f32, can-invalidate=false, init-value=D_ZERO_ULS_F32}, provided-interface=HwTrq_HwNm_f32
    require port NxtrDiagMgr: required-com-specs=[GetNTCActive, GetNTCFailed, GetNTCStatus, SetNTCStatus], required-interface=NxtrDiagMgr
  internal behavior Cd_Nhet1_InternalBehavior: component=Cd_Nhet1
    timing event TMT_Nhet1_Per1: start-on-event=Nhet1_Per1, period=0.002
    timing event TMT_Nhet1_Per2: start-on-event=Nhet1_Per2, period=0.002
    port-api-options:
      enable-take-address=false, indirect-api=false, port=DigHwTrqT1
      enable-take-address=false, indirect-api=false, port=DigHwTrqT2
      enable-take-address=false, indirect-api=false, port=NxtrDiagMgr
    runnable Nhet1_Per1
    runnable Nhet1_Per2
      data write access WRITE_DigHwTrqT1_HwNm_f32: data-element=DigHwTrqT1.HwNm_f32
      data write access WRITE_DigHwTrqT2_HwNm_f32: data-element=DigHwTrqT2.HwNm_f32
      sync call SC_NxtrDiagMgr_SetNTCStatus: operation=NxtrDiagMgr.SetNTCStatus, timeout=0
  swc implementation Cd_Nhet1_Implementation: behavior=Cd_Nhet1_InternalBehavior
    code-descriptors:
      code Code: type=SRC
