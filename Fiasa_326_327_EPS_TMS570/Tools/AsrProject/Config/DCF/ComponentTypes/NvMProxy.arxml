AUTOSAR XML (schema 314)
package /ComponentType
  internal behavior NvMProxy_InternalBehavior: component=NvMProxy
    16 x operation invoked event, all with start-on-event=GetErrorStatus:
      OIT_GetErrorStatus_PS_NvMP_NvmBlock_BatteryOvervoltageData_GetErrorStatus: operation=PS_NvMP_NvmBlock_BatteryOvervoltageData.GetErrorStatus
      OIT_GetErrorStatus_PS_NvMP_NvmBlock_CloseCheckData_GetErrorStatus: operation=PS_NvMP_NvmBlock_CloseCheckData.GetErrorStatus
      OIT_GetErrorStatus_PS_NvMP_NvmBlock_CogTrqCal_GetErrorStatus: operation=PS_NvMP_NvmBlock_CogTrqCal.GetErrorStatus
      OIT_GetErrorStatus_PS_NvMP_NvmBlock_CogTrqRplComp_GetErrorStatus: operation=PS_NvMP_NvmBlock_CogTrqRplComp.GetErrorStatus
      OIT_GetErrorStatus_PS_NvMP_NvmBlock_CurrTempOffset_GetErrorStatus: operation=PS_NvMP_NvmBlock_CurrTempOffset.GetErrorStatus
      OIT_GetErrorStatus_PS_NvMP_NvmBlock_DigColPsEOL_GetErrorStatus: operation=PS_NvMP_NvmBlock_DigColPsEOL.GetErrorStatus
      OIT_GetErrorStatus_PS_NvMP_NvmBlock_DigMSBEOLData_GetErrorStatus: operation=PS_NvMP_NvmBlock_DigMSBEOLData.GetErrorStatus
      OIT_GetErrorStatus_PS_NvMP_NvmBlock_DigTrqTrim_GetErrorStatus: operation=PS_NvMP_NvmBlock_DigTrqTrim.GetErrorStatus
      OIT_GetErrorStatus_PS_NvMP_NvmBlock_EOLNomMtrParam_GetErrorStatus: operation=PS_NvMP_NvmBlock_EOLNomMtrParam.GetErrorStatus
      OIT_GetErrorStatus_PS_NvMP_NvmBlock_EOLVehCntrOffset_GetErrorStatus: operation=PS_NvMP_NvmBlock_EOLVehCntrOffset.GetErrorStatus
      OIT_GetErrorStatus_PS_NvMP_NvmBlock_MotPosReset_GetErrorStatus: operation=PS_NvMP_NvmBlock_MotPosReset.GetErrorStatus
      OIT_GetErrorStatus_PS_NvMP_NvmBlock_Polarity_GetErrorStatus: operation=PS_NvMP_NvmBlock_Polarity.GetErrorStatus
      OIT_GetErrorStatus_PS_NvMP_NvmBlock_ShCurrCal_GetErrorStatus: operation=PS_NvMP_NvmBlock_ShCurrCal.GetErrorStatus
      OIT_GetErrorStatus_PS_NvMP_NvmBlock_SteerAsstDefeat_GetErrorStatus: operation=PS_NvMP_NvmBlock_SteerAsstDefeat.GetErrorStatus
      OIT_GetErrorStatus_PS_NvMP_NvmBlock_TorqueCmdSF_GetErrorStatus: operation=PS_NvMP_NvmBlock_TorqueCmdSF.GetErrorStatus
      OIT_GetErrorStatus_PS_NvMP_NvmBlock_TypeHRamBuffer_GetErrorStatus: operation=PS_NvMP_NvmBlock_TypeHRamBuffer.GetErrorStatus
    timing event TMT_NvMProxy_MainFunction: start-on-event=NvMProxy_MainFunction, period=0.01
    32 x operation invoked event:
      OIT_SetRamBlockStatus_PS_NvMP_NvmBlock_BatteryOvervoltageData_SetRamBlockStatus: start-on-event=SetRamBlockStatus, operation=PS_NvMP_NvmBlock_BatteryOvervoltageData.SetRamBlockStatus
      OIT_SetRamBlockStatus_PS_NvMP_NvmBlock_CloseCheckData_SetRamBlockStatus: start-on-event=SetRamBlockStatus, operation=PS_NvMP_NvmBlock_CloseCheckData.SetRamBlockStatus
      OIT_SetRamBlockStatus_PS_NvMP_NvmBlock_CogTrqCal_SetRamBlockStatus: start-on-event=SetRamBlockStatus, operation=PS_NvMP_NvmBlock_CogTrqCal.SetRamBlockStatus
      OIT_SetRamBlockStatus_PS_NvMP_NvmBlock_CogTrqRplComp_SetRamBlockStatus: start-on-event=SetRamBlockStatus, operation=PS_NvMP_NvmBlock_CogTrqRplComp.SetRamBlockStatus
      OIT_SetRamBlockStatus_PS_NvMP_NvmBlock_CurrTempOffset_SetRamBlockStatus: start-on-event=SetRamBlockStatus, operation=PS_NvMP_NvmBlock_CurrTempOffset.SetRamBlockStatus
      OIT_SetRamBlockStatus_PS_NvMP_NvmBlock_DigColPsEOL_SetRamBlockStatus: start-on-event=SetRamBlockStatus, operation=PS_NvMP_NvmBlock_DigColPsEOL.SetRamBlockStatus
      OIT_SetRamBlockStatus_PS_NvMP_NvmBlock_DigMSBEOLData_SetRamBlockStatus: start-on-event=SetRamBlockStatus, operation=PS_NvMP_NvmBlock_DigMSBEOLData.SetRamBlockStatus
      OIT_SetRamBlockStatus_PS_NvMP_NvmBlock_DigTrqTrim_SetRamBlockStatus: start-on-event=SetRamBlockStatus, operation=PS_NvMP_NvmBlock_DigTrqTrim.SetRamBlockStatus
      OIT_SetRamBlockStatus_PS_NvMP_NvmBlock_EOLNomMtrParam_SetRamBlockStatus: start-on-event=SetRamBlockStatus, operation=PS_NvMP_NvmBlock_EOLNomMtrParam.SetRamBlockStatus
      OIT_SetRamBlockStatus_PS_NvMP_NvmBlock_EOLVehCntrOffset_SetRamBlockStatus: start-on-event=SetRamBlockStatus, operation=PS_NvMP_NvmBlock_EOLVehCntrOffset.SetRamBlockStatus
      OIT_SetRamBlockStatus_PS_NvMP_NvmBlock_MotPosReset_SetRamBlockStatus: start-on-event=SetRamBlockStatus, operation=PS_NvMP_NvmBlock_MotPosReset.SetRamBlockStatus
      OIT_SetRamBlockStatus_PS_NvMP_NvmBlock_Polarity_SetRamBlockStatus: start-on-event=SetRamBlockStatus, operation=PS_NvMP_NvmBlock_Polarity.SetRamBlockStatus
      OIT_SetRamBlockStatus_PS_NvMP_NvmBlock_ShCurrCal_SetRamBlockStatus: start-on-event=SetRamBlockStatus, operation=PS_NvMP_NvmBlock_ShCurrCal.SetRamBlockStatus
      OIT_SetRamBlockStatus_PS_NvMP_NvmBlock_SteerAsstDefeat_SetRamBlockStatus: start-on-event=SetRamBlockStatus, operation=PS_NvMP_NvmBlock_SteerAsstDefeat.SetRamBlockStatus
      OIT_SetRamBlockStatus_PS_NvMP_NvmBlock_TorqueCmdSF_SetRamBlockStatus: start-on-event=SetRamBlockStatus, operation=PS_NvMP_NvmBlock_TorqueCmdSF.SetRamBlockStatus
      OIT_SetRamBlockStatus_PS_NvMP_NvmBlock_TypeHRamBuffer_SetRamBlockStatus: start-on-event=SetRamBlockStatus, operation=PS_NvMP_NvmBlock_TypeHRamBuffer.SetRamBlockStatus
      OIT_WriteBlock_PS_NvMP_NvmBlock_BatteryOvervoltageData_WriteBlock: start-on-event=WriteBlock, operation=PS_NvMP_NvmBlock_BatteryOvervoltageData.WriteBlock
      OIT_WriteBlock_PS_NvMP_NvmBlock_CloseCheckData_WriteBlock: start-on-event=WriteBlock, operation=PS_NvMP_NvmBlock_CloseCheckData.WriteBlock
      OIT_WriteBlock_PS_NvMP_NvmBlock_CogTrqCal_WriteBlock: start-on-event=WriteBlock, operation=PS_NvMP_NvmBlock_CogTrqCal.WriteBlock
      OIT_WriteBlock_PS_NvMP_NvmBlock_CogTrqRplComp_WriteBlock: start-on-event=WriteBlock, operation=PS_NvMP_NvmBlock_CogTrqRplComp.WriteBlock
      OIT_WriteBlock_PS_NvMP_NvmBlock_CurrTempOffset_WriteBlock: start-on-event=WriteBlock, operation=PS_NvMP_NvmBlock_CurrTempOffset.WriteBlock
      OIT_WriteBlock_PS_NvMP_NvmBlock_DigColPsEOL_WriteBlock: start-on-event=WriteBlock, operation=PS_NvMP_NvmBlock_DigColPsEOL.WriteBlock
      OIT_WriteBlock_PS_NvMP_NvmBlock_DigMSBEOLData_WriteBlock: start-on-event=WriteBlock, operation=PS_NvMP_NvmBlock_DigMSBEOLData.WriteBlock
      OIT_WriteBlock_PS_NvMP_NvmBlock_DigTrqTrim_WriteBlock: start-on-event=WriteBlock, operation=PS_NvMP_NvmBlock_DigTrqTrim.WriteBlock
      OIT_WriteBlock_PS_NvMP_NvmBlock_EOLNomMtrParam_WriteBlock: start-on-event=WriteBlock, operation=PS_NvMP_NvmBlock_EOLNomMtrParam.WriteBlock
      OIT_WriteBlock_PS_NvMP_NvmBlock_EOLVehCntrOffset_WriteBlock: start-on-event=WriteBlock, operation=PS_NvMP_NvmBlock_EOLVehCntrOffset.WriteBlock
      OIT_WriteBlock_PS_NvMP_NvmBlock_MotPosReset_WriteBlock: start-on-event=WriteBlock, operation=PS_NvMP_NvmBlock_MotPosReset.WriteBlock
      OIT_WriteBlock_PS_NvMP_NvmBlock_Polarity_WriteBlock: start-on-event=WriteBlock, operation=PS_NvMP_NvmBlock_Polarity.WriteBlock
      OIT_WriteBlock_PS_NvMP_NvmBlock_ShCurrCal_WriteBlock: start-on-event=WriteBlock, operation=PS_NvMP_NvmBlock_ShCurrCal.WriteBlock
      OIT_WriteBlock_PS_NvMP_NvmBlock_SteerAsstDefeat_WriteBlock: start-on-event=WriteBlock, operation=PS_NvMP_NvmBlock_SteerAsstDefeat.WriteBlock
      OIT_WriteBlock_PS_NvMP_NvmBlock_TorqueCmdSF_WriteBlock: start-on-event=WriteBlock, operation=PS_NvMP_NvmBlock_TorqueCmdSF.WriteBlock
      OIT_WriteBlock_PS_NvMP_NvmBlock_TypeHRamBuffer_WriteBlock: start-on-event=WriteBlock, operation=PS_NvMP_NvmBlock_TypeHRamBuffer.WriteBlock
    port-api-option enable-take-address=false, indirect-api=false, port=PS_NvMP_NvmBlock_BatteryOvervoltageData:
      port-arg-values:
        integer literal NvM_ServiceBlockId_16: type=UInt8, value=16
    port-api-option enable-take-address=false, indirect-api=false, port=PS_NvMP_NvmBlock_CloseCheckData:
      port-arg-values:
        integer literal NvM_ServiceBlockId_4: type=UInt8, value=4
    port-api-option enable-take-address=false, indirect-api=false, port=PS_NvMP_NvmBlock_CogTrqCal:
      port-arg-values:
        integer literal NvM_ServiceBlockId_6: type=UInt8, value=6
    port-api-option enable-take-address=false, indirect-api=false, port=PS_NvMP_NvmBlock_CogTrqRplComp:
      port-arg-values:
        integer literal NvM_ServiceBlockId_11: type=UInt8, value=11
    port-api-option enable-take-address=false, indirect-api=false, port=PS_NvMP_NvmBlock_CurrTempOffset:
      port-arg-values:
        integer literal NvM_ServiceBlockId_12: type=UInt8, value=12
    port-api-option enable-take-address=false, indirect-api=false, port=PS_NvMP_NvmBlock_DigColPsEOL:
      port-arg-values:
        integer literal NvM_ServiceBlockId_15: type=UInt8, value=15
    port-api-option enable-take-address=false, indirect-api=false, port=PS_NvMP_NvmBlock_DigMSBEOLData:
      port-arg-values:
        integer literal NvM_ServiceBlockId_9: type=UInt8, value=9
    port-api-option enable-take-address=false, indirect-api=false, port=PS_NvMP_NvmBlock_DigTrqTrim:
      port-arg-values:
        integer literal NvM_ServiceBlockId_8: type=UInt8, value=8
    port-api-option enable-take-address=false, indirect-api=false, port=PS_NvMP_NvmBlock_EOLNomMtrParam:
      port-arg-values:
        integer literal NvM_ServiceBlockId_7: type=UInt8, value=7
    port-api-option enable-take-address=false, indirect-api=false, port=PS_NvMP_NvmBlock_EOLVehCntrOffset:
      port-arg-values:
        integer literal NvM_ServiceBlockId_10: type=UInt8, value=10
    port-api-option enable-take-address=false, indirect-api=false, port=PS_NvMP_NvmBlock_MotPosReset:
      port-arg-values:
        integer literal NvM_ServiceBlockId_14: type=UInt8, value=14
    port-api-option enable-take-address=false, indirect-api=false, port=PS_NvMP_NvmBlock_Polarity:
      port-arg-values:
        integer literal NvM_ServiceBlockId_3: type=UInt8, value=3
    port-api-option enable-take-address=false, indirect-api=false, port=PS_NvMP_NvmBlock_ShCurrCal:
      port-arg-values:
        integer literal NvM_ServiceBlockId_1: type=UInt8, value=1
    port-api-option enable-take-address=false, indirect-api=false, port=PS_NvMP_NvmBlock_SteerAsstDefeat:
      port-arg-values:
        integer literal NvM_ServiceBlockId_13: type=UInt8, value=13
    port-api-option enable-take-address=false, indirect-api=false, port=PS_NvMP_NvmBlock_TorqueCmdSF:
      port-arg-values:
        integer literal NvM_ServiceBlockId_2: type=UInt8, value=2
    port-api-option enable-take-address=false, indirect-api=false, port=PS_NvMP_NvmBlock_TypeHRamBuffer:
      port-arg-values:
        integer literal NvM_ServiceBlockId_5: type=UInt8, value=5
    4 x runnable:
      GetErrorStatus: can-be-invoked-concurrently=true, symbol=NvMProxy_GetErrorStatus
      NvMProxy_MainFunction: minimum-start-interval=0.01
      SetRamBlockStatus: can-be-invoked-concurrently=true, symbol=NvMProxy_SetRamBlockStatus
      WriteBlock: can-be-invoked-concurrently=true, symbol=NvMProxy_WriteBlock
  service component type NvMProxy: category=ServiceComponent  # Software Component description for NvM ASILD proxy based on generated file from Ecuc Package: ActiveEcuC
    16 x provide port, all with provided-interface=NvM_AC3_SRBS_Srv:
      PS_NvMP_NvmBlock_BatteryOvervoltageData  # P-Port Prototype of NvM_AC3_SRBS_Srv for NVRAM Block Rte_NvmBlockProxy_BatteryOvervoltageData
        provided-com-specs:
          operation=EraseBlock, queue-length=1
          operation=GetErrorStatus, queue-length=1
          operation=InvalidateNvBlock, queue-length=1
          operation=ReadBlock, queue-length=1
          operation=SetRamBlockStatus, queue-length=1
          operation=WriteBlock, queue-length=1
      PS_NvMP_NvmBlock_CloseCheckData  # P-Port Prototype of NvM_AC3_SRBS_Srv for NVRAM Block Rte_NvmBlockProxy_CloseCheckData
        provided-com-specs:
          operation=EraseBlock, queue-length=1
          operation=GetErrorStatus, queue-length=1
          operation=InvalidateNvBlock, queue-length=1
          operation=ReadBlock, queue-length=1
          operation=SetRamBlockStatus, queue-length=1
          operation=WriteBlock, queue-length=1
      PS_NvMP_NvmBlock_CogTrqCal  # P-Port Prototype of NvM_AC3_SRBS_Srv for NVRAM Block Rte_NvmBlockProxy_CogTrqCal
        provided-com-specs:
          operation=EraseBlock, queue-length=1
          operation=GetErrorStatus, queue-length=1
          operation=InvalidateNvBlock, queue-length=1
          operation=ReadBlock, queue-length=1
          operation=SetRamBlockStatus, queue-length=1
          operation=WriteBlock, queue-length=1
      PS_NvMP_NvmBlock_CogTrqRplComp  # P-Port Prototype of NvM_AC3_SRBS_Srv for NVRAM Block Rte_NvmBlockProxy_CogTrqRplComp
        provided-com-specs:
          operation=EraseBlock, queue-length=1
          operation=GetErrorStatus, queue-length=1
          operation=InvalidateNvBlock, queue-length=1
          operation=ReadBlock, queue-length=1
          operation=SetRamBlockStatus, queue-length=1
          operation=WriteBlock, queue-length=1
      PS_NvMP_NvmBlock_CurrTempOffset  # P-Port Prototype of NvM_AC3_SRBS_Srv for NVRAM Block Rte_NvmBlockProxy_CurrTempOffset
        provided-com-specs:
          operation=EraseBlock, queue-length=1
          operation=GetErrorStatus, queue-length=1
          operation=InvalidateNvBlock, queue-length=1
          operation=ReadBlock, queue-length=1
          operation=SetRamBlockStatus, queue-length=1
          operation=WriteBlock, queue-length=1
      PS_NvMP_NvmBlock_DigColPsEOL  # P-Port Prototype of NvM_AC3_SRBS_Srv for NVRAM Block Rte_NvmBlockProxy_DigColPsEOL
        provided-com-specs:
          operation=EraseBlock, queue-length=1
          operation=GetErrorStatus, queue-length=1
          operation=InvalidateNvBlock, queue-length=1
          operation=ReadBlock, queue-length=1
          operation=SetRamBlockStatus, queue-length=1
          operation=WriteBlock, queue-length=1
      PS_NvMP_NvmBlock_DigMSBEOLData  # P-Port Prototype of NvM_AC3_SRBS_Srv for NVRAM Block Rte_NvmBlockProxy_DigMSBEOLData
        provided-com-specs:
          operation=EraseBlock, queue-length=1
          operation=GetErrorStatus, queue-length=1
          operation=InvalidateNvBlock, queue-length=1
          operation=ReadBlock, queue-length=1
          operation=SetRamBlockStatus, queue-length=1
          operation=WriteBlock, queue-length=1
      PS_NvMP_NvmBlock_DigTrqTrim  # P-Port Prototype of NvM_AC3_SRBS_Srv for NVRAM Block Rte_NvmBlockProxy_DigTrqTrim
        provided-com-specs:
          operation=EraseBlock, queue-length=1
          operation=GetErrorStatus, queue-length=1
          operation=InvalidateNvBlock, queue-length=1
          operation=ReadBlock, queue-length=1
          operation=SetRamBlockStatus, queue-length=1
          operation=WriteBlock, queue-length=1
      PS_NvMP_NvmBlock_EOLNomMtrParam  # P-Port Prototype of NvM_AC3_SRBS_Srv for NVRAM Block Rte_NvmBlockProxy_EOLNomMtrParam
        provided-com-specs:
          operation=EraseBlock, queue-length=1
          operation=GetErrorStatus, queue-length=1
          operation=InvalidateNvBlock, queue-length=1
          operation=ReadBlock, queue-length=1
          operation=SetRamBlockStatus, queue-length=1
          operation=WriteBlock, queue-length=1
      PS_NvMP_NvmBlock_EOLVehCntrOffset  # P-Port Prototype of NvM_AC3_SRBS_Srv for NVRAM Block Rte_NvmBlockProxy_EOLVehCntrOffset
        provided-com-specs:
          operation=EraseBlock, queue-length=1
          operation=GetErrorStatus, queue-length=1
          operation=InvalidateNvBlock, queue-length=1
          operation=ReadBlock, queue-length=1
          operation=SetRamBlockStatus, queue-length=1
          operation=WriteBlock, queue-length=1
      PS_NvMP_NvmBlock_MotPosReset  # P-Port Prototype of NvM_AC3_SRBS_Srv for NVRAM Block Rte_NvmBlockProxy_MotPosReset
        provided-com-specs:
          operation=EraseBlock, queue-length=1
          operation=GetErrorStatus, queue-length=1
          operation=InvalidateNvBlock, queue-length=1
          operation=ReadBlock, queue-length=1
          operation=SetRamBlockStatus, queue-length=1
          operation=WriteBlock, queue-length=1
      PS_NvMP_NvmBlock_Polarity  # P-Port Prototype of NvM_AC3_SRBS_Srv for NVRAM Block Rte_NvmBlockProxy_Polarity
        provided-com-specs:
          operation=EraseBlock, queue-length=1
          operation=GetErrorStatus, queue-length=1
          operation=InvalidateNvBlock, queue-length=1
          operation=ReadBlock, queue-length=1
          operation=SetRamBlockStatus, queue-length=1
          operation=WriteBlock, queue-length=1
      PS_NvMP_NvmBlock_ShCurrCal  # P-Port Prototype of NvM_AC3_SRBS_Srv for NVRAM Block Rte_NvmBlockProxy_ShCurrCal
        provided-com-specs:
          operation=EraseBlock, queue-length=1
          operation=GetErrorStatus, queue-length=1
          operation=InvalidateNvBlock, queue-length=1
          operation=ReadBlock, queue-length=1
          operation=SetRamBlockStatus, queue-length=1
          operation=WriteBlock, queue-length=1
      PS_NvMP_NvmBlock_SteerAsstDefeat  # P-Port Prototype of NvM_AC3_SRBS_Srv for NVRAM Block Rte_NvmBlockProxy_SteerAsstDefeat
        provided-com-specs:
          operation=EraseBlock, queue-length=1
          operation=GetErrorStatus, queue-length=1
          operation=InvalidateNvBlock, queue-length=1
          operation=ReadBlock, queue-length=1
          operation=SetRamBlockStatus, queue-length=1
          operation=WriteBlock, queue-length=1
      PS_NvMP_NvmBlock_TorqueCmdSF  # P-Port Prototype of NvM_AC3_SRBS_Srv for NVRAM Block Rte_NvmBlockProxy_TorqueCmdSF
        provided-com-specs:
          operation=EraseBlock, queue-length=1
          operation=GetErrorStatus, queue-length=1
          operation=InvalidateNvBlock, queue-length=1
          operation=ReadBlock, queue-length=1
          operation=SetRamBlockStatus, queue-length=1
          operation=WriteBlock, queue-length=1
      PS_NvMP_NvmBlock_TypeHRamBuffer  # P-Port Prototype of NvM_AC3_SRBS_Srv for NVRAM Block Rte_NvmBlockProxy_TypeHRamBuffer
        provided-com-specs:
          operation=EraseBlock, queue-length=1
          operation=GetErrorStatus, queue-length=1
          operation=InvalidateNvBlock, queue-length=1
          operation=ReadBlock, queue-length=1
          operation=SetRamBlockStatus, queue-length=1
          operation=WriteBlock, queue-length=1
  swc implementation NvMProxy_Implementation: behavior=NvMProxy_InternalBehavior
    code-descriptors:
      code Code: type=SRC
