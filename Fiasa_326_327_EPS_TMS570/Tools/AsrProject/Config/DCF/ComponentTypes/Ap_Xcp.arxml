AUTOSAR XML (schema 314)
package /ComponentType
  application software component type Ap_Xcp
  internal behavior Ap_Xcp_InternalBehavior: component=Ap_Xcp
    timing event TMT_DAQ_2msTL: start-on-event=DAQ_2msTL, period=0.002
    timing event TMT_Xcp_Per1: start-on-event=Xcp_Per1, period=0.01
    runnable DAQ_2msTL
    runnable Xcp_Per1
  swc implementation Ap_Xcp_Implementation: behavior=Ap_Xcp_InternalBehavior
    code-descriptors:
      code Code: type=SRC
