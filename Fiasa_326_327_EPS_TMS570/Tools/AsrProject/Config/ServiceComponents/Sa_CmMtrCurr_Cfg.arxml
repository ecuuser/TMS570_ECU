AUTOSAR XML (schema 321)
package /ComponentType
  sensor actuator software component type Sa_CmMtrCurr
  internal behavior Sa_CmMtrCurr_InternalBehavior: component=Sa_CmMtrCurr
  swc implementation Sa_CmMtrCurr_Implementation: behavior=Sa_CmMtrCurr_InternalBehavior
    code-descriptors:
      code Code: type=SRC
package /PortInterface
  client server interface WdgM_CheckpointReached: is-service=true
    operation CheckpointReached: possible-error=E_NOT_OK  # Indicates to the Watchdog Manager that a Checkpoint within a Supervised Entity has been reached.
    error E_NOT_OK: error-code=1
