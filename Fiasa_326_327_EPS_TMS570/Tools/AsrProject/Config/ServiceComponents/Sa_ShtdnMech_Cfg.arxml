AUTOSAR XML (schema 321)
package /ComponentType
  sensor actuator software component type Sa_ShtdnMech
  internal behavior Sa_ShtdnMech_InternalBehavior: component=Sa_ShtdnMech
  swc implementation Sa_ShtdnMech_Implementation: behavior=Sa_ShtdnMech_InternalBehavior
    code-descriptors:
      code Code: type=SRC
package /PortInterface
  client server interface WdgM_CheckpointReached: is-service=true
    operation CheckpointReached: possible-error=E_NOT_OK  # Indicates to the Watchdog Manager that a Checkpoint within a Supervised Entity has been reached.
    error E_NOT_OK: error-code=1
