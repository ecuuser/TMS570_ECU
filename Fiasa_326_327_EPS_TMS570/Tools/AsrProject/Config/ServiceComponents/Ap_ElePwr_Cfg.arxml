AUTOSAR XML (schema 321)
package /ComponentType
  application software component type Ap_ElePwr
  internal behavior Ap_ElePwr_InternalBehavior: component=Ap_ElePwr
  swc implementation Ap_ElePwr_Implementation: behavior=Ap_ElePwr_InternalBehavior
    code-descriptors:
      code Code: type=SRC
package /PortInterface
  client server interface WdgM_CheckpointReached: is-service=true
    operation CheckpointReached: possible-error=E_NOT_OK  # Indicates to the Watchdog Manager that a Checkpoint within a Supervised Entity has been reached.
    error E_NOT_OK: error-code=1
