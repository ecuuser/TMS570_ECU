AUTOSAR XML (schema 3.2.1)
standard types defined: Boolean, UInt8, UInt16, UInt32
package /ComponentType
  internal behavior ComMInternalBehavior: component=ComM
    timing event Timer_ComM_MainFunction_1300cf42: start-on-event=ComM_MainFunction_0, period=0.01
    11 x operation invoked event:
      OpEventComM_UserRequest_16ed2913: start-on-event=GetCurrentComMode, operation=UR_ComMUser_CCAN.GetCurrentComMode
      OpEventComM_UserRequest_36540e3e: start-on-event=RequestComMode, operation=UR_ComMUser_CCAN.RequestComMode
      OpEventComM_UserRequest_dea8ee6a: start-on-event=GetRequestedMode, operation=UR_ComMUser_CCAN.GetRequestedMode
      OpEventComM_UserRequest_939157e8: start-on-event=GetMaxComMode, operation=UR_ComMUser_CCAN.GetMaxComMode
      OpEventComM_ECUModeLimi_56ef1311: start-on-event=ReadInhibitCounter, operation=modeLimitation.ReadInhibitCounter
      OpEventComM_ECUModeLimi_af552dc0: start-on-event=SetECUGroupClassification, operation=modeLimitation.SetECUGroupClassification
      OpEventComM_ECUModeLimi_5b4f977d: start-on-event=ResetInhibitCounter, operation=modeLimitation.ResetInhibitCounter
      OpEventComM_ECUModeLimi_dc1297bc: start-on-event=LimitECUToNoComMode, operation=modeLimitation.LimitECUToNoComMode
      OpEventComM_ChannelLimi_af95168d: start-on-event=GetInhibitionStatus, operation=CL_CCAN.GetInhibitionStatus
      OpEventComM_ChannelLimi_a67f3266: start-on-event=LimitChannelToNoComMode, operation=CL_CCAN.LimitChannelToNoComMode
      OpEventComM_ChannelWake_44599e88: start-on-event=PreventWakeUp, operation=CW_CCAN.PreventWakeUp
    port-api-options port-api-option={enable-take-address=true, indirect-api=false, port=modeLimitation}:
      port-api-option enable-take-address=true, indirect-api=false, port=UR_ComMUser_CCAN:
        port-arg-values:
          integer literal UR_ComMUser_CCAN: type=ComM_UserHandleType, value=0
      port-api-option enable-take-address=true, indirect-api=false, port=CL_CCAN:
        port-arg-values:
          integer literal CL_CCAN: type=ComM_NetworkHandleType, value=0
      port-api-option enable-take-address=true, indirect-api=false, port=CW_CCAN:
        port-arg-values:
          integer literal CW_CCAN: type=ComM_NetworkHandleType, value=0
    12 x runnable, all with can-be-invoked-concurrently=true:
      ComM_MainFunction_0
      RequestComMode: symbol=ComM_RequestComMode
      GetCurrentComMode: symbol=ComM_GetCurrentComMode
      GetMaxComMode: symbol=ComM_GetMaxComMode
      GetRequestedMode: symbol=ComM_GetRequestedComMode
      LimitECUToNoComMode: symbol=ComM_LimitECUToNoComMode
      ReadInhibitCounter: symbol=ComM_ReadInhibitCounter
      ResetInhibitCounter: symbol=ComM_ResetInhibitCounter
      SetECUGroupClassification: symbol=ComM_SetECUGroupClassification
      LimitChannelToNoComMode: symbol=ComM_ServiceLimitChannelToNoComMode
      GetInhibitionStatus: symbol=ComM_GetInhibitionStatus
      PreventWakeUp: symbol=ComM_ServicePreventWakeUp
  swc implementation ComMImplementation: behavior=ComMInternalBehavior
  service component type ComM: category=ServiceComponent
    4 x provide port:
      UR_ComMUser_CCAN: provided-interface=ComM_UserRequest
      modeLimitation: provided-interface=ComM_ECUModeLimitation
      CL_CCAN: provided-interface=ComM_ChannelLimitation
      CW_CCAN: provided-interface=ComM_ChannelWakeUp
package /PortInterface
  4 x client server interface, all with is-service=true:
    ComM_UserRequest
      4 x operation:
        RequestComMode: possible-error=[ComM_UserRequest/E_NOT_OK, E_MODE_LIMITATION]
          arg ComMode: type=ComM_ModeType, direction=IN
        GetCurrentComMode: possible-error=ComM_UserRequest/E_NOT_OK
          arg ComMode: type=ComM_ModeType, direction=OUT
        GetMaxComMode: possible-error=ComM_UserRequest/E_NOT_OK
          arg ComMode: type=ComM_ModeType, direction=OUT
        GetRequestedMode: possible-error=ComM_UserRequest/E_NOT_OK
          arg ComMode: type=ComM_ModeType, direction=OUT
      error E_NOT_OK: error-code=1
      error E_MODE_LIMITATION: error-code=2
    ComM_ECUModeLimitation
      4 x operation, all with possible-error=ComM_ECUModeLimitation/E_NOT_OK:
        LimitECUToNoComMode
          arg Status: type=Boolean, direction=IN
        ReadInhibitCounter
          arg CounterValue: type=UInt16, direction=OUT
        ResetInhibitCounter
        SetECUGroupClassification
          arg Status: type=ComM_InhibitionStatusType, direction=IN
      error E_NOT_OK: error-code=1
    ComM_ChannelLimitation
      operation LimitChannelToNoComMode: possible-error=ComM_ChannelLimitation/E_NOT_OK
        arg Status: type=Boolean, direction=IN
      operation GetInhibitionStatus: possible-error=ComM_ChannelLimitation/E_NOT_OK
        arg Status: type=ComM_InhibitionStatusType, direction=OUT
      error E_NOT_OK: error-code=1
    ComM_ChannelWakeUp
      operation PreventWakeUp: possible-error=ComM_ChannelWakeUp/E_NOT_OK
        arg Status: type=Boolean, direction=IN
      error E_NOT_OK: error-code=1
package /DataType
  integer type ComM_ModeType: compu {0=COMM_NO_COMMUNICATION, 1=COMM_SILENT_COMMUNICATION, 2=COMM_FULL_COMMUNICATION}, lower-limit=0, upper-limit=2
  integer type ComM_UserHandleType: lower-limit=0, upper-limit=255
  integer type ComM_InhibitionStatusType: lower-limit=0, upper-limit=0
  integer type ComM_NetworkHandleType: lower-limit=0, upper-limit=255
  mode declaration group ComMMode: initial-mode=NO_COMMUNICATION
    mode NO_COMMUNICATION
    mode SILENT_COMMUNICATION
    mode FULL_COMMUNICATION
