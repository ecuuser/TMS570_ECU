AUTOSAR XML (schema 3.0.1)
package /MICROSAR
  module config CanIf_Pre: definition=CanIf, implementation-config-variant=VARIANT-PRE-COMPILE
    CanIfPublicConfiguration:
      CanIfMultipleDriverSupport = false
      CanIfNumberOfCanHwUnits = 1
      CanIfReadRxPduDataApi = false
      CanIfReadRxPduNotifyStatusApi = false
      CanIfReadTxPduNotifyStatusApi = false
    CanIfPrivateConfiguration:
      CanIf_SupportExtendedIds = true
      CanIf_TransmitCancellationAPI = false
      CanIf_BusOffRecovery = false
      CanIf_ExtendedStateMachine = false
      CanIf_Autosar21_ComM_Compliance = false
      CanIf_AsrIfCan_IsLibrarySolution = false
      CanIfDlcFailedReportDem = true
      CanIf_TxBufferAPI = Bit_queue
    CanIfDispatchConfig:
      CanIfBusOffNotification = CanSM_ControllerBusOff
      CanIfWakeupNotification = EcuM_SetWakeupEvent
      CanIfWakeupValidNotification = CanIfWakeupValidNotification
  module config CanIf_Rec: definition=CanIf
    CanIfPublicConfiguration: CanIfDevErrorDetect=false, CanIfVersionInfoApi=false, CanIfProdErrorDetect=true
    CanIfPrivateConfiguration: CanIfSoftwareFilterType=LINEAR, CanIf_TransceiverMapping=false, CanIf_TransceiverHandling=true, CanIfDlcCheck=true
  module config CanIf_Rec_Class1: definition=CanIf
    CanIfDriverConfig: CanIfTransmitCancellation=false
