AUTOSAR XML (schema 3.0.1)
package /MICROSAR
  bsw implementation EcuM_Impl: code-generator=cMICROSAR,GENy, programming-language=C, sw-major-version=7, sw-minor-version=6, sw-patch-version=1, vendor-id=30, ar-major-version=1, ar-minor-version=2, ar-patch-version=0, preconfigured-configuration=EcuM_Pre, recommended-configuration=EcuM_Rec, vendor-specific-module-def=EcuM
  module definition EcuM [0..1]: refined-module-def=EcuM, variants post-build/pre-compile  # Configuration of the EcuM (ECU State Manager) module.
    container EcuMConfiguration: multiple-configuration-container=true  # This container contains the configuration (parameters) of the ECU State Manager
      integer EcuMConfigConsistencyHash: 0..0, set at pre-compile, default-value=0  # NOT USED
      float EcuMNvramReadallTimeout: 0..0.0, set at pre-compile, default-value=0  # Period given in seconds for which the ECU State Manager will wait until it considers a ReadAll job of the NVRAM Manager as failed.
      float EcuMNvramWriteallTimeout: 0..240, set at pre-compile, default-value=60  # Period given in seconds for which the ECU State Manager will wait until it considers a WriteAll job of the NVRAM Manager as failed.
      float EcuMRunMinimumDuration: 0.0..100000.0, set at post-build in variant post-build / pre-compile in variant pre-compile, default-value=0.1  # Duration given in seconds for which the ECU State Manager will stay in RUN state even when no one requests RUN. This duration should be long at least as long as a SW-Cs needs to request RUN. The time is specified in seconds.
      float EcuMSleepActivityPeriod: 0..0.0, set at pre-compile, default-value=0  # Period of the EcuM_SleepActivity callout. The period is given in seconds.
      string EcuMComStackTypesIncludeFile: set at post-build in variant post-build / pre-compile in variant pre-compile, origin=Vector Informatik, default-value=ComStack_Types.h  # Include which defines types used by the communication stack.
      choice reference EcuMModuleConfigurationRef [0..*]: set at post-build in variant post-build / pre-compile in variant pre-compile, destination=[GptChannelConfigSet, WdgMConfigSet, AdcConfigSet, SpiDriver, FlsConfigSet, CanConfigSet, FrTpMultipleConfig, WdgModeConfig, PwmChannelConfigSet, CanStateManagerConfiguration, IcuConfigSet, LinSMChannel, FrSmCluster, FrNmChannelConfig, PortConfigSet, McuModuleConfiguration, DemConfigSet, EepInitConfiguration, CanNmGlobalConfig, DcmConfigSet, CanTpConfigSet, CanIfInitConfiguration, PduRGlobalConfig, ComConfig, IPduMConfig, LinIfGlobalConfig, LinTpGlobalConfig, LinGlobalConfig, FrIfConfig, FrMultipleConfiguration, ComMConfig, CanTrcvConfigSet]  # This parameter contains a reference to the init structure of the corresponding BSW module.
      symbolic name reference EcuMDefaultAppMode: set at post-build in variant post-build / pre-compile in variant pre-compile, destination=OsAppMode  # The default application mode loaded when the ECU comes out of reset.
      symbolic name reference EcuMNormalMcuModeRef [0..1]: set at pre-compile, destination=McuModeSettingConf  # NOT USED
      container EcuMDefaultShutdownTarget  # This container describes the default shutdown target to be selected by EcuM. The actual shutdown target may be overridden by the EcuM_SelectShutdownTarget service.
        enumeration EcuMDefaultState: {EcuMStateOff, EcuMStateReset, EcuMStateSleep}, set at post-build in variant post-build / pre-compile in variant pre-compile, default-value=EcuMStateReset  # This parameter describes the state part of the default shutdown target selected when the ECU comes out of reset. If EcuMStateSleep is selected, the parameter EcuMDefaultSleepModeRef selects the specific sleep mode.
        symbolic name reference EcuMDefaultSleepModeRef [0..1]: set at post-build in variant post-build / pre-compile in variant pre-compile, destination=EcuMSleepMode  # If EcuMDefaultShutdownTarget is EcuMStateSleep, this parameter selects the default sleep mode. Otherwise this parameter may be ignored. RESTRICTIONS: 'EcuMDefaultSleepModeRef' is only available, if 'EcuMDefaultState' is set to 'EcuMStateSleep'.
      container EcuMDriverInitListOne  # Container for Init Block I. This container holds a list of module IDs that will be initialised. Each module in the list will be called for initialisation in the list order. All modules in this list are initilialised before the OS is started and so these modules require no OS support.
        container EcuMDriverInitItem [0..*]  # This container describes one entry in a driver init list.
          string EcuMModuleID: set at post-build in variant post-build / pre-compile in variant pre-compile, default-value=Code  # Short name of the module to be initialized, e.g. Mcu, Gpt etc. Enter the Keyword 'Code' here to enable the Code field below.
          string EcuMModuleService: set at post-build in variant post-build / pre-compile in variant pre-compile  # The service to be called to initialize that module, e.g. Init, PreInit, Start etc. If the service is Init and the parameter EcuMModuleConfigurationRef has been set for that module, the corresponding pointer to the init structure (<Module>_ConfigType) shall be passed as an argument. RESTRICTIONS: 'EcuMModuleService' is only available, if 'EcuMModuleID' is set to an value not equal 'Code'. This parameter can only be used if the function signature of the Init-function matches the Autosar spezification. Precompile changes of the API are not regarded. Use 'Code' in parameter 'EcuMModuleId' to configure such a function.
          string EcuMAdditionalInitCode: set at post-build in variant post-build / pre-compile in variant pre-compile, origin=Vector Informatik  # This Parameter allows adding additional code in the callout function, e.g. Mcu_InitClock(). RESTRICTIONS: 'EcuMAdditionalInitCode' is only available, if 'EcuMModuleID' is set to 'Code'.
      container EcuMDriverInitListTwo  # Container for Init Block II. This container holds a list of module IDs that will be initialised. Each module in the list will be called for initialisation in the list order. All modules in this list are initilialised after the OS is started and so these modules may use OS support. These modules may not rely on the Nvram ReadAll job to have provided all data.
        container EcuMDriverInitItem [0..*]  # This container describes one entry in a driver init list.
          string EcuMModuleID: set at post-build in variant post-build / pre-compile in variant pre-compile, default-value=Code  # Short name of the module to be initialized, e.g. Mcu, Gpt etc. Enter the Keyword 'Code' here to enable the Code field below.
          string EcuMModuleService: set at post-build in variant post-build / pre-compile in variant pre-compile  # The service to be called to initialize that module, e.g. Init, PreInit, Start etc. If the service is Init and the parameter EcuMModuleConfigurationRef has been set for that module, the corresponding pointer to the init structure (<Module>_ConfigType) shall be passed as an argument. RESTRICTIONS: 'EcuMModuleService' is only available, if 'EcuMModuleID' is set to an value not equal 'Code'. This parameter can only be used if the function signature of the Init-function matches the Autosar spezification. Precompile changes of the API are not regarded. Use 'Code' in parameter 'EcuMModuleId' to configure such a function.
          string EcuMAdditionalInitCode: set at post-build in variant post-build / pre-compile in variant pre-compile, origin=Vector Informatik  # This Parameter allows adding additional code in the callout function, e.g. Mcu_InitClock(). RESTRICTIONS: 'EcuMAdditionalInitCode' is only available, if 'EcuMModuleID' is set to 'Code'.
      container EcuMDriverInitListThree  # Container for Init Block III. This container holds a list of module IDs that will be initialised. Each module in the list will be called for initialisation in the list order. All modules in this list are initilialised after the OS is started and so these modules may use OS support. These modules may also rely on the Nvram ReadAll job to have provided all data.
        container EcuMDriverInitItem [0..*]  # This container describes one entry in a driver init list.
          string EcuMModuleID: set at post-build in variant post-build / pre-compile in variant pre-compile, default-value=Code  # Short name of the module to be initialized, e.g. Mcu, Gpt etc. Enter the Keyword 'Code' here to enable the Code field below.
          string EcuMModuleService: set at post-build in variant post-build / pre-compile in variant pre-compile  # The service to be called to initialize that module, e.g. Init, PreInit, Start etc. If the service is Init and the parameter EcuMModuleConfigurationRef has been set for that module, the corresponding pointer to the init structure (<Module>_ConfigType) shall be passed as an argument. RESTRICTIONS: 'EcuMModuleService' is only available, if 'EcuMModuleID' is set to an value not equal 'Code'. This parameter can only be used if the function signature of the Init-function matches the Autosar spezification. Precompile changes of the API are not regarded. Use 'Code' in parameter 'EcuMModuleId' to configure such a function.
          string EcuMAdditionalInitCode: set at post-build in variant post-build / pre-compile in variant pre-compile, origin=Vector Informatik  # This Parameter allows adding additional code in the callout function, e.g. Mcu_InitClock(). RESTRICTIONS: 'EcuMAdditionalInitCode' is only available, if 'EcuMModuleID' is set to 'Code'.
      container EcuMDriverInitListZero [0..1]  # NOT USED
        container EcuMDriverInitItem [0..*]  # not used!! This container describes one entry in a driver init list.
          string EcuMModuleID: set at post-build in variant post-build / pre-compile in variant pre-compile, default-value=Code  # not used!! Short name of the module to be initialized, e.g. Mcu, Gpt etc.
          string EcuMModuleService: set at post-build in variant post-build / pre-compile in variant pre-compile  # not used!! The service to be called to initialize that module, e.g. Init, PreInit, Start etc. If the service is Init and the parameter EcuMModuleConfigurationRef has been set for that module, the corresponding pointer to the init structure (<Module>_ConfigType) shall be passed as an argument.
      container EcuMDriverRestartList  # List of module IDs. EcuM2719: A configuration tool shall fill the callout EcuM_AL_DriverRestart with initialization calls to the listed drivers in the order in which they occur in the list. EcuM2720: Entries in this list must appear in the same order as in the combined list of EcuM_DriverInitListOne and EcuM_DriverInitListTwo. This list may be a real subset though. In all other cases, the generation tool shall report an error. The included container has the same structure as EcuM_DriverInitItem
        container EcuMDriverInitItem [0..*]  # This container describes one entry in a driver init list.
          string EcuMModuleID: set at post-build in variant post-build / pre-compile in variant pre-compile, default-value=Code  # Short name of the module to be initialized, e.g. Mcu, Gpt etc. Enter the Keyword 'Code' here to enable the Code field below.
          string EcuMModuleService: set at post-build in variant post-build / pre-compile in variant pre-compile  # The service to be called to initialize that module, e.g. Init, PreInit, Start etc. If the service is Init and the parameter EcuMModuleConfigurationRef has been set for that module, the corresponding pointer to the init structure (<Module>_ConfigType) shall be passed as an argument. RESTRICTIONS: 'EcuMModuleService' is only available, if 'EcuMModuleID' is set to an value not equal 'Code'. This parameter can only be used if the function signature of the Init-function matches the Autosar spezification. Precompile changes of the API are not regarded. Use 'Code' in parameter 'EcuMModuleId' to configure such a function.
          string EcuMAdditionalInitCode: set at post-build in variant post-build / pre-compile in variant pre-compile, origin=Vector Informatik  # This Parameter allows adding additional code in the callout function, e.g. Mcu_InitClock(). RESTRICTIONS: 'EcuMAdditionalInitCode' is only available, if 'EcuMModuleID' is set to 'Code'.
      container EcuMSleepMode [0..*]  # This container describes one configured sleep mode. RESTRICTIONS: Mcu module must be available within the EcuC configuration.
        integer EcuMSleepModeId: 0..255, set at post-build in variant post-build / pre-compile in variant pre-compile, default-value=0  # This parameter specifies the ID of the sleep mode. It can be used for services like EcuM_SelectShutdownTarget().
        string EcuMSleepModeName: set at post-build in variant post-build / pre-compile in variant pre-compile, symbolic-name-value=true, default-value=EcuMSleepMode  # This parameter specifies the name of the current sleep mode configuration.
        boolean EcuMSleepModeSuspend: set at post-build in variant post-build / pre-compile in variant pre-compile, default-value=false  # NOT USED
        string EcuMMcuMode [0..1]: set at post-build in variant post-build / pre-compile in variant pre-compile, origin=Vector Informatik  # The following parameter stores the MCU sleep modes. Normally the valuelist shall be empty because the used parameters are only available in the MCU driver and shall be added automatically after the start of new projects in this paramater "EcuMMcuMode". Please note that this is a workaround. It is required for the V85x fx3 derivatives from Renesas -formerly NEC- RESTRICTIONS: 'EcuMMcuMode' must only be configured if the Mcu module does not specify the mode id in the expected AUTOSAR 3.0 format AND 'EcuMAvailableMcuModes' is used
        symbolic name reference EcuMSleepModeMcuModeRef: set at post-build in variant post-build / pre-compile in variant pre-compile, destination=McuModeSettingConf  # This parameter specifies the MCU mode which should the ECUM select when the sleep mode is entered. RESTRICTIONS: Mcu module must be available within the EcuC configuration.
        symbolic name reference EcuMSleepModeWdgMModeRef [0..1]: set at post-build in variant post-build / pre-compile in variant pre-compile, destination=WdgMMode  # This parameter defines the Watchdog Manager mode that shall be active in this sleep mode. RESTRICTIONS: 'EcuMSleepModeWdgMModeRef' is only available, if 'EcuMIncludeWdgM' is set to 'true'.
        symbolic name reference EcuMWakeupSourceMask [1..*]: set at pre-compile in variant pre-compile / post-build in variant post-build, destination=EcuMWakeupSource  # This parameter is a reference to the wakeup source that shall be enabled for this sleep mode.
      container EcuMTTII [0..*]  # This container specifies the data structure for TTII use. The items will be generated in the same order as in the list defined. It is proposed that this list is ordered from more power consumtion to less power consumtion. ATTENTION: The integrator has the responsibility to order this list from more power consuming to less power consuming. RESTRICTIONS: 'EcuMTTII' is only available, if 'EcuMTTIIEnabled' is set to 'true'.
        integer EcuMDivisor: 1..65535, set at pre-compile in variant pre-compile / post-build in variant post-build, default-value=1  # This parameter specifies the divisor preload value. RESTRICTIONS: 'EcuMDivisor' is only available, if 'EcuMTTIIEnabled' is set to 'true'.
        symbolic name reference EcuMSleepModeRef [0..1]: set at post-build in variant post-build / pre-compile in variant pre-compile, destination=EcuMSleepMode  # NOT USED
        symbolic name reference EcuMSuccessorRef: set at post-build in variant post-build / pre-compile in variant pre-compile, destination=EcuMSleepMode  # This parameter is a reference to the next sleep mode in the TTII protocol. RESTRICTIONS: 'EcuMSuccessorRef' is only available, if 'EcuMTTIIEnabled' is set to 'true'.
      container EcuMUserConfig [1..*]  # A list of identifiers that are needed to refer to a software component or another appropriate entity in the system which is designated to request the RUN state. Application requestors refer to entities above RTE, system requestors to entities below RTE (e.g. Communication Manager).
        integer EcuMUser: 1..255, set at post-build in variant post-build / pre-compile in variant pre-compile, symbolic-name-value=true, default-value=1  # This parameter specifies the ID of the configured user.
      container EcuMWakeupSource [1..32]  # This container describes one configured wakeup source.
        integer EcuMResetReason: -1..9223372036854775807, set at pre-compile in variant pre-compile / post-build in variant post-build, default-value=-1  # This parameter describes the mapping of reset reasons detected by the MCU driver into wakeup sources. Please enter the value returned by Mcu_GetResetReason() which should mapped to the according wakeup source. Let this field free or enter "-1" if the value is unknown. If no value is configured or "-1" is inserted the reset reason will be mapped to ECUM_WKSOURCE_RESET.
        float EcuMValidationTimeout: 0.0..100000.0, set at pre-compile in variant pre-compile / post-build in variant post-build, default-value=0  # This parameter specifies the maximum validation timeout for a wakeup source. If the timeout expires the ECU is going into sleep state. Wakeup sources which don't need validation must have a value of 0.The timeout is specified in seconds.
        integer EcuMWakeupSourceId: 1..2147483648, set at post-build in variant post-build / pre-compile in variant pre-compile, symbolic-name-value=true, default-value=1  # This parameter defines the identifier of this wakeup source.
        boolean EcuMWakeupSourcePolling: set at post-build in variant post-build / pre-compile in variant pre-compile, default-value=false  # NOT USED
        float EcuMCheckWakeupTimeout [0..1]: 0..10, set at pre-compile, default-value=0  # This parameter specifies the maximum time between the call of EcuM_CheckWakeup and an anychron call of EcuM_SetWakeupEvent of the same wakeup source. If the timeout expires the ECU is allowed to go into sleep state. For wakeup sources where it is ensured that the EcuM_SetWakeupEvent is called before EcuM_CheckWakeup function ends the timout value shall be 0.The timeout is specified in seconds.
        symbolic name reference EcuMComMChannelRef [0..1]: set at post-build in variant post-build / pre-compile in variant pre-compile, destination=ComMChannel  # This parameter is a reference to a Network (channel) defined in the Communication Manager. No reference indicates that the wakeup source is not a communication channel.
      container EcuMWdgM [0..1]  # This container holds the configuration parameters for the interaction between the Watchdog Manager (WdgM) and EcuM. The WdgM mode to be selected in a specific Sleep Mode of EcuM is configured in the EcuMSleepMode container. RESTRICTIONS: 'EcuMWdgM' is only available, if 'EcuMIncludeWdgM' is set to 'true'.
        reference EcuMWdgMPostRunModeRef: set at post-build in variant post-build / pre-compile in variant pre-compile, destination=WdgMMode  # This parameter references the WdgM mode to be set when entering the POST RUN state of EcuM. RESTRICTIONS: 'EcuMWdgMPostRunModeRef' is only available, if 'EcuMIncludeWdgM' is set to 'true'.
        reference EcuMWdgMRunModeRef: set at post-build in variant post-build / pre-compile in variant pre-compile, destination=WdgMMode  # This parameter references the WdgM mode to be set when entering the RUN state of EcuM. RESTRICTIONS: 'EcuMWdgMRunModeRef' is only available, if 'EcuMIncludeWdgM' is set to 'true'.
        reference EcuMWdgMShutdownModeRef: set at post-build in variant post-build / pre-compile in variant pre-compile, destination=WdgMMode  # This parameter references the WdgM mode to be set when leaving the GO OFF I state of EcuM. RESTRICTIONS: 'EcuMWdgMShutdownModeRef' is only available, if 'EcuMIncludeWdgM' is set to 'true'.
        reference EcuMWdgMStartupModeRef [0..1]: set at post-build in variant post-build / pre-compile in variant pre-compile, destination=WdgMMode  # not used! This parameter references the WdgM mode to be set when entering the STARTUP II state of EcuM.
        reference EcuMWdgMWakeupModeRef: set at post-build in variant post-build / pre-compile in variant pre-compile, destination=WdgMMode  # This parameter references the WdgM mode to be set when entering the WAKEUP I state of EcuM. RESTRICTIONS: 'EcuMWdgMWakeupModeRef' is only available, if 'EcuMIncludeWdgM' is set to 'true'.
        symbolic name reference EcuMSupervisedEntityRef [0..1]: set at pre-compile, destination=WdgMSupervisedEntity  # not used! This parameter references the Supervised Entity ID that way configured for EcuM in the Watchdog Manager.
    container EcuMGeneral  # This container holds the general, pre-compile configuration parameters
      boolean EcuMDevErrorDetect: set at pre-compile, default-value=true  # It is the main switch over following buttons: - Check Parameter - Check Uninit - Det Errorhook include file - Det Errorhook Function The checks simplify the search for errors. In production mode, this switch should be disabled to save RAM and to speed up the module.
      boolean EcuMIncludeDem: set at post-build in variant post-build / pre-compile in variant pre-compile, default-value=false  # Enable/disables the use of the DEM.
      boolean EcuMIncludeDet: set at post-build in variant post-build / pre-compile in variant pre-compile, default-value=false  # Enable/disables the use of the DET.
      boolean EcuMIncludeNvramMgr: set at pre-compile, default-value=false  # Enable/disables the use of the NVRAM Manager.
      boolean EcuMIncludeWdgM: set at post-build in variant post-build / pre-compile in variant pre-compile, default-value=false  # Enable/disables the use of the Watchdog Manager.
      float EcuMMainFunctionPeriod: 0.001..100000, set at post-build in variant post-build / pre-compile in variant pre-compile, default-value=0.01  # This parameter defines the schedule period of EcuM_MainFunction. Unit: [s]
      boolean EcuMTTIIEnabled: set at pre-compile, default-value=false  # This parameter enables / disables the use of the TTII protocol.
      boolean EcuMVersionInfoApi: set at pre-compile, default-value=false  # This switch enables or disables the EcuM_GetVersionInfo() API function.
      boolean EcuMIncludeComM: set at post-build in variant post-build / pre-compile in variant pre-compile, origin=Vector Informatik, default-value=false  # Enable/disables the use of the ComM.
      boolean EcuMIncludeRte: set at post-build in variant post-build / pre-compile in variant pre-compile, origin=Vector Informatik, default-value=true  # Enable/disables the use of the Rte.
      boolean EcuMCheckParameter: set at pre-compile, origin=Vector Informatik, default-value=true  # This parameter enables/disables the following parameter check: CheckPointerParameter CheckStateParameter CheckWkSourceParameter CheckBootTargetParameter CheckSleepModeParameter CheckUserParameter RESTRICTIONS: 'EcuMCheckParameter' is only available, if 'EcuMDevErrorDetect' is set to 'true'.
      boolean EcuMCheckPointerParameter: set at pre-compile, origin=Vector Informatik, default-value=true  # Disables/enables the null pointer parameter check. RESTRICTIONS: 'EcuMCheckPointerParameter' is only available, if 'EcuMCheckParameter' is set to 'true'.
      boolean EcuMCheckStateParameter: set at pre-compile, origin=Vector Informatik, default-value=true  # Disables/enables the state parameter check. RESTRICTIONS: 'EcuMCheckStateParameter' is only available, if 'EcuMCheckParameter' is set to 'true'.
      boolean EcuMCheckWkSourceParameter: set at pre-compile, origin=Vector Informatik, default-value=true  # Disables/enables the wakeup source parameter check. RESTRICTIONS: 'EcuMCheckWkSourceParameter' is only available, if 'EcuMCheckParameter' is set to 'true'.
      boolean EcuMCheckBootTargetParameter: set at pre-compile, origin=Vector Informatik, default-value=true  # Disables/enables the boottarget parameter check. RESTRICTIONS: 'EcuMCheckBootTargetParameter' is only available, if 'EcuMCheckParameter' is set to 'true'.
      boolean EcuMCheckSleepModeParameter: set at pre-compile, origin=Vector Informatik, default-value=true  # Disables/enables the sleep mode parameter check. RESTRICTIONS: 'EcuMCheckSleepModeParameter' is only available, if 'EcuMCheckParameter' is set to 'true'.
      boolean EcuMCheckUserParameter: set at pre-compile, origin=Vector Informatik, default-value=true  # Disables/enables the sleep mode parameter check. RESTRICTIONS: 'EcuMCheckUserParameter' is only available, if 'EcuMCheckParameter' is set to 'true'.
      boolean EcuMEnableProdErrorReporting: set at pre-compile, origin=Vector Informatik, default-value=true  # Enables the reporting of production errors.
      boolean EcuMReportAllRunRequestsKilled: set at pre-compile, origin=Vector Informatik, default-value=true  # Enables the reporting of production error ECUM_ALL_RUN_REQUESTS_KILLED. RESTRICTIONS: 'EcuMReportAllRunRequestsKilled' is only available, if 'EcuMEnableProdErrorReporting' is set to 'true'.
      boolean EcuMReportRamCheckFailed: set at pre-compile, origin=Vector Informatik, default-value=true  # Enables the reporting of production error ECUM_RAM_CHECK_FAILED. RESTRICTIONS: 'EcuMReportAllRunRequestsKilled' is only available, if 'EcuMEnableProdErrorReporting' is set to 'true'.
      string EcuMDetErrorhookFunction: set at pre-compile, origin=Vector Informatik, default-value=Det_ReportError  # Name of the error reporting function of development errors. RESTRICTIONS: 'EcuMDetErrorhookFunction' is only available, if 'EcuMDevErrorDetect' is set to 'true'.
      string EcuMDemSetError: set at pre-compile, origin=Vector Informatik, default-value=Dem_ReportErrorStatus  # Name of the reporting function of production errors. RESTRICTIONS: 'EcuMDemSetError' is only available, if 'EcuMEnableProdErrorReporting' is set to 'true'.
      boolean EcuMCheckUnInit: set at pre-compile, origin=Vector Informatik, default-value=true  # This parameter enables/disables the check if the module is enabled. RESTRICTIONS: 'EcuMCheckUnInit' is only available, if 'EcuMDevErrorDetect' is set to 'true'.
      boolean EcuMCheckConfigType: set at pre-compile, origin=Vector Informatik, default-value=true  # Enables/Disables the check of the config structure not being a NULL_PTR. RESTRICTIONS: 'EcuMCheckConfigType' is only available, if 'EcuMCheckParameter' is set to 'true'.
      string EcuMAvailableMcuModes [0..*]: set at pre-compile in variant pre-compile / post-build in variant post-build, origin=Vector Informatik  # List of all available mcu modes RESTRICTIONS: 'EcuMAvailableMcuModes' must only be configured if the Mcu module does not specify the mode id in the expected AUTOSAR 3.0 format.
      boolean EcuMIncludeSchM: set at post-build in variant post-build / pre-compile in variant pre-compile, origin=Vector Informatik, default-value=false  # Enables/Disables the use of the Schedule Manager.
      string EcuMMcuIncludeFile: set at pre-compile, origin=Vector Informatik, default-value=Mcu.h  # Header file of Mcu Module
      string EcuMWdgMIncludeFile: set at post-build in variant post-build / pre-compile in variant pre-compile, origin=Vector Informatik, default-value=WdgM.h  # Header file of WdgM Module. RESTRICTIONS: 'EcuMWdgMIncludeFile' is only available, if 'EcuMIncludeWdgM' is set to 'true'.
      string EcuMComMIncludeFile: set at post-build in variant post-build / pre-compile in variant pre-compile, origin=Vector Informatik, default-value=ComM.h  # Header file of ComM Module. RESTRICTIONS: 'EcuMComMIncludeFile' is only available, if 'EcuMIncludeComM' is set to 'true'.
      string EcuMComMCallbackFile: set at post-build in variant post-build / pre-compile in variant pre-compile, origin=Vector Informatik, default-value=ComM_EcuM.h  # Callback Header file of ComM Module. RESTRICTIONS: 'EcuMComMCallbackFile' is only available, if 'EcuMIncludeComM' is set to 'true'.
      string EcuMRteIncludeFile: set at post-build in variant post-build / pre-compile in variant pre-compile, origin=Vector Informatik, default-value=Rte_Main.h  # Header file of Rte. RESTRICTIONS: 'EcuMRteIncludeFile' is only available, if 'EcuMIncludeRte' is set to 'true'.
      string EcuMNvmIncludeFile: set at post-build in variant post-build / pre-compile in variant pre-compile, origin=Vector Informatik, default-value=Nvm.h  # Header file of Nvm Module. RESTRICTIONS: 'EcuMNvmIncludeFile' is only available, if 'EcuMIncludeNvramMgr' is set to 'true'.
      string EcuMDetIncludeFile: set at post-build in variant post-build / pre-compile in variant pre-compile, origin=Vector Informatik, default-value=Det.h  # Header file of Det Module. RESTRICTIONS: 'EcuMDetIncludeFile' is only available, if 'EcuMIncludeDet' is set to 'true'.
      string EcuMDemIncludeFile: set at post-build in variant post-build / pre-compile in variant pre-compile, origin=Vector Informatik, default-value=Dem.h  # Header file of Dem Module. RESTRICTIONS: 'EcuMDemIncludeFile' is only available, if 'EcuMIncludeDem' is set to 'true'.
      string EcuMOsIncludeFile: set at pre-compile, origin=Vector Informatik, default-value=Os.h  # Header file of Os Module
      string EcuMSchMIncludeFile: set at post-build in variant post-build / pre-compile in variant pre-compile, origin=Vector Informatik, default-value=SchM.h  # Include file of Schedule Manager. RESTRICTIONS: 'EcuMSchMIncludeFile' is only available, if 'EcuMIncludeSchM' is set to 'true'.
      string EcuMDevErrorDetectIncludeFile: set at pre-compile, origin=Vector Informatik, default-value=Det.h  # Include file where the prototype of the used Errorreporting function (same prototype as Det_ReportError ) is defined. RESTRICTIONS: 'EcuMDevErrorDetectIncludeFile' is only available, if 'EcuMDevErrorDetect' is set to 'true'.
      string EcuMProdErrorDetectIncludeFile: set at pre-compile, origin=Vector Informatik, default-value=Dem.h  # Include file where the prototype of the used Errorreporting function (same prototype as Dem_ReportErrorStatus ) is defined. RESTRICTIONS: 'EcuMProdErrorDetectIncludeFile' is only available, if 'EcuMEnableProdErrorReporting' is set to 'true'.
      string EcuMAdditionalIncludes [0..*]: set at post-build in variant post-build / pre-compile in variant pre-compile, origin=Vector Informatik  # List of header files needed for driver init lists.
      float EcuMNvmCancelWriteAllTimeout: 0..60, set at pre-compile in variant pre-compile / post-build in variant post-build, origin=Vector Informatik, default-value=60  # This parameter specifies the time in seconds which shall be waited for NvM_WriteAll in case NvM_CancelWriteAll was called due to a wakeup event. The following coding is used: [0] - immediately abort the waiting mechanism. EcuM will switch immediately into RUN state or calls the optional NvM_KillWriteAll API before switching to RUN state. [60] - the maximum waiting time before the EcuM will continue with the wakeup sequence
      boolean EcuMAmdRuntimeMeasurement: set at pre-compile, origin=Vector Informatik, default-value=false  # This parameter is used to support the Amd Runtimemeasurement.
      string EcuMShutdownOSFunction: set at pre-compile in variant pre-compile / post-build in variant post-build, origin=Vector Informatik, default-value=ShutdownOS(E_OK)  # Name of the function which shall be called for Shutdown the OS.
      symbolic name reference EcuMTTIISleepModeRef [0..1]: set at pre-compile, destination=EcuMSleepMode  # not used! This configuration parameter references the initial sleep mode to be used by TTII when TTII is activated after a RUN mode. EcuM2785: Whenever RUN mode is reached, the TTII protocol shall be reset to use the wakeup source referenced by this parameter. This configuration parameter is a human readable name for a TTII wakeup source which is only needed by the configuration tool. For imlementation on the ECU, this parameter may be dropped and replaced by a generated list index of EcuM_TTII.
      reference EcuMIrqHandling [0..1]: set at pre-compile, origin=Vector Informatik, destination=InterruptFunctionSet  # Preprocessor switch to determine the IRQ function set which is used to protect critical sections. RESTRICTIONS: 'EcuMIrqHandling' is only available, if 'BoardUseSchm' is set to 'false'.
      reference EcuMTTIIWakeupSourceRef [0..1]: set at pre-compile, origin=Vector Informatik, destination=EcuMWakeupSource  # This parameter is a replacement of the parameter EcuMTTIISleepModeRef. This parameter references exactly one wakeup source which should be act as TTII wakeup source. RESTRICTIONS: 'EcuMTTIIWakeupSourceRef' is only available, if 'EcuMTTIIEnabled' is set to 'true'.
      reference EcuMWkupIsrHandling [0..1]: set at pre-compile, origin=Vector Informatik, destination=InterruptFunctionSet  # This parameter is a reference to an interrupt function set which should disable/enable the global interrupts. !! DO NOT USE AN OS FUNCTION FOR THIS PARAMETER !! NOTE: - This parameter is ECU specific and depends strongly on the used platform - No transformation of the value of this parameter will be performed, i.e. the user is responsible to enter the correct syntax of this parameter. RESTRICTIONS: 'EcuMWkupIsrHandling' is independent from 'BoardUseSchm'. In case SchM functionality will be used, it must be inserted into the coresponding 'interrupt function set'.
      container EcuMApiSwitches  # Container for which contains parameter for enabling/disabling the availability of APIs.
        boolean EcuMKillAllRUNRequestApi: set at pre-compile, origin=Vector Informatik, default-value=true  # This switch enables or disables the EcuM_KillAllRUNRequests() API function.
        boolean EcuMGetValidatedWakeupEventsApi: set at pre-compile, origin=Vector Informatik, default-value=true  # This switch enables or disables the EcuM_GetValidatedWekeupEvents() API function.
        boolean EcuMGetExpiredWakeupEventsApi: set at pre-compile, origin=Vector Informatik, default-value=true  # This switch enables or disables the EcuM_GetExpiredWakeupEvents() API function.
        boolean EcuMGetStatusOfWakeupSourceApi: set at pre-compile, origin=Vector Informatik, default-value=true  # This switch enables or disables the EcuM_GetStatusOfWakeupSource() API function.
      container EcuMCalloutSwitches  # Container for which contains parameter for enabling/disabling the availability of callouts.
        boolean EcuMOnRTEStartupCallout: set at pre-compile, origin=Vector Informatik, default-value=true  # This switch enables or disables the EcuM_OnRTEStartup() callout function.
        boolean EcuMOnEnterRunCallout: set at pre-compile, origin=Vector Informatik, default-value=true  # This switch enables or disables the EcuM_OnEnterRun() callout function.
        boolean EcuMOnExitRunCallout: set at pre-compile, origin=Vector Informatik, default-value=true  # This switch enables or disables the EcuM_OnExitRun() callout function.
        boolean EcuMOnExitPostRunCallout: set at pre-compile, origin=Vector Informatik, default-value=true  # This switch enables or disables the EcuM_OnExitPostRun() callout function.
        boolean EcuMOnPrepShutdownCallout: set at pre-compile, origin=Vector Informatik, default-value=true  # This switch enables or disables the EcuM_OnPrepShutdown() callout function.
        boolean EcuMOnGoSleepCallout: set at pre-compile, origin=Vector Informatik, default-value=true  # This switch enables or disables the EcuM_OnGoSleep() callout function.
        boolean EcuMOnGoOffOneCallout: set at pre-compile, origin=Vector Informatik, default-value=true  # This switch enables or disables the EcuM_OnGoOffOne() callout function.
        boolean EcuMOnGoOffTwoCallout: set at pre-compile, origin=Vector Informatik, default-value=true  # This switch enables or disables the EcuM_OnGoOffTwo() callout function.
        boolean EcuMOnWakeupReactionCallout: set at pre-compile, origin=Vector Informatik, default-value=true  # This switch enables or disables the EcuM_OnWakeupReaction() callout function.
        boolean EcuMGeneratorCompatibilityError: set at pre-compile, origin=Vector Informatik, default-value=false  # This parameter enables the callout EcuM_GeneratorCompatibilityError(). This switch must be enabled if components implements the CRC check.
        boolean EcuMOnErrorHook: set at pre-compile, origin=Vector Informatik, default-value=true  # This switch enables or disables the EcuM_ErrorHook() callout function.
        boolean EcuMOnStateChangeCallout: set at pre-compile, origin=Vector Informatik, default-value=false  # This switch enables or disables the EcuM_OnStateChange() callout function.
      container EcuMServicePortConfig  # Container for the configuration of Service Ports.
        boolean EcuMGenStateRequestPort: set at post-build in variant post-build / pre-compile in variant pre-compile, origin=Vector Informatik, default-value=false  # This parameter enables the generation of State Request Ports. RESTRICTIONS: 'EcuMGenStateRequestPort' is only available, if 'EcuMIncludeRte' is set to 'true.
        boolean EcuMGenBootTargetPort: set at post-build in variant post-build / pre-compile in variant pre-compile, origin=Vector Informatik, default-value=false  # This parameter enables the generation of BootTarget Ports. RESTRICTIONS: 'EcuMGenBootTargetPort' is only available, if 'EcuMIncludeRte' is set to 'true.
        boolean EcuMGenApplicationModePort: set at post-build in variant post-build / pre-compile in variant pre-compile, origin=Vector Informatik, default-value=false  # This parameter enables the generation of ApplicationMode Ports. RESTRICTIONS: 'EcuMGenApplicationModePort' is only available, if 'EcuMIncludeRte' is set to 'true.
        boolean EcuMGenShutdownTargetPort: set at post-build in variant post-build / pre-compile in variant pre-compile, origin=Vector Informatik, default-value=false  # This parameter enables the generation of ShutdownTarget Ports. RESTRICTIONS: 'EcuMGenShutdownTargetPort' is only available, if 'EcuMIncludeRte' is set to 'true.
        string EcuMServiceComponentName: set at post-build in variant post-build / pre-compile in variant pre-compile, origin=Vector Informatik, default-value=EcuM  # Name of the Service Component for import into Rte generation tool.
        boolean EcuMGenModeSwitchPort: set at pre-compile in variant pre-compile / post-build in variant post-build, origin=Vector Informatik, default-value=false  # This parameter enables the generation of the EcuM_CurrentMode sender-receiver interface within the SW-C description and the usage of a callback function for mode switch notification. The used notification function depends on the ECUM parameter EcuMIncludeRte: If this parameter is set to ON the ECUM will use the provided RTE function Rte_Switch_currentMode_currentMode(). If the parameter EcuMIncludeRte is set to OFF the callback function specified in EcuMModeSwitchCbkName will be used to notify mode switch event.
        string EcuMModeSwitchCbkName: set at pre-compile in variant pre-compile / post-build in variant post-build, origin=Vector Informatik, default-value=Appl_EcuM_currentMode_currentMode  # This parameter specifies the callback function name which should be used by ECUM for mode switch event notification if the parameter EcuMIncludeRte is set ot OFF and the parameter EcuMGenModeSwitchPort is set to ON. RESTRICTIONS: 'EcuMModeSwitchCbkName' is only available, if 'EcuMGenModeSwitchPort' is set to 'true'.
        boolean EcuMModeSwitchRteAck: set at pre-compile, origin=Vector Informatik, default-value=true  # This parameter enables the synchronisation mechanism with RTE. In case thi parameter is enabled, the EcuM waits on defined synchronistion points until the Rte switches into coresponding ECU mode. After receiving the ACK, EcuM will continue.
      container EcuMAppMode [0..*]  # This container holds the configuration parameters for the interaction between the Operating System and EcuM. This container represents a mapping to the OS Application Modes. These AppModes are used by EcuM_SelectApplicationMode and EcuM_GetApplicationMode APIs.
        symbolic name reference EcuMUsedAppModeRef: set at pre-compile in variant pre-compile / post-build in variant post-build, origin=Vector Informatik, destination=OsAppMode  # This parameter specifies the corresponding Os Application Mode.
    container VectorCommonData  # This configuration container contains Vector specific vendor data, which are relevant for configuration management purposes.
      string BswmdVersion: set at published-information, origin=Vector Informatik, default-value=6.06.01  # This parameter specifies the version of this bswmd file.
  module config EcuM_Pre: definition=EcuM
  module config EcuM_Rec: definition=EcuM
