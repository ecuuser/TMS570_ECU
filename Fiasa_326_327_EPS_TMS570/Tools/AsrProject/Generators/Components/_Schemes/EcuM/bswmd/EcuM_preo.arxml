AUTOSAR XML (schema 3.0.1)
package /MICROSAR
  module config EcuM_Pre: definition=EcuM, implementation-config-variant=VARIANT-PRE-COMPILE
    EcuMGeneral:
      EcuMDetIncludeFile = Det.h
      EcuMComMIncludeFile = ComM.h
      EcuMRteIncludeFile = Rte_Main.h
      EcuMCheckConfigType = false
      EcuMDetErrorhookFunction = Det_ReportError
      EcuMDemSetError = Dem_ReportErrorStatus
      EcuMComMCallbackFile = ComM_EcuM.h
      EcuMDemIncludeFile = Dem.h
      EcuMSchMIncludeFile = SchM.h
      EcuMDevErrorDetectIncludeFile = Det.h
      EcuMProdErrorDetectIncludeFile = Dem.h
      EcuMIncludeSchM = true
      EcuMCalloutSwitches: EcuMGeneratorCompatibilityError=false
  module config EcuM_Rec: definition=EcuM
    EcuMGeneral:
      EcuMIncludeRte = true
      EcuMIncludeDem = true
      EcuMDevErrorDetect = false
      EcuMVersionInfoApi = false
      EcuMIncludeSchM = true
      EcuMIncludeComM = true
      EcuMIncludeDet = true
      EcuMEnableProdErrorReporting = true
      EcuMIncludeNvramMgr = true
      EcuMIncludeWdgM = true
  module config EcuM_Pre_Class1: definition=EcuM
    EcuMConfiguration: EcuMComStackTypesIncludeFile=ComStack_Types.h
