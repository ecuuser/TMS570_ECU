AUTOSAR XML (schema 3.2.1)
package /MICROSAR
  bsw implementation PduR_Impl: code-generator=GENy, programming-language=C, sw-major-version=3, sw-minor-version=21, sw-patch-version=02, vendor-id=30, ar-major-version=2, ar-minor-version=2, ar-patch-version=1, preconfigured-configuration=PduR_Pre, recommended-configuration=PduR_Rec, vendor-specific-module-def=PduR
  module definition PduR [0..1]: refined-module-def=PduR, variants pre-compile/link-time/post-build  # Configuration of the PduR (PDU Router) module.
    container PduRBswModules [0..*]  # Each container describes a specific BSW module (upper/CDD/lower/IpduM) that the PDU Router shall interface to.
      boolean PduRCommunicationInterface: set at pre-compile, origin=Vector Informatik  # Specifies if the BSW module supports the Communication Interface APIs or not. Value true the APIs are supported.
      boolean PduRLowerModule: set at pre-compile, origin=Vector Informatik  # The PduRLowerModule will decide who will call the APIs and who will implement the APIs.
      boolean PduRTransportProtocol: set at pre-compile, origin=Vector Informatik  # The PDU Router module shall use the API parameters specified for transport protocol interface.
      boolean PduRTriggertransmit: set at pre-compile, origin=Vector Informatik  # Specifies if the BSW module supports the TriggerTransmit API or not. Value true the API is supported.
      enumeration PduRDataProvision: {NONE, DIRECT, TRIGGER_TRANSMIT, USER_DEFINED}, set at pre-compile  # Specifies the used data provision type of the BSW module. NONE: No data provision used DIRECT: Data provision in <Lo>_Transmit() context TRIGGER_TRANSMIT: Data provision in PduR_<Lo>TriggerTransmit() context USER_DEFINED: Mixed usage of DIRECT and TRIGGER_TRANSMIT data provision
      boolean PduRUpperModule: set at pre-compile, origin=Vector Informatik  # The PduRUpperModule will decide who will call the APIs and who will implement the APIs.
      boolean PduRCancelReceive: set at pre-compile, origin=Vector Informatik  # This parameter, if set to true, enables the PduR_<UpTp>CancelReceive Api for this Module.
      boolean PduRCancelTransmit: set at pre-compile, origin=Vector Informatik  # This parameter, if set to true, enables the PduR_<UpTp>CancelTransmit Api for this Module.
      boolean PduRChangeParameterRequestApi: set at pre-compile, origin=Vector Informatik  # This parameter, if set to true, enables the PduR_<UpTp>ChangeParameterRequest Api for this Module.
      boolean PduRReadParameterRequestApi: set at pre-compile, origin=Vector Informatik  # This parameter, if set to true, enables the PduR_<UpTp>ReadParameterRequest Api for this Module.
      boolean PduRUseTag: set at pre-compile, origin=Vector Informatik  # This parameter, if set to true, enables the usage of the tag (<up>) in the following API calls: * PduR_<UpTp>CancelReceive * PduR_<UpTp>CancelTransmit * PduR_<UpTp>ChangeParameter * PduR_<UpTp>ReadParameter Example for module Dcm: If parameter is enabled, the API PduR_DcmCancelTransmit() instead of PduR_CancelTransmit() is used.
    container PduRGeneral  # This container is a subcontainer of PduR and specifies the general configuration parameters of the PDU Router.
      boolean PduRCanIfSupport: set at pre-compile  # Configuration parameter to enable or disable PDU Router support for CAN interface.
      boolean PduRCanTpCancelReceive: set at pre-compile  # This parameter is not used by the PduR. Specifies if the Can Transport protocol module supports the CancelReceive API or not. Value true the API is supported.
      boolean PduRCanTpChangeParameterRequestApi: set at pre-compile  # This parameter is not used by the PduR. This parameter, if set to true, enables the PduR_CanTpChangeParameterRequest Api for CanTp.
      boolean PduRCanTpSupport: set at pre-compile  # Configuration parameter to enable or disable PDU Router support for CAN TP.
      boolean PduRMostTpSupport: set at pre-compile, origin=Vector Informatik  # Enable / Disable PduR support for the module MostTp. This parameter must be preconfigured. This feature is an extension to the PduR module.
      boolean PduRMostIfSupport: set at pre-compile, origin=Vector Informatik  # Enable / Disable PduR support for the module MostIf. This parameter must be preconfigured. This feature is an extension to the PduR module.
      boolean PduRComSupport: set at pre-compile  # Configuration parameter to enable or disable PDU Router support for COM.
      boolean PduRDcmSupport: set at pre-compile  # Configuration parameter to enable or disable PDU Router support for DCM.
      boolean PduRDevErrorDetect: set at pre-compile  # Switches the Development Error Detection and Notification ON or OFF.
      boolean PduRFifoTxBufferSupport: set at pre-compile  # Configuration parameter to enable or disable PDU Router support for FIFOs as PDU transmit buffers; if PDUR_GATEWAY_OPERATION is disabled, this parameter has to be disabled.
      boolean PduRFrIfSupport: set at pre-compile  # Configuration parameter to enable or disable PDU Router support for FlexRay interface.
      boolean PduRFrTpCancelReceive: set at pre-compile  # This parameter is not used by the PduR. Specifies if the Flaxray Transport protocol module supports the CancelReceive API or not. Value true the API is supported.
      boolean PduRFrTpChangeParameterRequestApi: set at pre-compile  # This parameter is not used by the PduR. This parameter, if set to true, enables the PduR_FrTpChangeParameterRequest Api for FrTp.
      boolean PduRFrTpSupport: set at pre-compile  # Configuration parameter to enable or disable PDU Router support for FlexRay TP.
      boolean PduRGatewayOperation: set at pre-compile  # Configuration parameter to enable or disable PDU Router gateway operation; if PDUR_ZERO_COST_OPERATION is enabled, this parameter has to be disabled.
      boolean PduRIpduMSupport: set at pre-compile  # Configuration parameter to enable or disable PDU Router support for IPDUM; if PDUR_ZERO_COST_OPERATION is enabled, this parameter has to be disabled.
      boolean PduRIpduMUpSupport [0..1]: set at pre-compile, origin=Vector Informatik  # Enable / Disable PduR support for the upper layer interface of the BSW module IPdu Multiplexer. This parameter must be preconfigured.
      boolean PduRLinIfSupport: set at pre-compile  # Configuration parameter to enable or disable PDU Router support for LIN interface.
      boolean PduRLinTpChangeParameterRequestApi: set at pre-compile  # This parameter is not used by the PduR. This parameter, if set to true, enables the PduR_LinTpChangeParameterRequest Api for LinTp.
      boolean PduRLinTpSupport: set at pre-compile  # Configuration parameter to enable or disable PDU Router support for LIN TP.
      integer PduRMemorySize: 0.., set at pre-compile in variant pre-compile / link in variant link-time+post-build, default-value=0  # Reserves buffer. Should post build configurations require additional buffer, it should be allocated at linktime. Parameter required for gateway operation only.
      boolean PduRMulticastFromIfSupport: set at pre-compile  # Configuration parameter to enable or disable PDU Router support for multicasts from an interface module to upper layer modules or lower layer interface modules; if PDUR_ZERO_COST_OPERATION is enabled, this parameter has to be disabled.
      boolean PduRMulticastFromTpSupport: set at pre-compile  # Configuration parameter to enable or disable PDU Router support for multicasts from a TP module to upper layer modules or lower layer TP modules; if PDUR_ZERO_COST_OPERATION is enabled, this parameter has to be disabled.
      boolean PduRMulticastToIfSupport: set at pre-compile, default-value=false  # This parameter is not used by the PduR. Configuration parameter to enable or disable PDU Router support for multicasts from an upper layer module to interface modules; if PDUR_ZERO_COST_OPERATION is enabled, this parameter has to be disabled.
      boolean PduRMulticastToTpSupport: set at pre-compile, default-value=false  # This parameter is not used by the PduR. Configuration parameter to enable or disable PDU Router support for multicasts from an upper layer module to TP modules; if PDUR_ZERO_COST_OPERATION is enabled, this parameter has to be disabled.
      boolean PduRSbTxBufferSupport: set at pre-compile  # This parameter is not used by the PduR. Configuration parameter to enable or disable PDU Router support for single buffers as PDU transmit buffers; if PDUR_GATEWAY_OPERATION is disabled, this parameter has to be disabled.
      boolean PduRVersionInfoApi: set at pre-compile  # Activates/Deactivates the Version Info API.
      boolean PduRZeroCostOperation: set at pre-compile, default-value=false  # This parameter is not used by the PduR. All routing paths are implicitly defined and the communication modules directly above or below the PDU Router shall directly call each other without using PDU Router functions (zero cost operation). The configuration parameters PDUR_SINGLE_IF and PDUR_SINGLE_TP are used to specify the related lower layer module.
      integer PduRPBStartAddress [0..1]: set at link, origin=Vector Informatik  # This is the start address of the memory block in ROM where the post build configuration data is located. Required for variant post-build only.
      boolean PduRProdErrorDetect [0..1]: set at pre-compile, origin=Vector Informatik, default-value=true  # Enable to report production relevant errors to the Diagnostics Event Manager (DEM). If disabled no errors will be reported to DEM.
      boolean PduRRouting2CSFSupport [0..1]: set at pre-compile, origin=Vector Informatik, default-value=false  # Enable / Disable support for the BSW module CanTp 4.0 API. Accepts a new routing request for a single frame while the previous is being routed.
      string PduRUserConfigurationFile [0..1]: set at pre-compile, origin=Vector Informatik  # Choose a user configuration file whose content will be appended to the generated PduR_Cfg.h at the end overwritting configuration settings in PduR_Cfg.h.
      integer PduRMaxNumberOfRxCanTpPdus [0..1]: 1..65535, set at pre-compile in variant pre-compile / link in variant link-time+post-build, origin=Vector Informatik  # Define the maximum number of CanTp Routings possible.
      integer PduRMaxNumberOfRxFrTpPdus [0..1]: 1..65535, set at pre-compile in variant pre-compile / link in variant link-time+post-build, origin=Vector Informatik  # Define the maximum number of FrTp Routings possible.
      boolean PduRJ1939Support [0..1]: set at pre-compile, origin=Vector Informatik, default-value=false  # Enable / Disable PduR support for the module J1939Tp. This parameter must be preconfigured. This feature is an extension to the PduR module.
      boolean PduRApplIfSupport [0..1]: set at pre-compile, origin=Vector Informatik, default-value=false  # Enable / Disable PduR support for direct application access to If layer PDUs in the PduR. This parameter must be preconfigured. This feature is an extension to the PduR module.
      boolean PduRApplTpSupport [0..1]: set at pre-compile, origin=Vector Informatik, default-value=false  # Enable / Disable PduR support for direct application access to Tp layer PDUs in the PduR. This parameter must be preconfigured. This feature is an extension to the PduR module.
      boolean PduRSoAdSupport [0..1]: set at pre-compile, origin=Vector Informatik, default-value=false  # Enable / Disable PduR support for module SoAd interface access to Tp layer PDUs. This feature is an extension to the PduR module.
      boolean PduRCanNmSupport: set at pre-compile, origin=Vector Informatik  # Enable / Disable PduR support for module CanNm interface access to If layer PDUs. This feature is an extension to the PduR module.
      boolean PduRNmOsekSupport: set at pre-compile, origin=Vector Informatik  # Enable / Disable PduR support for module NmOsek interface access to If layer PDUs. This feature is an extension to the PduR module.
      boolean PduRFrNmSupport: set at pre-compile, origin=Vector Informatik  # Enable / Disable PduR support for module FrNm interface access to If layer PDUs. This feature is an extension to the PduR module.
      integer PduRMaxRoutingPathGroups [0..1]: 0..65535, set at pre-compile in variant pre-compile / link in variant link-time+post-build, origin=Vector Informatik  # Defines the maximum number of PduRRoutingPathGroups in one Identity.
      integer PduRMaxRoutingPathsInRPGs [0..1]: 0..65535, set at pre-compile in variant pre-compile / link in variant link-time+post-build, origin=Vector Informatik  # Defines the maximum number of PduRRoutingPaths in PduRRoutingPathGroups in one Identity.
      boolean PduRRoutingPathGroupSupport [0..1]: set at pre-compile, origin=Vector Informatik, default-value=false  # Enable / Disable PduR support for PduRRoutingPathGroups.
      boolean PduRFrTp2ProvideRxBufferCalls [0..1]: set at pre-compile, origin=Vector Informatik, default-value=false  # Enable / Disable PduR support for CanTp to support two ProvideRxBuffer calls
      boolean PduRCanTp2ProvideRxBufferCalls [0..1]: set at pre-compile, origin=Vector Informatik, default-value=false  # Enable / Disable PduR support for CanTp to support two ProvideRxBuffer calls.
      boolean PduRBalanceRoutingTime [0..1]: set at pre-compile, origin=Vector Informatik, default-value=false  # Multiple Chunks of the TP buffer are blocked by the Tx TP until the data is transmitted. The Rx TP has to wait until the buffer is free. The TP timings have to take this effect into account and the timings have to be very tolerant and the routing latency is reduced. Due to this, the TP transmission shall be managed by the PDUR with chunks to provide fast buffer for the reception TP.
      boolean PduRDynamicDlcSupport [0..1]: set at pre-compile, origin=Vector Informatik, default-value=false  # If this feature is activated, the received data length (PduInfoPtr->SduLength) is checked in the function PduR_<Lo>RxIndication and only completely received bytes are processed.
      boolean PduRAmdRuntimeMeasurement [0..1]: set at pre-compile, origin=Vector Informatik, default-value=false  # This parameter defines if AMD Runtime Measurement (RTM) is enabled for this module
    container PduRGlobalConfig: multiple-configuration-container=true  # This container contains the global configuration parameter of the PduR. It is a MultipleConfigurationContainer, i.e. this container and its sub-containers exit once per configuration set.
      integer PduRConfigurationId [0..1]: set at post-build  # unique configuration identifier of post-build time configuration; this parameter shall be used if PDUR_ZERO_COST_OPERATION is disabled; otherwise it shall not be used.
      container PduRRoutingPathGroup [0..*]: post-build-changeable=true  # This container groups routing path destinations. Destinations are used instead of routing paths since a routing path can be 1:n. It is desirable to be able to enable/disable a specific bus (i.e. a destination) rather than a routing path. Of course it is possible to create groups that covers specific routing paths as well. Enabling and disabling of routing path groups are made using the PduR API.
        boolean PduRIsEnabledAtInit: set at post-build, default-value=false  # If set to true this routing path group will be enabled after initializing the PDU Router module (i.e. enabled in the PduR_Init function).
        integer PduRRoutingPathGroupId: 0..65535, set at pre-compile, symbolic-name-value=true  # Identification of the routing group. The identification will be used by the disable/enable API in the PDU Router module API.
        reference PduRDestPduRef [1..*]: set at post-build, destination=PduRDestPdu  # This reference selects one destination of the routing path.
      container PduRRoutingTable  # PDU Router routing table is a subcontainer ofPduR. This container shall only be considered by the PDU Router Configuration Generator if PduRGeneral/PDUR_ZERO_COST_OPERATION is disabled.
        container PduRRoutingPath [0..*]: post-build-changeable=true  # This container is a subcontainer of PduRRoutingTable and specifies the routing path of a PDU.
          integer SduLength [0..1]: 0..255, set at post-build  # This parameter is not used by the PduR. Length of PDU data (SDU). Only required if a Tx buffer is configured.
          integer TpChunkSize [0..1]: 1..65535, set at post-build, default-value=7  # Chunk size for routing on the fly. Defines the number of bytes which shall be received before transmission on the destination bus may start. Only required for TP gateway PDUs. The TpChunkSize shall not be larger than the length of the related TP Buffer.
          container PduRDefaultValue [0..1]: post-build-changeable=true  # This container is a subcontainer of PduRRoutingPath and specifies the default value of the I-PDU. Only required for gateway operation and if at least one PDU specified by PduRDestPdu uses TriggerTransmit Data provision. Represented as an array of IntegerParamDef.
            container PduRDefaultValueElement [0..*]  # Each value element is represented by the element and the position in an array.
              integer DefaultValueElement [1..*]: 0..255, set at post-build  # The default value consists of a number of elements. Each element is one byte long and the number of elements is specified by SduLength. The position of this parameter in the container is specified by the ElementBytePosition parameter.
              integer ElementBytePosition: set at post-build  # This parameter specifies the byte position of the element within the default value
          container PduRDestPdu [1..*]: post-build-changeable=true  # This container is a subcontainer of PduRRoutingPath and specifies one destination for the PDU to be routed.
            enumeration DataProvision [0..1]: {DIRECT, TRIGGER_TRANSMIT}, set at post-build  # Specifies how data are provided: direct (as part of the Transmit call) or via the TriggerTransmit callback function. Only required for non-TP gateway PDUs.
            function name RoutingCallout [0..1]: set at link, origin=Vector Informatik  # Configure a callout function implemented by the application and triggered on the routing event. The return value from the function determines if the routing was executed (E_OK) or canceled (E_NOT_OK). The prototype of the function is provided in PduR_Notifications.h.
            boolean DisableRouting [0..1]: set at post-build, origin=Vector Informatik, default-value=false  # This parameter allows to suspend a routing without deleting it. If the parameter is not present or set to false, the routing will be generated and active. This parameter is evaluated for TP- and interface layer routing relations.
            boolean PduRCddDobtSwitch [0..1]: set at post-build, origin=Vector Informatik, default-value=false  # True, if the Tx CanTp Port can be used by CddDobt.
            reference DestPduRef: set at post-build, destination=Pdu  # Destination PDU reference; reference to unique PDU identifier which shall be used by the PDU Router instead of the source PDU ID when calling the related function of the destination module.
            reference TxBufferRef [0..1]: set at post-build, destination=PduRTxBuffer  # Specifies the assigned transmit buffer. Only required for specific non-TP gateway PDUs.
          container PduRSrcPdu: post-build-changeable=true  # This container is a subcontainer of PduRRoutingPath and specifies the source of the PDU to be routed.
            integer HandleId: 0..65535, set at post-build, symbolic-name-value=true  # PDU identifier assigned by PDU Router.
            boolean PduRCddDobtSwitch [0..1]: set at post-build, origin=Vector Informatik, default-value=false  # True, if the Rx CanTp Port can be used by CddDobt.
            reference SrcPduRef: set at post-build, destination=Pdu  # Source PDU reference; reference to unique PDU identifier which shall be used for the requested PDU Router operation.
      container PduRTpBufferTable [0..1]: post-build-changeable=true  # This container is a subcontainer of PduR and contains the definition of all TP buffers (only required for PDU Router gateway operation). This container shall only be considered by the PDU Router Configuration Generator if PduRGeneral/PDUR_GATEWAY_OPERATION is enabled.
        integer PduRMaxTpBufferNumber: 0..65535, set at link  # maximum number of TP buffers.
        container PduRTpBuffer [0..*]: post-build-changeable=true  # This container is a subcontainer of PduRTpBufferTable and specifies a TP buffer.
          integer Length: 1..65535, set at link in variant pre-compile+link-time / post-build in variant post-build  # Length of the buffer.
      container PduRTxBufferTable [0..1]: post-build-changeable=true  # This container is a subcontainer of PduR and contains the definition of all transmit buffers (used by specific non-TP PDUs; only required for PDU Router gateway operation). This container shall only be considered by the PDU Router Configuration Generator if PduRGeneral/PDUR_GATEWAY_OPERATION is enabled.
        integer PduRMaxTxBufferNumber: 0..65535, set at link  # maximum number of transmit buffers
        container PduRTxBuffer [0..*]: post-build-changeable=true  # This container is a subcontainer of PduRTxBufferTable and specifies a transmit buffer for a non-TP PDU.
          integer Depth: 0..255, set at link in variant pre-compile+link-time / post-build in variant post-build  # Specifies the depth of the buffer
          integer Length: 1..255, set at link in variant pre-compile+link-time / post-build in variant post-build  # This parameter is not used by the PduR. Length of the buffer.
      container PduRApplicationAccess [0..1]: post-build-changeable=true  # Provides Rx and Tx PDUs that can be accessed by the application directly from the PDU Router. For any Rx and Tx PDU the reference to the global PDU and the PDU ID has to be specified. This feature is an optional Vector Informatik extension to the AUTOSAR standard. Please note that this feature can only be used if it has been licensed in the configuration tool.
        container PduRApplicationPdu [0..*]: post-build-changeable=true
          choice container PduRApplicationPduType
            container PduRRxIfApplicationPdu [0..1]: post-build-changeable=true
              integer PduRHandleId: 0..65535, set at link in variant pre-compile+link-time / post-build in variant post-build, origin=Vector Informatik, default-value=0  # Handle ID that is used by the application to access this PDU. The handle space must be contineous and zero based.
              reference PduRPduRef: set at link in variant pre-compile+link-time / post-build in variant post-build, origin=Vector Informatik, destination=Pdu  # Reference to the global PDU. Establishes a link to the PduRRoutingPaths source interface layer I-PDU.
            container PduRTxIfApplicationPdu [0..1]: post-build-changeable=true  # The handle ID of this routing path is configured by the related PduRRoutingPath that can be found by means of the
              integer PduRHandleId: 0..65535, set at pre-compile, origin=Vector Informatik, default-value=0  # Handle ID that is used by the application to access this PDU. The handle space must be contineous and zero based.
              reference PduRPduRef: set at pre-compile, origin=Vector Informatik, destination=Pdu  # Reference to the global PDU. Establishes a link to the PduRRoutingPaths destination interface layer PDU.
            container PduRRxTpApplicationPdu [0..1]: post-build-changeable=true
              integer PduRHandleId: 0..65535, set at link in variant pre-compile+link-time / post-build in variant post-build, origin=Vector Informatik, default-value=0  # Handle ID that is used by the application to access this PDU. The handle space must be contineous and zero based.
              reference PduRPduRef: set at link in variant pre-compile+link-time / post-build in variant post-build, origin=Vector Informatik, destination=Pdu  # Reference to the global PDU. Establishes a link to the PduRRoutingPaths source TP layer PDU. Please note that TP PDUs which have been referenced here must not be involved in any other routing path.
            container PduRTxTpApplicationPdu [0..1]: post-build-changeable=true
              integer PduRHandleId: 0..65535, set at link in variant pre-compile+link-time / post-build in variant post-build, origin=Vector Informatik, default-value=0  # Handle ID that is used by the application to access this PDU. The handle space must be contineous and zero based.
              reference PduRPduRef: set at link in variant pre-compile+link-time / post-build in variant post-build, origin=Vector Informatik, destination=Pdu  # Reference to the global PDU. Establishes a link to the PduRRoutingPaths destination TP layer PDU. Please note that TP PDUs which have been referenced here must not be involved in any other routing path.
    container VectorCommonData
      string BswmdVersion: configuration-class-affection=affection-kind=NO-AFFECT, set at published-information, origin=Vector Informatik, default-value=3.20.02  # Version of the BSWMD file that has been used to set up the ECU configuration
  module config PduR_Rec: definition=PduR
  module config PduR_Pre: definition=PduR
