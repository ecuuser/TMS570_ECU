AUTOSAR XML (schema 3.0.1)
# COPYRIGHT
# Copyright (c) 2015 by Vector Informatik GmbH. All rights reserved.
# This software is copyright protected and proprietary to Vector Informatik GmbH.
# Vector Informatik GmbH grants to you only those rights as set out in the license conditions.
package /MICROSAR
  bsw implementation Dem_Impl: code-generator=GENy, programming-language=C, sw-major-version=1, sw-minor-version=6, sw-patch-version=3, vendor-id=30, ar-major-version=2, ar-minor-version=2, ar-patch-version=1, preconfigured-configuration=Dem_Pre, recommended-configuration=Dem_Rec, vendor-specific-module-def=Dem
  module definition Dem [0..1]: refined-module-def=Dem, variants pre-compile/link-time/post-build  # Configuration of the Dem (Diagnostic Event Manager) module.
    container DemConfigSet: multiple-configuration-container=true  # This container contains the configuration parameters and sub containers of the Dem module supporting multiple configuration sets. This container is a MultipleConfigurationContainer, i.e. this container and its sub-containers exist once per configuration set.
      reference DemActiveDsdServiceTableRef [0..1]: configuration-class-affection=affection-kind=NO-AFFECT, set at pre-compile in variant pre-compile / link in variant link-time+post-build, origin=Vector Informatik, destination=DcmDsdServiceTable  # Link to Dcm configuration, Dcm configuration is master when present.
      container DemDTCClass [0..16777214]  # This container contains the configuration (parameters) for DTCClass.
        integer DemDTC: 0..16777215, set at pre-compile in variant pre-compile / link in variant link-time+post-build  # Diagnostic trouble code
        integer DemDTCFunctionalUnit: 0..255, set at pre-compile in variant pre-compile / link in variant link-time+post-build  # DTCFuncitonalUnit is a 1-byte value which identifies the corresponding basic vehicle / system function which reports the DTC. This parameter is necessary for the report of severity information.
        enumeration DemDTCKind: {DEM_DTC_KIND_ALL_DTCS, DEM_DTC_KIND_EMISSION_REL_DTCS}, set at pre-compile in variant pre-compile / link in variant link-time+post-build  # Kind of DTC (OBD relevant or not) ImplementationType: Dem_DTCKindType
        enumeration DemDTCSeverity [0..1]: {DEM_DTC_SEV_CHECK_AT_NEXT_HALT, DEM_DTC_SEV_IMMEDIATELY, DEM_DTC_SEV_MAINTENANCE_ONLY, DEM_DTC_SEV_NO_SEVERITY}, set at pre-compile in variant pre-compile / link in variant link-time+post-build  # Severity of this event's DTC This parameter depends on the OEM and is optional.
        boolean DemDTCSupportWarningIndicator: set at pre-compile in variant pre-compile / link in variant link-time+post-build, origin=Vector Informatik, default-value=false  # Select whether the status bit 'RequestWarningIndicator' is reported to a tester for this DTC. If disabled, the reported DTC status byte will never have bit 8 set. If enabled, the reported DTC status byte can have bit 8 set. This option does not influence the AUTOSAR indicator handling, only the reported DTC status byte.
        reference DemTriggerOnDTCStatusTargetRef [0..*]: set at pre-compile in variant pre-compile / link in variant link-time+post-build, destination=DemTriggerOnDTCStatusTgt  # Reference to Xxx_DemTriggerOnEventStatus function. The possible selection depends on Xxx_DemTriggerOnEventStatusList.
        container DemInit [0..1]  # This container contains the configuration (parameters) for "Xxx_DemInit{Function} calls at Dem_ClearSingleDTC2Generic
          reference DemInitListTargetRef [1..*]: set at pre-compile, destination=DemInitFunction  # NOT USED by Vector Reference to "Xxx_DemInit{Function} called at Dem_ClearSingleDTC2Generic.
      container DemEventParameter [0..65535]  # This container contains the configuaration (parameters) for events. Note that this container definition does not explicitly define a symbolic name parameter. Instead, the short name of the container will be used in the Ecu Configuration Description to specify the symbolic name of the DEM_EVENT_NAME.
        integer DemEventID: 1..65535, set at pre-compile in variant pre-compile / link in variant link-time+post-build, symbolic-name-value=true  # Unique identifier of an event. The DemEventID should be generated by Dem itself to prevent gaps and multiple use of a DemEventID. Max value = 255 for small ECUs with no more than 255 different events and a limited RAM. The events should be sequentially ordered beginning with 1 and no gaps in between. Max value = 65535 for ECUs with > 255 different events. The events should be sequentially ordered beginning with 1 and no gaps in between.
        enumeration DemEventKind: {DEM_EVENT_KIND_BSW, DEM_EVENT_KIND_SWC}, set at pre-compile in variant pre-compile / link in variant link-time+post-build  # This parameter is used to distinguish between SW-C and BSW events. Enumeration values: DEM_EVENT_KIND_BSW: Event is for Dem_ReportErrorStatus API DEM_EVENT_KIND_SWC: Event is for Dem_SetEventStatus API NOTE: with Vector's Dem, this parameter will only distinguish the used include file for the event: BSW EventIDs become defined in Dem_IntErrId.h, SWC EventIDs become defined in Dem_IntEvtId.h. Due to the fact that you shall never inculde one of these files, but shall always include file Dem.h instead (which will include both files) you will not have any visible effect of the chosen value - this will change in later AUTOSAR versions.
        function name DemInitMonitorName [0..1]: set at pre-compile in variant pre-compile / link in variant link-time+post-build  # Monitor function which has to be initialized for the event (ref. to Xxx_DemInitMonitor(EventId)) The value entered here is used as port prototype name for the CallbackInitMonitor port interface. The AUTOSAR recommendation is to use a name of the form CBInitEvt_<EventName>. Port prototype names can not exceed 32 letters due to restrictions of the XML exchange format.
        boolean DemImportedEvent: configuration-class-affection=affection-kind=NO-AFFECT, set at pre-compile in variant pre-compile / link in variant link-time+post-build, origin=Vector Informatik  # Marker if the event was imported from an event database. This parameter is only relevant during configuration time and has no effect during runtime.
        reference DemDTCClassRef [0..1]: set at pre-compile in variant pre-compile / link in variant link-time+post-build, destination=DemDTCClass  # Reference to a DemDTCClass container
        reference DemExtendedDataRef [0..1]: set at pre-compile in variant pre-compile / link in variant link-time+post-build, destination=DemExtendedDataClass  # Reference to a DemExtendedDataClass container
        reference DemFreezeFrameClassRef [0..255]: set at pre-compile in variant pre-compile / link in variant link-time+post-build, destination=DemFreezeFrameClass  # Reference to a DemFreezeFrameClass container
        reference DemTriggerOnEventStatusTargetRef [0..*]: set at pre-compile in variant pre-compile / link in variant link-time+post-build, destination=DemTriggerOnEventStatusTgt  # Reference to Xxx_DemTriggerOnEventStatus function. The possible selection depends on Xxx_DemTriggerOnEventStatusList.
        container DemEventClass  # This container contains the configuration (parameters) for EventClass
          enumeration DemEventDestination [0..3]: {DEM_DTC_ORIGIN_MIRROR_MEMORY, DEM_DTC_ORIGIN_PERMANENT_MEMORY, DEM_DTC_ORIGIN_PRIMARY_MEMORY}, set at pre-compile in variant pre-compile / link in variant link-time+post-build  # The event destination assigns events to none, one or multiple origins. If no event destination is assigned to a specific event, the event is handled internally and is not visible externally to the Dcm. If more than one event destination is assigned to a specific event, the event can be present in the corresponding origins. Enumeration values: DEM_DTC_ORIGIN_MIRROR_MEMORY DEM_DTC_ORIGIN_PERMANENT_MEMORY DEM_DTC_ORIGIN_PRIMARY_MEMORY
          integer DemEventPriority: 0..255, set at pre-compile in variant pre-compile / link in variant link-time+post-build  # Priority of an event, with regard to full event buffer (ref. to Dem104).
          boolean DemFFPrestorageSupported: set at pre-compile, default-value=false  # If this parameter is set to true, then the prestorage of freeze frames is supported by the assigned event. This parameter is useful to calculate the buffer size. This parameter is OEM specific and might not be available in your version of Dem.
          boolean DemHealingAllowed: set at pre-compile in variant pre-compile / link in variant link-time+post-build  # General switch to allow self-healing/unlearning/aging of event or not (refer to Dem104). true = self-healing/unlearning/aging allowed false = self-healing/unlearning/aging not allowed
          integer DemHealingCycleCounter [0..1]: 1..256, set at pre-compile in variant pre-compile / link in variant link-time+post-build, default-value=40  # Number of cycles needed to self-heal/age/erase event (refer to Dem104). This parameter is OEM specific and might not be available in your version of Dem.
          integer DemIndicatorHealingCycleCount [0..1]: 0..1, set at pre-compile in variant pre-compile / link in variant link-time+post-build, origin=Vector Informatik, default-value=0  # Defines the number of healing cycles for the WarningIndicatorOffCriteria.
          integer DemMaturationTime [0..1]: 0..4294967295, set at pre-compile in variant pre-compile / link in variant link-time+post-build, origin=Vector Informatik, default-value=0  # Indicates the 'time value' (in milliseconds) required to mature an active DTC condition. Use '0' if the maturation occurs immediately (immediate fault setting is not recommended). NOTE: This parameter is only used to calculate the maturation time that will be actually reached using the configured pre-debounce settings. It will have no direct effect to the Dem configuration.
          integer DemMaturationMonitorRate [0..1]: 0..4294967295, set at pre-compile in variant pre-compile / link in variant link-time+post-build, origin=Vector Informatik, default-value=0  # Describes at what intervals a monitor will report its status via Dem_SetEventStatus(). NOTE: This parameter is only used to calculate the maturation time that will be actually reached using the configured pre-debounce settings. It will have no direct effect to the Dem configuration.
          integer DemDematurationTime [0..1]: 0..4294967295, set at pre-compile in variant pre-compile / link in variant link-time+post-build, origin=Vector Informatik, default-value=0  # Indicates the 'time value' (in milliseconds) required to demature an active DTC condition. Use '0' if the dematuration occurs immediately (immediate fault setting is not recommended). NOTE: This parameter is only used to calculate the dematuration time that will be actually reached using the configured pre-debounce settings. It will have no direct effect to the Dem configuration.
          integer DemDematurationMonitorRate [0..1]: 0..4294967295, set at pre-compile in variant pre-compile / link in variant link-time+post-build, origin=Vector Informatik, default-value=0  # Describes at what intervals a monitor will report its status via Dem_SetEventStatus(). NOTE: This parameter is only used to calculate the dematuration time that will be actually reached using the configured pre-debounce settings. It will have no direct effect to the Dem configuration.
          reference DemEnableConditionRef [0..0]: set at pre-compile in variant pre-compile / link in variant link-time+post-build, destination=DemEnableCondition  # Enable condition(s) relevant for this event. The event status will be changed by the SetEventStatus() API only if all enable conditions of this event are 'true' Other conditions (i.e. Operation Cycle) must be met additionaly, the enable conditions alone do not suffice to enable storage of an event. This parameter is OEM specific and might not be available in your version of Dem.
          reference DemHealingCycleRef [0..1]: set at pre-compile in variant pre-compile / link in variant link-time+post-build, destination=DemOperationCycleTgt  # Kind of operation cycle for the event self healing (e.g. power cycle, driving cycle, ...)
          reference DemOperationCycleRef: set at pre-compile in variant pre-compile / link in variant link-time+post-build, destination=DemOperationCycleTgt  # Kind of operation cycle for the event storage (e.g. power cycle, driving cycle, ...)
          reference DemSupportedViewName [0..1]: set at pre-compile, destination=DemView  # NOT USED by Vector View name of supported view A view describes a functional group like a wiper system or a window lifter for the access of corresponding DTCs and related data. SUPPORTED_VIEW_NAME selects a view in which the event is visible. Example: WIPERSYSTEM refers to functionality wiper system, WINDOWLIFTER refers to functionality window lifter, ... This parameter is optional.
          reference DemIndicatorHealingCycleRef [0..1]: set at pre-compile in variant pre-compile / link in variant link-time+post-build, origin=Vector Informatik, destination=DemOperationCycleTgt  # Kind of healing cycle for the indicator controlled by the according event used for the WarningIndicatorOffCriteria.
          container DemIndicatorAttribute [0..255]  # This container contains the event specific configuration of indicators.
            integer DemIndicatorBehaviour: 0..7, set at pre-compile in variant pre-compile / link in variant link-time+post-build  # Behaviour of the linked indicator Bit 0: Indicator is active if event has status FAILED Bit 1: Indicator is blinking if event has status FAILED
            reference DemLinkedIndicator: set at pre-compile in variant pre-compile / link in variant link-time+post-build, destination=DemIndicator  # Indicator name of the used indicator
          container DemOEMSpecific [0..1]  # This container contains the configuration for OEM specific additional parameter.
          choice container DemPredebounceAlgorithmClass  # Used predebounce algorithm class Available choices: DemPreDebounceCounterBased DemPreDebounceFrequencyBased (NOT USED by Vector) DemPreDebounceMonitorInternal (NOT USED by Vector) DemPreDebounceTimeBase (support depends on OEM - might not be available in your version of Dem)
            container DemPreDebounceCounterBased [0..1]  # This container contains the configuration parameters for the predebounce algorithm DEM_PRE_DEBOUNCE_COUNTER_BASED.
              integer DemCountInStepSize: 0..127, set at pre-compile in variant pre-compile / link in variant link-time+post-build  # Defines the Step size for incrementation of FDC (PREFAILED). Range: 0 - 127
              integer DemCountOutStepSize: 0..127, set at pre-compile in variant pre-compile / link in variant link-time+post-build  # Defines the Step size for decrementation of FDC (PREPASSED). Range: 0 - 127
              boolean DemJumpDown: set at pre-compile in variant pre-compile / link in variant link-time+post-build, default-value=true  # Switch for the activation of JumpDown true: JumpDown activated false: JumpDown not activated RESTRICTIONS: This switch will only be used if "DemJumpUp" is enabled.
              boolean DemJumpUp: set at pre-compile in variant pre-compile / link in variant link-time+post-build, default-value=true  # Switch for the activation of JumpUp true: JumpUp activated false: JumpUp not activated
              enumeration DemPreDebounceName: {DEM_PRE_DEBOUNCE_COUNTER_BASED}, set at pre-compile in variant pre-compile / link in variant link-time+post-build  # Defines the selected debounce algorithm
            container DemPreDebounceFrequencyBased [0..1]  # NOT USED by Vector This container contains the configuration parameters for the predebounce algorithm DEM_PRE_DEBOUNCE_FREQUENCY_BASED.
              integer DemDurationOfTimeWindow: 0.., set at pre-compile  # NOT USED by Vector Defines duration of the time window. Range defined in the Dem SWS as 0 .. 2^32, this parameter contains a value in milliseconds. The AUTOSAR configuration standard is to use SI units, so this parameter is defined as float value in seconds. DEM configuration tools must convert this float value to the appropriate value format for the use in the software implementation of DEM.
              enumeration DemPreDebounceName: {DEM_PRE_DEBOUNCE_FREQUENCY_BASED}, set at pre-compile  # NOT USED by Vector Defines the selected debounce algorithm
              integer DemThresholdForEventTestedFailed: 0..65535, set at pre-compile  # NOT USED by Vector Defines the threshold for FAILED-detection
              integer DemThresholdForEventTestedPassed: 0..65535, set at pre-compile  # NOT USED by Vector Defines the threshold for PASSED-detection
            container DemPreDebounceMonitorInternal [0..1]  # NOT USED by Vector This container contains the configuration parameters for the predebounce algorithm DEM_NO_PRE_DEBOUNCE.
              function name DemGetFaultDetectionCntFnc: set at pre-compile  # NOT USED by Vector Defines a real name of an API assigned to the monitoring path. This name shall be used by a code generator as function name.
              enumeration DemPreDebounceName: {DEM_NO_PRE_DEBOUNCE}, set at pre-compile  # NOT USED by Vector Defines the selected debounce algorithm.
            container DemPreDebounceTimeBase [0..1]  # This container contains the configuration parameters for the predebounce algorithm DEM_PRE_DEBOUNCE_TIME_BASED.
              enumeration DemPreDebounceName: {DEM_PRE_DEBOUNCE_TIME_BASED}, set at pre-compile in variant pre-compile / link in variant link-time+post-build  # Defines the selected debounce algorithm
              integer DemTimeFailedThreshold: 0.., set at pre-compile in variant pre-compile / link in variant link-time+post-build  # Defines the time for time based debouncing of an event to reach the FAILED status. To trigger the debouncing, call Dem_SetEventStatus() with parameter DEM_EVENT_STATUS_PREFAILED. The event specific time is started, and will (Dem internally) set the event to FAILED after the configured time. To cancel the debouncing, call Dem_SetEventStatus() for that event with a parameter different from DEM_EVENT_STATUS_PREFAILED. If this timer triggers, a simultaneously running timer for PASSED-debouncing is automatically stopped.
              integer DemTimePassedThreshold: 0.., set at pre-compile in variant pre-compile / link in variant link-time+post-build  # Defines the time for time based debouncing of an event to reach the FAILED status. To trigger the debouncing, call Dem_SetEventStatus() with parameter DEM_EVENT_STATUS_PREPASSED. The event specific time is started, and will (Dem internally) set the event to PASSED after the configured time. To cancel the debouncing, call Dem_SetEventStatus() for that event with a parameter different from DEM_EVENT_STATUS_PREPASSED. If this timer triggers, a simultaneously running timer for FAILED-debouncing is automatically stopped.
        container DemTriggerOnEventStatus [0..1]  # This container contains the configuration for TriggerOnEvent functions.
        container DemCallbackClearEventAllowed [0..1]  # The presence of this container indicates that the DEM has access to a "ClearEventAllowed" callback. In case there is a DemCallbackClearEventAllowedFnc, this parameter defines the name of the function that the DEM will call. In case there is no DemCallbackClearEventAllowedFnc, the DEM will have an R-Port requiring the interface CallbackClearEventAllowed whose name is generated by using the unique callback-prefix followed by the event name.
          function name DemCallbackClearEventAllowedFnc [0..1]: set at pre-compile in variant pre-compile / link in variant link-time+post-build, origin=Vector Informatik  # Function name of prototype "ClearEventAllowed". In case there is a DemCallbackClearEventAllowedFnc, this parameter defines the name of the function that the DEM will call. In case there is no DemCallbackClearEventAllowedFnc, the DEM will have an R-Port requiring the interface CallbackClearEventAllowed whose name is generated by using the unique callback-prefix followed by the event name.
      container DemGroupOfDTC [0..16777214]  # This container contains the configuration (parameters) for DTC Groups.
        integer DemGroupDTCs: 1..16777214, set at pre-compile in variant pre-compile / link in variant link-time+post-build, symbolic-name-value=true  # DTC number used to describe a group of DTC (according to ISO14229-1[9] Annex D1).
      container DemOemIdClass [0..*]  # This container contains the configuration (parameters) for OEMIdClass. Note hat this container definition does not explicitly define a symbolic name parameter. Instead, the short name of the container will be used in the Ecu Configuration Description to specify the symbolic name of the VALUE_NAME.
        integer DemOemID: 0..255, set at pre-compile, symbolic-name-value=true  # NOT USED by Vector Defines a unique ID of a data value.
    container DemGeneral  # This container contains the configuration (parameters) of the BSW Dem
      integer DemBswErrorBufferSize: 0..255, set at pre-compile in variant pre-compile / link in variant link-time+post-build  # Maximum number of elements in buffer for handling of BSW errors (ref. to Dem107). Up to this number of events occurring before initialization of the Dem module can be stored in an error queue. Those events are processed by the Dem after the initialization process has completed. Before calling Dem_Init() only events reported with status FAILED will enter this queue. During operation, i.e. after calling Dem_Init() all BSW events (with any status) will enter the queue; to get a defined call context the queue is worked off in the next DemMainFunction() call.
      boolean DemDevErrorDetect: set at pre-compile  # Enable/disable the Development Error Detection and Notification. If enabled, development errors are reported to the Development Error Tracer (Det). For further details, please see Dem - Technical Reference, chapter "Development Error Reporting". Note: In general, the development error detection is recommended during pre-test phase. It is not recommended to enable the development error detection in production code due to increased runtime and ROM needs.
      integer DemDtcStatusAvailabilityMask: 0..255, set at pre-compile in variant pre-compile / link in variant link-time+post-build  # Mask for the supported DTC status bits by the Dem. This mask is used by UDS service 0x19.
      integer DemFFDataIDLength: 0..4, set at published-information  # Length of the DID and PID of freeze frames in bytes.
      integer DemMaxNumberEventEntryMir: 0..0, set at pre-compile, default-value=0  # NOT USED Maximum number of events which can be stored in the mirror memory (typically up to 30) (ref. to example ch. 7)
      integer DemMaxNumberEventEntryPrm: 1..255, set at pre-compile in variant pre-compile / link in variant link-time+post-build, default-value=20  # Maximum number of events which can be stored in the primary memory (typically up to 20) (ref. to example ch. 7)
      integer DemMaxNumberEventEntrySec: 0..0, set at pre-compile, default-value=0  # NOT USED Maximum number of events which can be stored in the secondary memory.
      integer DemMaxNumberPrestoredFF: 0..255, set at pre-compile in variant pre-compile / link in variant link-time+post-build  # Defines the maximum number for prestored freeze frames. If set to 0, prestorage is not supported by the ECU. RESTRICTIONS: This value must match the number of events that have 'DemFFPrestorageSupported' flag set to true.
      integer DemNvmAccessRetry: 0..255, set at published-information  # Maximum number of retries to access NVRAM Manager (NvM).
      integer DemNvmAccessRetryTimeDelay: 0..65535, set at published-information  # Time in milliseconds between two retries to NVRAM Manager (NvM) in case that first access failed.
      integer DemTaskTime: 0.., set at pre-compile in variant pre-compile / link in variant link-time+post-build  # Allow to configure the time for the periodic cyclic task Dem_MainFunction(). Please note: This configuration value shall be equal to the value in the ScheduleManager module. All Dem internal time calculations are based on this value so it is very important that the correct value is configured here.
      integer DemTypeOfDTCSupported: 0..31, set at pre-compile in variant pre-compile / link in variant link-time+post-build  # DEM_TYPE_OF_DTC_SUPPORTED is defined in the Dem SWS as uint8. However, it is used in a way similar to an enum. Bit 0: 2 byte ISO15031-6 / SAE J2012-DA DTC (*) Bit 1: 3 byte ISO14229-1 DTC Bit 2: Customer specific DTC (n/a for Vector Dem) Bit 3: SAE J1939-73 (n/a for Vector Dem) Bit 4: SAE J2012-DA_WWHOBD Set the according Bit to '1' means DTC format is supported. Combination of different DTC formats is possible (e.g. ISO 15031-6 and ISO14229-1 is coded by 0x0011b). Note: As such a combination can not be reported via UDS diagnostics, such a combination is not supported by Vector. (*) "2 Byte" is misleading AUTOSAR wording. You must specify such DTCs always as 3 Byte-Number! With ECUs, that shall support 2 Byte DTC-Number WITHOUT appended 1 Byte FailureTypeByte (FTB), you must put the DTC-Number to High-/Middle-Byte and fill the Low-Byte (FTB) with 0 (zero). Example: - DTC-Number "P1234" = 0x1234 and NO FTB is resulting in AUTOSAR's DTC-Number definition: 0x123400 - DTC-Number "P1234" = 0x1234 and FTB "bus off"=0x88 resulting in AUTOSAR's DTC-Number definition: 0x123488
      boolean DemVersionInfoApi: set at pre-compile  # Preprocessor switch to enable or disable the version info API Dem_GetVersionInfo() If the version information is not needed, disable this option to save resources (ROM).
      integer DemAddErrorBufferSize: 0..255, set at pre-compile in variant pre-compile / link in variant link-time+post-build, origin=Vector Informatik  # Maximum number of operation cycle START triggers that can be received and queued before Dem_Init() was called (ref. to Dem107). In addition to the number of BSW events stored in the BswErrorBuffer, up to this number of operation cycle start events can be stored additionally in the start up queue. The value should match the number of different operation cycles of those BSW events that can occur during system initialization.
      integer DemSnapshotsPerDTC: 1..21, set at published-information in variant pre-compile / pre-compile in variant link-time+post-build, origin=Vector Informatik, default-value=2  # Number of stored Snapshot Records for each DTC This is the sum of the first occurred and most recent snapshot records stored. Example: 1 First occurred snapshot and 2 recent snapshots -> Enter 3 here.
      boolean DemUseRte: set at pre-compile, origin=Vector Informatik, default-value=true  # Decides if the Dem uses port interfaces or callback functions Enable this option if the ECU uses an Rte. If this option is enabled, a port interface description (software component template) is generated which can be used for the Rte configuration. Disable this option if the ECU does not use an Rte. If this option is disabled, a header file named Dem_Cbk.h will generated which contains prototypes for all Dem interfaces towards the application.
      integer DemPostbuildStartAddress: 0..4294967295, set at  in variant pre-compile / published-information in variant link-time+post-build, origin=Vector Informatik  # Define the start address of the post build data. This setting is mandatory when generating a configuration that will be written to the memory of your ECU at post-build time (i.e. when generating a hex-file). This setting is not relevant when generating the initial ECU configuration at link- or pre-compile time (i.e. when generating a C file that will be linked with your project). The module start address must specify the start address of the memory area which the generated hex-file will be mapped to. If the ECU supports selectable post-build configuration, the module start address can be any location that is accessible for the Dem module. If selectable post-build configuration is not supported by your ECU, the module start address must be the same address to which the initial configuration was mapped. Please see to your linker map file to get this address. RESTRICTIONS: This parameter is only relevant if the config variant is set to VARIANT-POST-BUILD.
      boolean DemUseDcmCompatiblePorts: configuration-class-affection=affection-kind=NO-AFFECT, set at pre-compile in variant pre-compile / link in variant link-time+post-build, origin=Vector Informatik, default-value=false  # If this option is enabled, the port interface 'CallbackGetDataValueByDataID' is replaced by a separate port interface CallbackGetDataValue_<DID> per DID. The operation GetDataValueByDataIdentifier is redefined to be compatible to the Dcm counterpart ReadData. This makes it possible to trigger the same runnable with both operations. !!!To work correctly, the runnable must not return E_PENDING and must not depend upon CheckConditionRead being called before the runnable is triggered!!! If the option is disabled, the ports are generated as defined by AUTOSAR. RESTRICTIONS: This parameter will only have an effect if 'DemUseRte' is enabled.
      string DemUserConfigFile: configuration-class-affection=affection-kind=NO-AFFECT, set at pre-compile, origin=Vector Informatik  # This option specifies a path to a custom user config file for the Dem. If you want to overwrite some of the settings in the generated configuration file (Dem_Cfg.h), you can specify a path to a user defined configuration file. The user defined configuration file will be included at the end of the generated preprocessor switches. Definitions in the user defined configuration file can overwrite definitions in the generated configuration file. NOTE: Not all of the features can be overwritten simply by triggering the preprocessor switch. Some of the options are complex and the code generator generates less or more code depending on the setting. USE SUCH A FILE ONLY AFTER DISCUSSION WITH VECTOR.
      enumeration DemVariantModeSelection: {SIMPLE_ECU, MULTI_IDENTITY_MODE, VSG_MODE}, set at pre-compile, origin=Vector Informatik, default-value=SIMPLE_ECU  # Select the multi configuration variant mode. Enumeration values: SIMPLE_ECU: The diagnostics support one configuration only. (AUTOSAR standard) MULTI_IDENTITY_MODE: The diagnostics support different diagnostic variants. One variant is active a time. VSG_MODE: Diagnostic Entities (SubServices, DTCs...) are grouped into VSGs. Several VSGs can be activated at a time. Note: This setting is independent from communication identities!
      enumeration DemTimeBasedDebouncingDataType: {TIME_BASED_DEBOUNCING_8_BIT, TIME_BASED_DEBOUNCING_16_BIT, TIME_BASED_DEBOUNCING_32_BIT}, set at pre-compile, origin=Vector Informatik, default-value=TIME_BASED_DEBOUNCING_16_BIT  # Defines the data type used for internal timer(s) for time based debouncing of DTCs. To save RAM, you should choose the smallest possible type for your current configuration. GENy will warn you before generation if the selected value is too small. Enumeration values: TIME_BASED_DEBOUNCING_8_BIT: use uint8 as data type for timers TIME_BASED_DEBOUNCING_16_BIT: use uint16 as data type for timers TIME_BASED_DEBOUNCING_32_BIT: use uint32 as data type for timers With typical cycle time for Dem [10ms], use following rule of thumb: - uint8 for time 0 sec ... 2.5 sec - uint16 for time 2.5 sec ... 10 min - uint32 for time 10 min ... 490 day With minimal cycle time [1ms] you must divide above times by 10.
      boolean DemPreInitHasConfigParam: set at pre-compile, origin=Vector Informatik, default-value=false  # With "Multiple Configuration" (i.e. more than one CDD configuration) the Dem_PreInit() function has an additional parameter to select the CDD at startup.
      string DemSoftwareComponentName: set at pre-compile, origin=Vector Informatik, default-value=Dem  # This name is used as component name (ShortName) in the generated software component template. Change this name if you try to import the Dem components of several ECUs and have problems with name clashes. RESTRICTIONS: This setting will only be relevant if "DemUseRte" is enabled.
      boolean DemSupportGetEventIdApi: set at pre-compile, origin=Vector Informatik, default-value=false  # Create additional API for mapping a DTC-Number to an Event ID. This API enables implementation of complex device drivers, that receive DTC numbers and must address DEM by the event ID. Note: the mapping depends on the active configuration.
      boolean DemEnableFailStateNotification: set at pre-compile, origin=Vector Informatik, default-value=false  # If enabled, the application will be notified when the generic/current fail status changes, i.e. if the node has at least one DTC stored in its system memory. The respective Complex Device Driver APIs are defined as follows: void Appl_Dem_GenericFailStateChangeNotification (boolean failState) TRUE: If at least one DTC is stored in memory FALSE: If no DTC is stored in memory void Appl_Dem_CurrentFailStateChangeNotification(boolean failState) TRUE: If at least one DTC is set to FAILED. FALSE: If no DTC is set to FAILED.
      boolean DemNvWriteAfterConfirmation [0..1]: set at pre-compile, origin=Vector Informatik, default-value=false  # If enabled, environment data is written to NvM immediately after confirmation of a DTC. Otherwise data is only persisted during shutdown.
      boolean DemNvWriteAfterClear [0..1]: set at pre-compile, origin=Vector Informatik, default-value=false  # If enabled, environment data and event status data is cleared in NvM before the positive response is sent. Otherwise, cleared data is only fully persisted during shutdown.
      boolean DemAmdRuntimeMeasurement [0..1]: set at pre-compile, origin=Vector Informatik, default-value=false  # This parameter defines if AMD Runtime Measurement (RTM) is enabled for this module.
      container DemEnableCondition [0..0]  # This container contains the configuration (parameters) for enable conditions.
        integer DemEnableConditionID [0..1]: 0..65535, set at pre-compile  # This value is used to force an order on the enable conditions. It is not necessarily the same that will be used as port defined argument! Defines a condition ID. This parameter is optional and depends on manufacturer.
        integer DemEnableConditionStatus: 0..1, set at pre-compile in variant pre-compile / link in variant link-time+post-build  # Initial state of the enable condition after power up. Restricted to 0..1 because SetEnableCondition API only uses boolean values. Defines a status for enable or disable of storage of a event. The value is the initialization after power up. If this condition is fulfilled, the enable condition is initialized to true, so events dependent on this enable condition will be stored before the SetEnableCondition API has been called for the very first time. If this condition is not fulfilled, the enable condition is initialized to false, so events dependent on this enable condition will not be stored before the SetEnableCondition API has been called for the very first time. All other storage requirements (i.e. operation cycle) still apply, so setting this to true is no guarantee that an event is stored. After calling the SetEnableCondition API, this value has no effect until after the next ECU initialization.
      container DemExtendedDataClass [0..*]  # This class contains the combinations of extended data records (ExtendedDataClassRec).
        reference DemExtendedDataClassRef [1..253]: set at pre-compile in variant pre-compile / link in variant link-time+post-build, destination=DemExtendedDataRecClass  # This reference contains the link to a ExtendedDataClassRecord.
      container DemExtendedDataRecClass [0..253]  # This container contains the configuration (parameters) for ExtendedDataClassRecords
        integer DemExtendedDataRecordDataSize: 0..256, set at pre-compile in variant pre-compile / link in variant link-time+post-build  # Defines the size of the extended data record (in bytes).
        integer DemExtendedDataRecordNumber: 0..253, set at pre-compile in variant pre-compile / link in variant link-time+post-build  # This configuration parameter specifies an unique identifier for an extended data record. One or more extended data records can be assigned to one DTC. Max. value = 253 because 0xFF and 0xFE are reserved by ISO
        enumeration DemExtendedDataRecordType [0..1]: {FIRST_CONFIRMED, MOST_RECENT, GENERIC}, set at pre-compile in variant pre-compile / link in variant link-time+post-build, origin=Vector Informatik, default-value=GENERIC  # Selector to identitfy special attributes of extended records. Depends on OEM.
        enumeration DemExtendedDataRecordSemantics [0..1]: set at pre-compile, origin=Vector Informatik, default-value=NONE  # Used for extended records that shall contain Dcm controlled data (which is usually inacessible by the application) Dem will internally fill in the data of these, no port will be created.
          NONE  # User Data
          OCCURRENCE_COUNTER
        reference DemGetExtendedDataTargetRef: set at pre-compile in variant pre-compile / link in variant link-time+post-build, destination=DemGetExtDataRecord  # Reference to Xxx_GetExtendedData function. The possible selection depends on XxxDemGetExtDataRecordList.
      container DemFreezeFrameClass [0..65534]  # This container contains the configuration (parameters) for FreezeFrameClass.
        enumeration DemFreezeFrameKind: {DEM_FREEZE_FRAME_NON_OBD, DEM_FREEZE_FRAME_OBD}, set at pre-compile  # NOT USED by Vector
        integer DemFreezeFrameRecordNum: 0..255, set at pre-compile in variant pre-compile / link in variant link-time+post-build  # Record number of this snapshot record. This snapshot can be read via the Dcm using this number in the request $19 $05.
        reference DemFreezeFrameIdClassRef [1..255]: set at pre-compile in variant pre-compile / link in variant link-time+post-build, destination=DemFreezeFrameIdClass  # Reference to a DemFreezeFrameIdClass container
      container DemFreezeFrameIdClass [0..65535]  # This container contains the configuration (parameters) for FreezeFrameClass.
        integer DemDataID [0..1]: 0..65535, set at pre-compile in variant pre-compile / link in variant link-time+post-build  # For enhanced diagnostics. Multiple DataIDs can be relevant per freeze frame.
        integer DemFreezeFrameIdDataSize: 0..65535, set at pre-compile in variant pre-compile / link in variant link-time+post-build  # Size of the DID (in bytes).
        integer DemPID [0..1]: 0..255, set at pre-compile in variant pre-compile / link in variant link-time+post-build  # For OBD relevant data. Multiple PIDs can be relevant per freeze frame. This parameter is optional!
        boolean DemCreatePortInterface: configuration-class-affection=affection-kind=NO-AFFECT, set at pre-compile in variant pre-compile / link in variant link-time+post-build, origin=Vector Informatik, default-value=true  # Disable for special DIDs handled internally by Dcm.
        container DemGetDataValByDataIdTgt  # This container contains the configuration for GetDataValueByDataIdentifierList.
          reference DemGetDataValByDataIdTgtRef: set at pre-compile in variant pre-compile / link in variant link-time+post-build, destination=DemGetDataValByDataId  # Reference to Xxx_GetDataValueByDataIdentifier function.
      container DemGetDataValByDataId [0..*]  # This container contains the configuration (parameters) for GetDataValueByDataIdentifier functions.
        function name DemGetDataValByDataIdListFnc: set at pre-compile in variant pre-compile / link in variant link-time+post-build  # The value entered here is used as port prototype name for the CallbackGetDataValueByDataID port interface. The AUTOSAR recommendation is to use a name of the form CBValByDID_<DataID>. Port prototype names can not exceed 32 letters due to restrictions of the XML exchange format.
      container DemGetExtDataRecord [0..*]  # This container contains the configuration (parameters) for GetExtendedDataRecord functions.
        function name DemGetExtDataRecordFnc: set at pre-compile in variant pre-compile / link in variant link-time+post-build  # The value entered here is used as port prototype name for the CallbackGetExtendedDataRecord port interface. The AUTOSAR recommendation is to use a name of the form CBExtDataRec_<RecordNumber>. Port prototype names can not exceed 32 letters due to restrictions of the XML exchange format.
        boolean DemCreatePortInterface: configuration-class-affection=affection-kind=NO-AFFECT, set at pre-compile in variant pre-compile / link in variant link-time+post-build, origin=Vector Informatik, default-value=true  # Flag to distinguish between application provided extended records and Dem built-in extended records. Some extended record data is produced within the Dem, so there is no need for a require port. Still, a BSW internal callback function can be required, so instead of a just leaving the function reference empty, it can specify a BSW internal callback function if this flag is set to 'false'.
      container DemIndicator [0..255]  # This container contains the configuration (parameters) for Indicators. Note hat this container definition does not explicitly define a symbolic name parameter. Instead, the short name of the container will be used in the Ecu Configuration Description to specify the symbolic name of the INDICATOR_NAME.
        integer DemIndicatorID: 0..255, set at pre-compile in variant pre-compile / link in variant link-time+post-build, symbolic-name-value=true  # Unique identifier of an indicator. Must be in range 0..255
      container DemInitFunction [0..*]  # This container contains the configuration (parameters) for Xxx_DemInit{Function}
        function name DemInitFunctionName: set at pre-compile in variant pre-compile / link in variant link-time+post-build  # "Xxx_DemInit{Function} which has to be called by Dem or other API to reset the {Function} of the Module Xxx
      container DemNvramBlockId [0..*]  # This container contains the configuration (parameters) for Dem_OperationCycleList. Note that this container definition does not explicitly define a symbolic name parameter. Instead, the short name of the container will be used in the Ecu Configuration Description to specify the symbolic name of the VALUE_NAME.
        enumeration DemNvramBlockIdUsageType: {DEM_NVRAM_BLOCK_CORE, DEM_NVRAM_BLOCK_SUPPRESSDTC, DEM_NVRAM_BLOCK_EVENTDATA, DEM_NVRAM_BLOCK_PRIMARY, DEM_NVRAM_BLOCK_MIRROR}, set at pre-compile in variant pre-compile / link in variant link-time+post-build, origin=Vector Informatik, default-value=DEM_NVRAM_BLOCK_CORE  # This parameter describes the usage type of the Nvram Block Id referenced by 'DemNvramBlockIdRef' Enumeration values: DEM_NVRAM_BLOCK_CORE: This Nvram Block Id is used for generic non-volatile data DEM_NVRAM_BLOCK_SUPPRESSDTC: This Nvram Block Id is used for "suppress DTC" specific non-volatile configuration data DEM_NVRAM_BLOCK_EVENTDATA: This Nvram Block Id is used for event status data DEM_NVRAM_BLOCK_PRIMARY: This Nvram Block Id is used for primary memory DEM_NVRAM_BLOCK_MIRROR: This Nvram Block Id is used for mirror memory RESTRICTIONS: There must always exist one block with usage type DEM_NVRAM_BLOCKID_USAGE_CORE and DEM_NVRAM_BLOCK_EVENTDATA. If 'DemSupportSuppressDTC' is enabled, there must exist an additional block with usage type DEM_NVRAM_BLOCKID_USAGE_SUPPRESSDTC. There must exist 'DemMaxNumberEventEntryPrm' blocks of type DEM_NVRAM_BLOCK_PRIMARY. If mirror memory / HIR is supported, there must be a block with type DEM_NVRAM_BLOCK_MIRROR.
        integer DemNvramBlockIdUsageIndex [0..1]: 1..255, set at pre-compile, origin=Vector Informatik, default-value=1  # In case of multiple blocks of one type (DemNvramBlockIdUsageType) this parameter is used to set up an order for the blocks. E.g. if 10 blocks are used for primary memory, the index uniquely identifies which NvMBlockDescriptor is used for which part of the primary memory. This parameter is only used if the usage type supports index access, currently this is only the case for usage type DEM_NVRAM_BLOCK_PRIMARY
        symbolic name reference DemNvramBlockIdRef: set at pre-compile in variant pre-compile / link in variant link-time+post-build, destination=NvmBlockDescriptor  # NvRam ID used by Dem
      container DemOperationCycleTgt [0..*]  # Note that this container definition does not explicitly define a symbolic name parameter. Instead, the short name of the container will be used in the Ecu Configuration Description to specify the symbolic name of the OPERATION_CYCLE_NAME.
        enumeration DemOperationCycle: {DEM_IGNITION, DEM_OBD_DCY, DEM_POWER, DEM_WARMUP}, set at pre-compile  # List of cycles for the Dem to be supported by API Dem_SetOperationCycleState in SW-C. Therein, only the symbolic names shall be used. The declaration is given via Dem.h. Further cycles can be specified as part of the Dem delivery.
      container DemTriggerOnDTCStatusTgt [0..*]  # This container contains the configuration (parameters) for DemTriggerOnDTCStatus functions.
        function name DemTrigOnDTCStatusFnc: set at pre-compile in variant pre-compile / link in variant link-time+post-build  # The value entered here is used as port prototype name for the CallbackDTCStatusChange port interface. The AUTOSAR recommendation is to use a name of the form CBStatusDTC_<EventName>. Port prototype names can not exceed 32 letters due to restrictions of the XML exchange format.
      container DemTriggerOnEventStatusTgt [0..*]  # This container contains the configuration (parameters) for DemTriggerOnEventStatus functions.
        function name DemTrigOnEventStatusFnc: set at pre-compile in variant pre-compile / link in variant link-time+post-build  # The value entered here is used as port prototype name for the CallbackEventStatusChange port interface. The AUTOSAR recommendation is to use a name of the form CBStatusEvt_<EventName>. Port prototype names can not exceed 32 letters due to restrictions of the XML exchange format.
      container DemView [0..0]  # NOT USED by Vector This container contains the configuration (parameters) for views. Note hat this container definition does not explicitly define a symbolic name parameter. Instead, the short name of the container will be used in the Ecu Configuration Description to specify the symbolic name of the VIEW_NAME.
        integer DemViewID: 0..255, set at pre-compile, symbolic-name-value=true  # NOT USED by Vector Unique Identifier of a view. Implementation type: uint8
    container VectorCommonData  # NOT USED - META INFORMATION
      string BswmdVersion: configuration-class-affection=affection-kind=NO-AFFECT, set at published-information, origin=Vector Informatik, default-value=1.06.03  # NOT USED - META INFORMATION
