AUTOSAR XML (schema 3.1.4)
# COPYRIGHT
# Copyright (c) by Vector Informatik GmbH. All rights reserved.
# This software is copyright protected and proprietary to Vector Informatik GmbH.
# Vector Informatik GmbH grants to you only those rights as set out in the license conditions.
package /MICROSAR
  bsw implementation Mcu_Impl: code-generator=cMICROSAR, programming-language=C, sw-major-version=1, sw-minor-version=4, sw-patch-version=1, vendor-id=30, ar-major-version=2, ar-minor-version=3, ar-patch-version=0, preconfigured-configuration=Mcu_Pre, recommended-configuration=Mcu_Rec, vendor-api-infix=101, vendor-specific-module-def=Mcu
  module definition Mcu [0..1]: refined-module-def=Mcu, variants pre-compile/post-build  # Configuration of the Mcu (Microcontroler Unit) module.
    container McuGeneralConfiguration  # General Configuration | This container contains the configuration (parameters) of the MCU driver.
      boolean McuDevErrorDetect: set at pre-compile, default-value=false  # Development Mode | Pre-processor switch for enabling the development error detection and reporting.
      boolean McuPerformResetApi: set at pre-compile, default-value=true  # Enable Mcu_PerformReset | Pre-processor switch to enable/disable the use of the function Mcu_PerformReset().
      boolean McuVersionInfoApi: set at pre-compile, default-value=true  # Enable Mcu_GetVersionInfo | Pre-processor switch to enable/disable the API to read out the modules version information.
      boolean McuDoParamCheck: set at pre-compile, origin=VECTOR INFORMATIK, default-value=true  # Check Parameters | Enables parameter check.
      boolean McuCheckParamConfig: set at pre-compile, origin=VECTOR INFORMATIK, default-value=true  # Check Configuration Pointer | Enables the check of the Config pointer in the Mcu_Init() function.
      boolean McuCheckParamMode: set at pre-compile, origin=VECTOR INFORMATIK, default-value=true  # Check Mode Parameter | Enables the check of the mode parameter in the Mcu_SetMode() function.
      boolean McuCheckParamClock: set at pre-compile, origin=VECTOR INFORMATIK, default-value=true  # Check Clock Parameter | Enables the use of the parameter ClockSetting in the Mcu_InitClock() function.
      boolean McuCheckParamRamSection: set at pre-compile, origin=VECTOR INFORMATIK, default-value=true  # Check RamSection Parameter | Enables to check whether the given RAM Section number is located in the allow boundaries.
      boolean McuCheckVersionInfo: set at pre-compile, origin=VECTOR INFORMATIK, default-value=true  # Check Version Information | This switch is used to enable/disable the checking of the module version info.
      boolean McuCheckUninit: set at pre-compile, origin=VECTOR INFORMATIK, default-value=true  # Perform Uninit Check | Enables to check whether the module was initialized or not.
      boolean McuCheckPllStatus: set at pre-compile, origin=VECTOR INFORMATIK, default-value=true  # Check PLL Status | Allow to check the status of the PLL whether it locked or not.
      boolean McuDevErrorReport: set at pre-compile, origin=VECTOR INFORMATIK, default-value=true  # Development Error Reporting | Pre-processor switch to enable/disable reporting of development errors.
      function name McuErrorHook [0..1]: set at pre-compile, origin=VECTOR INFORMATIK, default-value=Det_ReportError  # DET Error Function | Uses to report development errors.
      string McuIncludeDet [0..1]: set at pre-compile, origin=VECTOR INFORMATIK, default-value=Det.h  # DET Include File | Includes the header file where the Error hook function is defined.
      boolean McuProdErrorReport: set at pre-compile, origin=VECTOR INFORMATIK, default-value=true  # Production Error Reporting | Pre-processor switch to enable/disable reporting of production errors.
      function name McuErrorRoutine [0..1]: set at pre-compile, origin=VECTOR INFORMATIK, default-value=Dem_SetEventStatus  # DEM Error Function | Uses to report production errors.
      string McuIncludeDem [0..1]: set at pre-compile, origin=VECTOR INFORMATIK, default-value=Dem.h  # DEM Include File | Includes the header file where the Error routine function is defined.
      boolean McuUseInitRamApi: set at pre-compile, origin=VECTOR INFORMATIK, default-value=false  # Enable Mcu_InitRamSection | Enable or disable the use of Switch Mcu_InitRam() function.
      boolean McuCopyTrimFromOtp: set at pre-compile, origin=VECTOR INFORMATIK, default-value=true  # LPO lock trim | This parameter decides if either: - LFTRIM and HFTRIM values are input by the use or - LFTRIM and HFTRIM values are set according to OTP register
      boolean McuSraEnabled: set at pre-compile, origin=VECTOR INFORMATIK, default-value=false  # Register Access via OS Functions | This control enables/ disables all access to the peripheral registers via a special function. The special function allows the access to the registers even if they are protected by MPU or supervisor mode. The function shall be provided by the OS.
      boolean McuSraOnlyForWrite: set at pre-compile, origin=VECTOR INFORMATIK, default-value=false  # Special Register Access only for Write | This control enables/ disables the usage of the special function to access the peripheral registers for the read access.
      boolean McuSraOnlyForPrivModeRegs: set at pre-compile, origin=VECTOR INFORMATIK, default-value=false  # Special Register Access only for Priviledged Mode Registers | This control enables/ disables the usage of the special function to access the peripheral registers for the read and write access. Only the registers which needs supervisor rights will be accessed with the special function.
      boolean McuSraNotInInit: set at pre-compile, origin=VECTOR INFORMATIK, default-value=false  # Special Register Access not during Initialization | This control enables/ disables the usage of the special function to access the peripheral registers during the initialization.
      boolean McuErrataFmzPll17Workaround: set at pre-compile, origin=VECTOR INFORMATIK, default-value=false  # Errata FMZPLL #17 Workaround | Pre-processor switch to enable/disable the FMZPLL #17 errata workaround. For details see Errata sheet Antares_12_22_2009.pdf dated 12/22/09, issue BTS_SSW.17.
      enumeration McuBank{0..7}Pwr: {SleepMode, StandbyMode, ActiveMode}, set at pre-compile, origin=VECTOR INFORMATIK, default-value=ActiveMode  # BANK{0..7} | These settings correspond to the Fallback Power Mode: - SleepMode: sense amplifiers and sense reference disable - StandbyMode: sense amplifiers disable, but sense refernece enabled - Activemode: both sense amplifiers and sense reference enabled
      reference McuIrqHandling: set at pre-compile, origin=VECTOR INFORMATIK, destination=InterruptFunctionSet  # Critical Section Handling | Preprocessor switch to determine the IRQ function set which is used to protect critical sections.
      container McuMemInit  # Memory initilaization.
        boolean McuInitMibSpiP1Ram: set at pre-compile, origin=VECTOR INFORMATIK, default-value=true  # Select/Init MIBSPIP1 RAM | This switch enables/disables the initialization of the MIBSPIP1 RAM.
        boolean McuInitMibSpiP3Ram: set at pre-compile, origin=VECTOR INFORMATIK, default-value=true  # Select/Init MIBSPIP3 RAM | This switch enables/disables the initialization of the MIBSPIP3 RAM.
        boolean McuInitMibSpiP5Ram: set at pre-compile, origin=VECTOR INFORMATIK, default-value=true  # Select/Init MIBSPIP5 RAM | This switch enables/disables the initialization of the MIBSPIP5 RAM.
        boolean McuInitDcan{1..3}Ram: set at pre-compile, origin=VECTOR INFORMATIK, default-value=true  # Select/Init DCAN{1..3} RAM | This switch enables/disables the initialization of the DCAN{1..3} RAM.
        boolean McuInitMibAdc1Ram: set at pre-compile, origin=VECTOR INFORMATIK, default-value=true  # Select/Init MIBADC1 RAM | This switch enables/disables the initialization of the MIBADC1 RAM.
        boolean McuInitMibAdc2Ram: set at pre-compile, origin=VECTOR INFORMATIK, default-value=true  # Select/Init MIBADC2 RAM | This switch enables/disables the initialization of the MIBADC2 RAM.
        boolean McuInitNhet1Ram: set at pre-compile, origin=VECTOR INFORMATIK, default-value=true  # Select/Init NHET1 RAM | This switch enables/disables the initialization of the NHET1 RAM.
        boolean McuInitNhet2Ram: set at pre-compile, origin=VECTOR INFORMATIK, default-value=true  # Select/Init NHET2 RAM | This switch enables/disables the initialization of the NHET2 RAM.
        boolean McuInitHetTu1Ram: set at pre-compile, origin=VECTOR INFORMATIK, default-value=true  # Select/Init HET TU1 RAM | This switch enables/disables the initialization of the HETTU1 RAM.
        boolean McuInitHetTu2Ram: set at pre-compile, origin=VECTOR INFORMATIK, default-value=true  # Select/Init HET TU2 RAM | This switch enables/disables the initialization of the HETTU2 RAM.
        boolean McuInitDmaRam: set at pre-compile, origin=VECTOR INFORMATIK, default-value=true  # Init DMA RAM | This switch enables/disables the initialization of the DMA RAM.
        boolean McuInitVimRam: set at pre-compile, origin=VECTOR INFORMATIK, default-value=false  # Init VIM RAM | This switch enables/disables the initialization of the VIM RAM.
        boolean McuInitFlexRayTuRam: set at pre-compile, origin=VECTOR INFORMATIK, default-value=true  # Select/Init FlexRay TU RAM | This switch enables/disables the initialization of the FlexRay RAM.
      container McuPeripheralSelect  # Peripheral select.
        boolean McuUseMibSpiP1: set at pre-compile, origin=VECTOR INFORMATIK, default-value=true  # Use MIBSPIP1 | This switch enables/disables the initialization of the MIBSPIP1 unit (Multibuffer Serial Peripheral Interface Module).
        boolean McuUseSpiP2: set at pre-compile, origin=VECTOR INFORMATIK, default-value=true  # Use SPI2 | This switch enables/disables the initialization of the SPI2 unit (Serial Peripheral Interface).
        boolean McuUseMibSpiP3: set at pre-compile, origin=VECTOR INFORMATIK, default-value=true  # Use MIBSPIP3 | This switch enables/disables the initialization of the MIBSPIP3 unit (Multibuffer Serial Peripheral Interface Module).
        boolean McuUseSpiP4: set at pre-compile, origin=VECTOR INFORMATIK, default-value=true  # Use SPI4 | This switch enables/disables the initialization of the SPI4 unit (Serial Peripheral Interface).
        boolean McuUseMibSpiP5: set at pre-compile, origin=VECTOR INFORMATIK, default-value=true  # Use MIBSPIP5 | This switch enables/disables the initialization of the MIBSPIP5 unit (Multibuffer Serial Peripheral Interface Module).
        boolean McuUseLin: set at pre-compile, origin=VECTOR INFORMATIK, default-value=true  # Use LIN | This switch enables/disables the initialization of the LIN (Local Interconnect Network).
        boolean McuUseSci: set at pre-compile, origin=VECTOR INFORMATIK, default-value=true  # Use SCI | This switch enables/disables the initialization of the SCI (Serial Communication Interface).
        boolean McuUseDcan{1..3}: set at pre-compile, origin=VECTOR INFORMATIK, default-value=true  # Use DCAN{1..3} | This switch enables/disables the initialization of the DCAN{1..3} unit.
        boolean McuUseI2c: set at pre-compile, origin=VECTOR INFORMATIK, default-value=true  # Use I2C | This switch enables/disables the initialization of the I2c perpheral.
        boolean McuUseFlexRay: set at pre-compile, origin=VECTOR INFORMATIK, default-value=true  # Use FlexRay | This switch enables/disables the initialization of the FlexRay perpheral.
        boolean McuUseMibAdc1: set at pre-compile, origin=VECTOR INFORMATIK, default-value=true  # Use MIBADC1 | This switch enables/disables the initialization of the ADC1 unit.
        boolean McuUseMibAdc2: set at pre-compile, origin=VECTOR INFORMATIK, default-value=true  # Use MIBADC2 | This switch enables/disables the initialization of the ADC2 unit.
        boolean McuUseGio: set at pre-compile, origin=VECTOR INFORMATIK, default-value=true  # Use GIO | This switch enables/disables the initialization of the GIOs.
        boolean McuUseNhet1: set at pre-compile in variant pre-compile / post-build in variant post-build, origin=VECTOR INFORMATIK, default-value=true  # Use NHET1 | This switch enables/disables the initialization of the NHET1.
        boolean McuUseNhet2: set at pre-compile in variant pre-compile / post-build in variant post-build, origin=VECTOR INFORMATIK, default-value=true  # Use NHET2 | This switch enables/disables the initialization of the NHET2.
        boolean McuUseHetTu1: set at pre-compile in variant pre-compile / post-build in variant post-build, origin=VECTOR INFORMATIK, default-value=true  # Use HET TU1 | This switch enables/disables the initialization of the HET Transfer Unit 1.
        boolean McuUseHetTu2: set at pre-compile in variant pre-compile / post-build in variant post-build, origin=VECTOR INFORMATIK, default-value=true  # Use HET TU2 | This switch enables/disables the initialization of the HET Transfer Unit 2.
        boolean McuUseFlexRayTu: set at pre-compile, origin=VECTOR INFORMATIK, default-value=true  # Use FlexRay TU | This switch enables/disables the initialization of the FlexRay Transfer Unit.
        boolean McuUseDmm: configuration-class-affection=affection-kind=NO-AFFECT, set at pre-compile, origin=VECTOR INFORMATIK, default-value=true  # Use DMM | This switch is used to initialize the DMM (Data Modification Module) . The Data Modification Module receives data over a dedicated port from external systems and writes the data directly to the address given in the packet and programmed in the module.
    container McuModuleConfiguration: multiple-configuration-container=true  # This container contains the configuration (parameters) of the MCU driver.
      enumeration McuClockSrcFailureNotification: {DISABLED, ENABLED}, set at pre-compile in variant pre-compile / post-build in variant post-build, default-value=DISABLED  # Clock Failure Notification | Enables/Disables clock failure notification. In case this feature is not supported by HW the setting should be disabled. [Not Used]
      derived integer McuNumberOfMcuModes: 3..3, set at pre-compile, default-value=3, calculation-formula=number of configured mcumodesettingconf, calculation-language=INFORMAL  # Number Of MCU Modes | This parameter shall represent the number of Modes available for the MCU. CalculationFormula = Number of configured McuModeSettingConf. [Not Used]
      derived integer McuRamSectors: 1..65535, set at pre-compile in variant pre-compile / post-build in variant post-build, default-value=1, calculation-formula=number of configured mcuramsectorsettingconf, calculation-language=INFORMAL  # Number Of RAM Sectors | This parameter shall represent the number of RAM sectors available for the MCU. CalculationFormula = Number of configured McuRamSectorSettingConf. [Not Used]
      integer McuResetSetting [0..1]: 1..1, set at pre-compile, default-value=1  # This parameter relates to the MCU specific reset configuration. This applies to the function Mcu_PerformReset, which performs a microcontroller reset using the hardware feature of the microcontroller. [Not Used]
      container McuClockSettingConfig [1..*]  # This container contains the configuration (parameters) for the Clock settings of the MCU. Please see MCU031 for more information on the MCU clock settings.
        container McuClockReferencePoint [1..*]  # This container defines a reference point in the Mcu Clock tree. It defines the frequency which then can be used by other modules as an input value. Lower multiplictiy is 1, as even in the simpliest case (only one frequency is used), there is one frequency to be defined.
          float McuClockReferencePointFrequency: 5..20, set at pre-compile in variant pre-compile / post-build in variant post-build, default-value=20  # Oscillator Clock (MHz) | This is the frequency for the specific instance of the McuClockReferencePoint container. It shall be given in MHz.
        container McuLpo  # Internal oscillator
          boolean McuLpoEnableBias: configuration-class-affection=affection-kind=PC-AFFECTS-PB, set at pre-compile, origin=VECTOR INFORMATIK, default-value=true  # Enable Bias | Enable/disable the bias circuit inside the low power oscillator (LPO).
          enumeration McuLpoTrimLow: {Trim20Comma67Percent, Trim25Comma76Percent, Trim30Comma84Percent, Trim35Comma90Percent, Trim40Comma93Percent, Trim45Comma95Percent, Trim50Comma97Percent, Trim55Comma91Percent, Trim60Comma86Percent, Trim65Comma78Percent, Trim70Comma75Percent, Trim75Comma63Percent, Trim80Comma61Percent, Trim85Comma39Percent, Trim90Comma23Percent, Trim95Comma11Percent, Trim100Comma00Percent, Trim104Comma84Percent, Trim109Comma51Percent, Trim114Comma31Percent, Trim119Comma01Percent, Trim123Comma75Percent, Trim128Comma62Percent, Trim133Comma31Percent, Trim138Comma03Percent, Trim142Comma75Percent, Trim147Comma32Percent, Trim152Comma02Percent, Trim156Comma63Percent, Trim161Comma38Percent, Trim165Comma90Percent, Trim170Comma42Percent}, set at pre-compile in variant pre-compile / post-build in variant post-build, origin=VECTOR INFORMATIK, default-value=Trim100Comma00Percent  # Low frequency oscillator trim value. They are used to center the LF LPO oscillator's frequency. This value should only be changed when the LF oscillator is not the source of SYSCLK, otherwise a crash colud result.
          enumeration McuLpoTrimHigh: {Trim29Comma52Percent, Trim34Comma24Percent, Trim38Comma85Percent, Trim43Comma45Percent, Trim47Comma99Percent, Trim52Comma55Percent, Trim57Comma02Percent, Trim61Comma46Percent, Trim65Comma92Percent, Trim70Comma17Percent, Trim74Comma55Percent, Trim78Comma92Percent, Trim83Comma17Percent, Trim87Comma43Percent, Trim91Comma75Percent, Trim95Comma89Percent, Trim100Comma00Percent, Trim104Comma09Percent, Trim108Comma17Percent, Trim112Comma32Percent, Trim116Comma41Percent, Trim120Comma67Percent, Trim124Comma42Percent, Trim128Comma38Percent, Trim132Comma24Percent, Trim136Comma15Percent, Trim140Comma15Percent, Trim143Comma94Percent, Trim148Comma02Percent, Trim151Comma80Percent, Trim155Comma50Percent, Trim159Comma35Percent}, set at pre-compile in variant pre-compile / post-build in variant post-build, origin=VECTOR INFORMATIK, default-value=Trim100Comma00Percent  # High frequency oscillator trim value. They are used to center the HF LPO oscillator's frequency. This value should only be changed when the HF oscillator is not the source of SYSCLK, otherwise a crash colud result.
          integer McuLpoLowref: 60..100, set at pre-compile in variant pre-compile / post-build in variant post-build, origin=VECTOR INFORMATIK, default-value=80  # LPO Low Reference | This is the current Lpo low reference frequency in KHz. The value is chip (mask) specific and it must be measured.
          integer McuLpoHighref: 80..120, set at pre-compile in variant pre-compile / post-build in variant post-build, origin=VECTOR INFORMATIK, default-value=100  # LPO High Reference | This is the current Lpo high reference frequency in hundreeds of KHz. The value is chip (mask) specific and it must be measured.
          float McuLpoLowfreq: set at pre-compile in variant pre-compile / post-build in variant post-build, origin=VECTOR INFORMATIK, default-value=0.080  # LPO Low | This is the current Lpo low frequency. Value should not be configurated since it is only used for the DaVinci Cfg Pro comfort view.
          float McuLpoHighfreq: set at pre-compile in variant pre-compile / post-build in variant post-build, origin=VECTOR INFORMATIK, default-value=10  # LPO High | This is the current Lpo high frequency. Value should not be configurated since it is only used for the DaVinci Cfg Pro comfort view.
        container McuPllConfig  # PLL
          integer McuPllRefClkDiv: 1..64, set at pre-compile in variant pre-compile / post-build in variant post-build, origin=VECTOR INFORMATIK, default-value=8  # NR (PLL Reference Clock Divider) | This is the Prescaler divider of the FM PLL.
          integer McuPllOdDiv: 1..8, set at pre-compile in variant pre-compile / post-build in variant post-build, origin=VECTOR INFORMATIK, default-value=2  # OD (Internal PLL Output Divider) | Postscale dividers.
          integer McuPllRDiv: 1..32, set at pre-compile in variant pre-compile / post-build in variant post-build, origin=VECTOR INFORMATIK, default-value=1  # R (PLL Output Clock Divider) | Postscale divider.
          integer McuPllMul: 1..256, set at pre-compile in variant pre-compile / post-build in variant post-build, origin=VECTOR INFORMATIK, default-value=180  # NF (PLL Multiplication Factor) | Multiplier.
          float McuPllIntClk: 1.630..6.530, set at pre-compile in variant pre-compile / post-build in variant post-build, origin=VECTOR INFORMATIK, default-value=2  # INTCLK (MHz) | This is the INTCLK frequency. Value should not be configurated since it is only used for the DaVinci Cfg Pro comfort view.
          float McuPllOutputClk: ..500, set at pre-compile in variant pre-compile / post-build in variant post-build, origin=VECTOR INFORMATIK, default-value=360  # foutputCLK (MHz) | This is the FM PLL output clock. Value should not be configurated since it is only used for the DaVinci Cfg Pro comfort view.
          float McuPllFreq: ..180, set at pre-compile in variant pre-compile / post-build in variant post-build, origin=VECTOR INFORMATIK, default-value=180  # PLL (MHz) | This is the resulting PLL frequency. Value should not be configurated since it is only used for the DaVinci Cfg Pro comfort view.
          enumeration McuPllFmMode: {FM_Enabled, FM_Disabled}, set at pre-compile in variant pre-compile / post-build in variant post-build, origin=VECTOR INFORMATIK, default-value=FM_Disabled  # Enable/ Disable Modulation | This parameter is used to enable/disable frequency modulation.
          integer McuPllFmNs: 1..512, set at pre-compile in variant pre-compile / post-build in variant post-build, origin=VECTOR INFORMATIK, default-value=21  # NS (Spreading Rate) | Prescaler for the PLL modulation frequency.
          float McuPllFmFs: 0.015..4, set at pre-compile in variant pre-compile / post-build in variant post-build, origin=VECTOR INFORMATIK, default-value=0.015  # Modulation Frequency fs (MHz) | This is the resulting frequency modulation fs. Value should not be configurated since it is only used for the DaVinci Cfg Pro comfort view.
          integer McuPllFmNv: 1..512, set at pre-compile in variant pre-compile / post-build in variant post-build, origin=VECTOR INFORMATIK, default-value=1  # NV (Spreading Amount) | Modulation spreading depth.
          float McuPllFmDepth: set at pre-compile in variant pre-compile / post-build in variant post-build, origin=VECTOR INFORMATIK, default-value=1.5  # Modulation Depth (%) | This is the resulting depth in. Value should not be configurated since it is only used for the DaVinci Cfg Pro comfort view.
          integer McuPllFmBwadj: 8..256, set at pre-compile in variant pre-compile / post-build in variant post-build, origin=VECTOR INFORMATIK, default-value=219  # NB (Bandwidth Adjustment) | Modulation spreading Bandwith.
          boolean McuPllResetOnPllSlip: set at pre-compile in variant pre-compile / post-build in variant post-build, origin=VECTOR INFORMATIK, default-value=false  # Slect whether a reset shall occur in PLL Slip or not.
          boolean McuPllBypassOnPllSlip: set at pre-compile in variant pre-compile / post-build in variant post-build, origin=VECTOR INFORMATIK, default-value=false  # Enable/disable the Bypass on Slip.
          boolean McuPllResetOnOsciFail: set at pre-compile in variant pre-compile / post-build in variant post-build, origin=VECTOR INFORMATIK, default-value=false  # Enable/Disable Reset on Oscillator failed.
        container McuPll2Config  # PLL2
          integer McuPll2RefClkDiv: 1..64, set at pre-compile in variant pre-compile / post-build in variant post-build, origin=VECTOR INFORMATIK, default-value=8  # NR2 (PLL2 Reference Clock Divider) | This is the Prescaler divider of the PLL2.
          integer McuPll2OdDiv: 1..8, set at pre-compile in variant pre-compile / post-build in variant post-build, origin=VECTOR INFORMATIK, default-value=2  # OD2 (Internal PLL2 Output Divider) | Postscale dividers.
          integer McuPll2RDiv: 1..32, set at pre-compile in variant pre-compile / post-build in variant post-build, origin=VECTOR INFORMATIK, default-value=1  # R2 (PLL2 Output Clock Divider) | Postscale divider.
          integer McuPll2Mul: 1..256, set at pre-compile in variant pre-compile / post-build in variant post-build, origin=VECTOR INFORMATIK, default-value=180  # NF2 (PLL2 Multiplication Factor) | Multiplier.
          float McuPll2IntClk: 1.630..6.530, set at pre-compile in variant pre-compile / post-build in variant post-build, origin=VECTOR INFORMATIK, default-value=2  # INTCLK2 (MHz) | This is the INTCLK2 frequency. Value should not be configurated since it is only used for the DaVinci Cfg Pro comfort view.
          float McuPll2OutputClk: ..500, set at pre-compile in variant pre-compile / post-build in variant post-build, origin=VECTOR INFORMATIK, default-value=360  # foutputCLK2 (MHz) | This is the PLL2 output clock. Value should not be configurated since it is only used for the DaVinci Cfg Pro comfort view.
          float McuPll2Freq: ..180, set at pre-compile in variant pre-compile / post-build in variant post-build, origin=VECTOR INFORMATIK, default-value=180  # PLL2 (MHz) | This is the resulting PLL2 frequency. Value should not be configurated since it is only used for the DaVinci Cfg Pro comfort view.
        container McuExtClocks  # External clocks
          float McuExtClk1Freq: set at pre-compile, origin=VECTOR INFORMATIK, default-value=80  # EXTCLKIN1 | External clock 1 (in MHz).
          float McuExtClk2Freq: set at pre-compile, origin=VECTOR INFORMATIK, default-value=80  # EXTCLKIN2 | External clock 2 (in MHz).
        container McuClocks  # Clocks and domains.
          container McuClockSrc  # Clock sources.
            boolean McuUsePllClk: set at pre-compile in variant pre-compile / post-build in variant post-build, origin=VECTOR INFORMATIK, default-value=true  # Use PLL | Select PLL as Clock Source.
            boolean McuUseOsciClk: set at pre-compile in variant pre-compile / post-build in variant post-build, origin=VECTOR INFORMATIK, default-value=true  # Use Oscillator | Select Oscillator clock as Clock source.
            boolean McuUse32KhzOsciClk: set at pre-compile in variant pre-compile / post-build in variant post-build, origin=VECTOR INFORMATIK, default-value=true  # Use 32kHz Oscillator | Select 32 KHz oscillator as clock source.
            boolean McuUseLpoLow: set at pre-compile in variant pre-compile / post-build in variant post-build, origin=VECTOR INFORMATIK, default-value=true  # Use LPO Low | Select LPO Low as clock source.
            boolean McuUseLpoHigh: set at pre-compile in variant pre-compile / post-build in variant post-build, origin=VECTOR INFORMATIK, default-value=true  # Use LPO High | Select LPO High as clock source
            boolean McuUsePll2Clk: set at pre-compile in variant pre-compile / post-build in variant post-build, origin=VECTOR INFORMATIK, default-value=false  # Use PLL2 | Select PLL2 as Clock Source.
            boolean McuUseExtClk1: set at pre-compile in variant pre-compile / post-build in variant post-build, origin=VECTOR INFORMATIK, default-value=false  # Use EXTCLKIN1 | Select EXTCLKIN1 as clock source.
            boolean McuUseExtClk2: set at pre-compile in variant pre-compile / post-build in variant post-build, origin=VECTOR INFORMATIK, default-value=false  # Use EXTCLKIN2 | Select EXTCLKIN2 as clock source.
            boolean McuUseGclk: set at pre-compile in variant pre-compile / post-build in variant post-build, origin=VECTOR INFORMATIK, default-value=true  # Use GCLK | Select the GCLK as clock domaine.
            boolean McuUseHclk: set at pre-compile in variant pre-compile / post-build in variant post-build, origin=VECTOR INFORMATIK, default-value=true  # Use HCLK | Select the HCLK as clock domaine.
            boolean McuUseVclkp: set at pre-compile in variant pre-compile / post-build in variant post-build, origin=VECTOR INFORMATIK, default-value=true  # Use VCLK | Select the VCLK as clock domaine.
            boolean McuUseVclk2: set at pre-compile in variant pre-compile / post-build in variant post-build, origin=VECTOR INFORMATIK, default-value=true  # Use VCLK2 | Select the VCLK2 as clock domaine.
            boolean McuUseVclk3: set at pre-compile in variant pre-compile / post-build in variant post-build, origin=VECTOR INFORMATIK, default-value=true  # Use VCLK3 | Select the VCLK3 as clock domaine.
            boolean McuUseVclka1: set at pre-compile in variant pre-compile / post-build in variant post-build, origin=VECTOR INFORMATIK, default-value=true  # Use AVCLK1 | Select the VCLKA1 as clock domaine.
            boolean McuUseVclka2: set at pre-compile in variant pre-compile / post-build in variant post-build, origin=VECTOR INFORMATIK, default-value=true  # Use AVCLK2 | Select the VCLKA2 as clock domaine.
            boolean McuUseVclka4: set at pre-compile in variant pre-compile / post-build in variant post-build, origin=VECTOR INFORMATIK, default-value=true  # Use AVCLK4 | Select the VCLKA4 as clock domaine.
            boolean McuUseVclka4Pre: set at pre-compile in variant pre-compile / post-build in variant post-build, origin=VECTOR INFORMATIK, default-value=false  # Enable the VCLKA4_DIVR signal.
            boolean McuUseRtiClk1: set at pre-compile in variant pre-compile / post-build in variant post-build, origin=VECTOR INFORMATIK, default-value=true  # Use RTICLK1 | Select the RTICLK1 as clock domaine.
            float McuRTI1Freq: set at pre-compile in variant pre-compile / post-build in variant post-build, origin=VECTOR INFORMATIK, default-value=90  # RTI1 | RTI1 Clock. Value should not be configurated since it is only used for the DaVinci Cfg Pro comfort view.
            float McuAVclk1Freq: set at pre-compile in variant pre-compile / post-build in variant post-build, origin=VECTOR INFORMATIK, default-value=90  # AVCLK1 | Async Peripheral clock1. Value should not be configurated since it is only used for the DaVinci Cfg Pro comfort view.
            float McuAVclk2Freq: set at pre-compile in variant pre-compile / post-build in variant post-build, origin=VECTOR INFORMATIK, default-value=90  # AVCLK2 | Async Peripheral clock2. Value should not be configurated since it is only used for the DaVinci Cfg Pro comfort view.
            float McuAVclk4sFreq: set at pre-compile in variant pre-compile / post-build in variant post-build, origin=VECTOR INFORMATIK, default-value=90  # AVCLK4_S | Async Peripheral clock4 - S. Value should not be configurated since it is only used for the DaVinci Cfg Pro comfort view.
            float McuAVclk4divrFreq: set at pre-compile in variant pre-compile / post-build in variant post-build, origin=VECTOR INFORMATIK, default-value=90  # AVCLK4_DIVR | Async Peripheral clock4 - DIVR. Value should not be configurated since it is only used for the DaVinci Cfg Pro comfort view.
            enumeration McuVclka1: {Oscillator, PLL, Oscillator32Khz, ExtClkIn1, LpoLow, LpoHigh, PLL2, ExtClkIn2, Vclk}, set at post-build, origin=VECTOR INFORMATIK, default-value=Vclk  # AVCLK1 | Peripheral asynchronous clock2 source.
            enumeration McuVclka2: {Oscillator, PLL, Oscillator32Khz, ExtClkIn1, LpoLow, LpoHigh, PLL2, ExtClkIn2, Vclk}, set at post-build, origin=VECTOR INFORMATIK, default-value=Vclk  # AVCLK2 | Peripheral asynchronous clock2 source.
            enumeration McuVclka4: {Oscillator, PLL, Oscillator32Khz, ExtClkIn1, LpoLow, LpoHigh, PLL2, ExtClkIn2, Vclk}, set at post-build, origin=VECTOR INFORMATIK, default-value=Vclk  # AVCLK4 | Peripheral asynchronous clock4 source.
            enumeration McuRti1Src: {Oscillator, PLL, Oscillator32Khz, ExtClkIn1, LpoLow, LpoHigh, PLL2, ExtClkIn2, Vclk}, set at post-build, origin=VECTOR INFORMATIK, default-value=Vclk  # RTI1 | RTI1 clock source. Value should not be configurated since it is only used for the DaVinci Cfg Pro comfort view.
            enumeration McuVclka4r: {DivderbyOne, DivderbyTwo, DivderbyThree, DivderbyFour, DivderbyFive, DivderbySix, DivderbySeven, DivderbyEight}, set at pre-compile in variant pre-compile / post-build in variant post-build, origin=VECTOR INFORMATIK, default-value=DivderbyOne  # AVCLK4 | AVCLK4 Clock prescaler
            enumeration McuRti1Div: {DivderbyOne, DivderbyTwo, DivderbyFour, DivderbyEight}, set at pre-compile in variant pre-compile / post-build in variant post-build, origin=VECTOR INFORMATIK, default-value=DivderbyOne  # RTI1 | RTI1 Clock prescaler
          container McuClockDomains  # Domains.
            float McuGclkFreq: set at pre-compile in variant pre-compile / post-build in variant post-build, origin=VECTOR INFORMATIK, default-value=180  # GCLK | CPU [GCLK=>MCLK]. Value should not be configurated since it is only used for the DaVinci Cfg Pro comfort view.
            float McuHclkFreq: set at pre-compile in variant pre-compile / post-build in variant post-build, origin=VECTOR INFORMATIK, default-value=180  # HCLK | System Bus Clock. Value should not be configurated since it is only used for the DaVinci Cfg Pro comfort view.
            integer McuFrdCntlAswsten: 0..1, set at pre-compile in variant pre-compile / post-build in variant post-build, origin=VECTOR INFORMATIK, default-value=1  # Address Waitstates | Address is not latched (if Waitstates = 0) or is latched (if Waitstates = 1) one cycle before decoding to determine pipeline hit or miss. Address Wait State is only available in pipeline mode. The value is optimally calculated by the tool according to the current GCLK and cannot be adjusted by the user.
            integer McuFrdCntlRwait: 0..3, set at pre-compile in variant pre-compile / post-build in variant post-build, origin=VECTOR INFORMATIK, default-value=3  # Data Waitstates | The random read wait state value indicates how many wait states are added to a flash read access. In pipeline mode there is always one wait state even when the value is set to 0. The value is optimally calculated by the tool according to the current GCLK and cannot be adjusted by the user.
            float McuVclkFreq: set at pre-compile in variant pre-compile / post-build in variant post-build, origin=VECTOR INFORMATIK, default-value=90  # VCLK | System peripheral clock. Value should not be configurated since it is only used for the DaVinci Cfg Pro comfort view.
            float McuVclk2Freq: set at pre-compile in variant pre-compile / post-build in variant post-build, origin=VECTOR INFORMATIK, default-value=90  # VCLK2 | Peripheral clock derived from HCLK. Value should not be configurated since it is only used for the DaVinci Cfg Pro comfort view.
            float McuVclk3Freq: set at pre-compile in variant pre-compile / post-build in variant post-build, origin=VECTOR INFORMATIK, default-value=90  # VCLK3 | Peripheral clock derived from HCLK. Value should not be configurated since it is only used for the DaVinci Cfg Pro comfort view.
            enumeration McuGhvwake: {Oscillator, PLL, Oscillator32Khz, ExtClkIn1, LpoLow, LpoHigh, PLL2, ExtClkIn2}, set at post-build, origin=VECTOR INFORMATIK, default-value=PLL  # On Wake-up | Clock Source of the GCLK, HCLK, VCLK, VCLK2 and VCLK3 on wakeup.
            enumeration McuHvlpm: {Oscillator, PLL, Oscillator32Khz, ExtClkIn1, LpoLow, LpoHigh, PLL2, ExtClkIn2}, set at post-build, origin=VECTOR INFORMATIK, default-value=PLL  # In Low Power Mode | Clock Source of the GCLK, HCLK, VCLK, VCLK2 and VCLK3 for low power mode.
            enumeration McuGhvsrc: {Oscillator, PLL, Oscillator32Khz, ExtClkIn1, LpoLow, LpoHigh, PLL2, ExtClkIn2}, set at post-build, origin=VECTOR INFORMATIK, default-value=PLL  # In Normal Mode | Current Clock Source of the GCLK, HCLK, VCLK, VCLK2 and VCLK3.
            integer McuTreeVclkDiv: 1..16, set at pre-compile in variant pre-compile / post-build in variant post-build, origin=VECTOR INFORMATIK, default-value=2  # VCLK | VCLK clock prescaler.
            integer McuTreeVclk2Div: 1..16, set at pre-compile in variant pre-compile / post-build in variant post-build, origin=VECTOR INFORMATIK, default-value=2  # VCLK2 | VCLK2 clock prescaler.
            integer McuTreeVclk3Div: 1..16, set at pre-compile in variant pre-compile / post-build in variant post-build, origin=VECTOR INFORMATIK, default-value=2  # VCLK3 | VCLK2 clock prescaler.
            integer McuEclkPrescaler: 0..65535, set at pre-compile in variant pre-compile / post-build in variant post-build, origin=VECTOR INFORMATIK, default-value=0  # ECLK Prescaler | Divider value for the external clock frequency. ELCK=VCLK or OSCIN divided by (ECLK Prescaler+1). Note ECLK max = 20 MHz.
            boolean McuEclkSuspendMode: set at pre-compile, origin=VECTOR INFORMATIK, default-value=true  # ECLK Suspend Mode | If enabled, the ECLK will be provided even during suspend mode.
            enumeration McuEclkSelector: {VCLK, OSCIN}, set at pre-compile, origin=VECTOR INFORMATIK, default-value=VCLK  # ECLK Selector | This Value selects the used clock source for the external clock.
      container McuModeSettingConf [1..*]  # This container contains the configuration (parameters) for the Mode setting of the MCU. Please see MCU035 for more information on the MCU mode settings.
        integer McuMode: 0..0, set at pre-compile in variant pre-compile / post-build in variant post-build, symbolic-name-value=true, default-value=0  # Mode ID | The parameter represents the MCU Mode settings. [Not Used]
        enumeration McuPowerMode: {DozeMode, SleepMode, SnoozeMode}, set at pre-compile in variant pre-compile / post-build in variant post-build, origin=VECTOR INFORMATIK, default-value=DozeMode  # Power Mode | The parameter represents the MCU Mode settings.
      container McuRamSectorSettingConf [0..*]  # This container contains the configuration (parameters) for the RAM Sector setting. Please see MCU030 for more information on RAM sec-tor settings.
        integer McuRamDefaultValue: 0..4294967294, set at post-build, default-value=0  # RAM Default Value | This parameter shall represent the Data pre-setting to be initialized.
        integer McuRamSectionBaseAddress: 134217728..134381567, set at post-build, default-value=134217728  # This parameter shall represent the MCU RAM section base address. [Not used]
        integer McuRamSectionSize: 0..163840, set at post-build, default-value=81920  # Section Size(in Words) | This parameter shall represent the MCU RAM Section size.
        integer McuRamBaseAddress: 134217728..134381567, set at post-build, origin=VECTOR INFORMATIK, default-value=134217728  # RAM Base Address | RAM Base Address.
        integer McuRomBaseAddress: 0..2097151, set at post-build, origin=VECTOR INFORMATIK, default-value=0  # ROM Base Address | ROM Base Address.
        boolean McuCopyRomToRam: set at post-build, origin=VECTOR INFORMATIK, default-value=false  # Copy ROM to RAM | This parameter shall be enabled when a user wants to initialize RAM with ROM data.
      container McuResetSettingConf  # This container contains the configuration (parameters) relevant for reset.
        enumeration McuReset: {SoftwareReset}, set at pre-compile in variant pre-compile / post-build in variant post-build, origin=VECTOR INFORMATIK, default-value=SoftwareReset  # RESET | This is the reset type used by the Mcu_PerformReset() function.
    container VectorCommonData  # This container contains the Vector Informatik specific configuration (parameters).
      string BswmdVersion: set at published-information, origin=VECTOR INFORMATIK, default-value=1.04.01  # BSWMD-file Version | This parameter specifies the version of this bswmd file.
  module config Mcu_Pre: definition=Mcu, implementation-config-variant=VARIANT-POST-BUILD
  module config Mcu_Rec: definition=Mcu, implementation-config-variant=VARIANT-POST-BUILD
