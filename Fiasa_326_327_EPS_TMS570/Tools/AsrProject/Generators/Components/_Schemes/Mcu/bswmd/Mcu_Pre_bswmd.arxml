AUTOSAR XML (schema 3.1.4)
package /MICROSAR
  module config Mcu_Pre: definition=Mcu
    McuGeneralConfiguration: McuCopyTrimFromOtp=true, McuBank2Pwr=SleepMode, McuBank3Pwr=SleepMode, McuBank4Pwr=SleepMode, McuBank5Pwr=SleepMode, McuBank6Pwr=SleepMode
    McuModuleConfiguration
      McuClockSettingConfig
        McuClocks
          McuClockSrc:
            McuUseOsciClk = true
            McuUse32KhzOsciClk = false
            McuUseLpoLow = true
            McuUseLpoHigh = true
            McuUseGclk = true
            McuUseHclk = true
            McuUseVclkp = true
            McuUseVclk2 = true
            McuUseVclk3 = true
            McuUseVclka1 = true
            McuUseVclka2 = true
            McuUseVclka4 = true
            McuUseRtiClk1 = true
