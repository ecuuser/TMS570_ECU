AUTOSAR XML (schema 3.2.1)
package /MICROSAR
  bsw implementation Com_Impl: code-generator=GENy, programming-language=C, sw-major-version=3, sw-minor-version=29, sw-patch-version=0, vendor-id=30, ar-major-version=3, ar-minor-version=0, ar-patch-version=1, preconfigured-configuration=Com_Pre, recommended-configuration=Com_Rec, vendor-specific-module-def=Com
  module definition Com [0..1]: refined-module-def=Com, variants pre-compile/link-time/post-build  # Configuration of the Com module.
    container ComConfig: multiple-configuration-container=true  # This container contains the configuration parameters and sub containers of the COM module. This container is a MultipleConfigurationContainer, i.e. this container and its sub-containers exist once per configuration set.
      integer ComConfigurationId: 0.., set at link in variant link-time / pre-compile in variant pre-compile / post-build in variant post-build, default-value=0  # This ID provides the unique identifier of the post-build configurable configuration part. At runtime the configuration ID can be retrieved by Com_GetConfigurationId().
      container ComGwMapping [0..*]  # You can specify a name for each Gw Mapping. The name must be unique as it is used as short name for the ComGwMapping container.
        boolean ComGenerate [0..1]: set at pre-compile in variant pre-compile / link in variant link-time / post-build in variant post-build, origin=Vector Informatik, default-value=false  # The switch can be used to temporarily deactivate a Gw Mapping relation.
        choice container ComGwDestination [1..*]  # Each instance of this choice container allows to define one routing destination either by reference to an already configured COM signal / signal group or by a destination description container.
          container ComGwSignal [0..1]  # Select the destination signal of the Gw Mapping. If there are several signals with the same name in your databases, the unique name is used as specified by the "NameDecorator" component (i.e. the channel index is added to the signal name).
            choice reference ComGwSignalRef: set at link in variant link-time / pre-compile in variant pre-compile / post-build in variant post-build, destination=[ComGroupSignal, ComSignalGroup, ComSignal]  # Reference to an object of a gateway relation. Either to a ComSignal, ComGroupSignal or to a SignalGroup.
        choice container ComGwSource  # This choice container allows the definition of the gateway source signal either by reference to an already configured COM signal / signal group or by a source description container.
          container ComGwSignal [0..1]  # Select the source signal of the Gw Mapping. If there are several signals with the same name in your databases, the unique name is used as specified by the "NameDecorator" component (i.e. the channel index is added to the signal name).
            choice reference ComGwSignalRef: set at link in variant link-time / pre-compile in variant pre-compile / post-build in variant post-build, destination=[ComGroupSignal, ComSignalGroup, ComSignal]  # Reference to an object of a gateway relation. Either to a ComSignal, ComGroupSignal or to a SignalGroup.
      container ComIPdu [0..*]  # Contains the configuration parameters of Com I-Pdus. The shortName is used as the symbolic name (ComIpduName) of this I-Pdu when communicating with the PduR. Is optional because the Com module might be used for internal communication only. This parameter is only stored in the XML file, and must not be used within the implementation.
        function name ComIPduCallout [0..1]: set at link in variant link-time+post-build / pre-compile in variant pre-compile  # Enter a function name if you require an I-PDU callout for this I-PDU. If the field is left empty no function will be configured. For Rx I-PDUs the function is called in the context of Com_RxIndication() and for Tx I-PDUs just before the transmission is triggered by a call to PduR_ComTransmit(). The prototype is generated to Com_Cbk.h and has to be implemented by the application.
        function name ComIPduTriggerTransmitCallout [0..1]: set at link in variant link-time+post-build / pre-compile in variant pre-compile  # Enter a function name if you require a trigger transmit I-PDU callout for this I-PDU. If the field is left empty no function will be configured. The function is called in the context of Com_TriggerTransmit(). The prototype is generated to Com_Cbk.h and has to be implemented by the application.
        integer ComIPduRxHandleId [0..1]: 0..65535, set at link in variant link-time+post-build / pre-compile in variant pre-compile, symbolic-name-value=true, default-value=0  # The numerical value used as the ID of this IPdu. The ComIPduRxHandleId is required by the API calls to receive IPdus from the PDUR. It is only present for IPdu is received from the PDUR, because Com is the starting module for Tx IPdus and there is no need to define IDs for - IPdus in the Com module.
        enumeration ComIPduSignalProcessing [0..1]: {DEFERED, IMMEDIATE}, set at link in variant link-time / pre-compile in variant pre-compile / post-build in variant post-build, default-value=DEFERED  # This option determines the call context and the point of time when the signal notification function is called. - IMMEDIATE: The notification function is called within Com_TxConfirmation() or Com_RxIndication(). Depending on the lower layer interface, this might be in interrupt context. - DEFERRED: The notification function is called on task level during the next call cycle of Com_MainFunctionRx() or Com_MainFunctionTx().
        integer ComIPduSize: 0..8191, set at link in variant link-time / pre-compile in variant pre-compile / post-build in variant post-build  # Size of the IPdu in bytes. The maximum size is limited by the underlying communication interface. 0-8 for CAN and LIN 0-254 for FlexRay 0-8191 for Others
        enumeration ComIpduDirection: {RECEIVE, SEND}, set at link in variant link-time / pre-compile in variant pre-compile / post-build in variant post-build  # The direction defines if this I-PDU, and therefore the contributing signals and signal groups, shall be send or received.
        boolean ComGenerate [0..1]: set at pre-compile in variant pre-compile / link in variant link-time / post-build in variant post-build, origin=Vector Informatik, default-value=true  # Activate this feature to enable any Com API for the ComPdu and it ComSignals. Deactivate this feature to disable any Com API for the ComPdu and it ComSignals. This can be used to reduce calculation time in Com, if a PDU is routed completely in the PDUR.
        boolean ComGwRouteDlc [0..1]: set at pre-compile in variant pre-compile / link in variant link-time / post-build in variant post-build, origin=Vector Informatik, default-value=false  # If enabled, the received DLC is routed to the Tx I-PDUs with a configured routing relation. In this case, the DLC check of the corresponding bus interface (if supported) has to be deactivated to enable this functionality. If disabled, the DLC of the Tx I-PDUs is static. Note: The DLC could only be routed to Tx I-PDUs transmitted on CAN bus. RESTRICTIONS: 'ComGwRouteDlc' is only available, if 'ComGwEnableDlcRouting' is set to 'true'.
        reference ComIPduGroupRef [1..*]: set at link in variant link-time / pre-compile in variant pre-compile / post-build in variant post-build, destination=ComIPduGroup  # Select the ComIPduGroup this ComPdu should be assigned to. Clear the selection to remove the assignment.
        reference ComIPduSignalGroupRef [0..*]: set at link in variant link-time / pre-compile in variant pre-compile / post-build in variant post-build, destination=ComSignalGroup  # References to all signal groups contained in this I-Pdu
        reference ComIPduSignalRef [0..*]: set at link in variant link-time / pre-compile in variant pre-compile / post-build in variant post-build, destination=ComSignal  # References to all signals contained in this I-PDU.
        reference PduIdRef: set at pre-compile in variant pre-compile+link-time / link in variant post-build, destination=Pdu  # Reference to the "global" Pdu structure to allow harmonization of handle IDs in the COM-Stack.
        container ComTxIPdu [0..1]  # This container contains additional transmission related configuration parameters of COM I-PDUs
          enumeration ComTxIPduClearUpdateBit [0..1]: {Confirmation, Transmit, TriggerTransmit}, set at link in variant link-time / post-build in variant post-build / pre-compile in variant pre-compile  # Clear update bit context for this Tx I-Pdu. Confirmation: clear update bit in Com_TxConfirmation() context Transmit: clear update bit in PduR_ComTransmit() context TriggerTransmit: clear update bit in Com_TriggerTransmit() context Note: This attribute will be configured automatically depending on the DataProvision settings in the PduR module. For multiplexed I-PDUs this attribute has to be configured manually taking IpduMJitUpdate, IPduMTxTriggerMode and PduRDataProvision into account.
          integer ComTxIPduMinimumDelayTimeFactor [0..1]: 0.., set at link in variant link-time / pre-compile in variant pre-compile / post-build in variant post-build, default-value=0  # This attribute defines the minimum transmit delay between two subsequent messages of the same ID. A minimum delay time of '0' disables the observation. The value must be a multiple of the Com_MainFunctionTx() cycle time.
          integer ComTxIPduUnusedAreasDefault: 0..255, set at link in variant link-time+post-build / pre-compile in variant pre-compile, default-value=0  # The specified value is used to fill gaps between the IPdu signals.
          enumeration ComTxIPduTimeoutContext [0..1]: {COM_TRANSMIT, TX_CONFIRMATION}, set at link in variant link-time / pre-compile in variant pre-compile / post-build in variant post-build, origin=Vector Informatik, default-value=COM_TRANSMIT  # Transmission deadline monitoring context for this Tx I-Pdu. COM_TRANSMIT: observe the time between PduR_ComTransmit() and Com_TxConfirmation() TX_CONFIRMATION: observe the time between two consecutive calls to Com_TxConfirmation() Note: This attribute will be configured automatically depending on the bus type of the Tx I-Pdu CAN: timeout context COM_TRANSMIT LIN: timeout context TX_CONFIRMATION FlexRay: depends on the parameter 'FrIfNoneMode' of the FrTxPdu TRUE: TX_CONFIRMATION FALSE: COM_TRANSMIT RESTRICTIONS: 'ComTxIPduTimeoutContext' is only available, if 'ComTxTimeoutForTxModeNoneSupport' is set to 'true'.
          container ComTxModeFalse [0..1]  # This container contains the configuration parameters of COM transmission modes in the case the ComFilter evaluates to false.
            container ComTxMode  # This container contains the configuration parameters of COM transmission modes.
              enumeration ComTxModeMode: {DIRECT, MIXED, NONE, PERIODIC}, set at link in variant link-time / pre-compile in variant pre-compile / post-build in variant post-build, default-value=NONE  # The transmission mode determines the Tx properties of the IPdu: - DIRECT: The message is transmitted in the next Com_MainFunctionTx() call after writing to a signal. - PERIODIC: The IPdu is transmitted with the specified cycle time (ComTxModeTimePeriodFactor). - MIXED: Combines the transmission modes of CYCLIC and DIRECT. - NONE: COM does not transmit these IPdus. A transmission must be triggered by Com_PduRTriggerTransmit(). All transmission modes, except NONE, maintain the Minimum Delay Time (ComTxIPduMinimumDelayTimeFactor) and delay a transmission if required.
              integer ComTxModeNumberOfRepetitions [0..1]: 0..255, set at link in variant link-time / pre-compile in variant pre-compile / post-build in variant post-build, default-value=0  # If the transmission mode is DIRECT or MIXED this attribute specifies the number of repetitions for this IPdu. If the value is 0 the transmit request is triggered once but the confirmation is not evaluated.
              integer ComTxModeRepetitionPeriodFactor [0..1]: 0..65535, set at link in variant link-time / pre-compile in variant pre-compile / post-build in variant post-build, default-value=0  # If the transmission mode is DIRECT or MIXED this attribute specifies cycle time for the repetitions specified by ComTxModeNumberOfRepetitions.
              integer ComTxModeTimeOffsetFactor [0..1]: 0..65535, set at link in variant link-time / pre-compile in variant pre-compile / post-build in variant post-build, default-value=0  # If the transmission mode is PERIODIC or MIXED this attribute specifies the time offset of the first transmission after enabling the IPdu. The value must be a multiple of the Com_MainFunctionTx() cycle time.
              integer ComTxModeTimePeriodFactor [0..1]: 0..65535, set at link in variant link-time / pre-compile in variant pre-compile / post-build in variant post-build, default-value=0  # If the transmission mode is PERIODIC or MIXED this attribute specifies the message cycle time. If the transmission mode is NONE, the cycle time is not evaluated. The value must be a multiple of the Com_MainFunctionTx() cycle time.
          container ComTxModeTrue [0..1]  # This container contains the configuration parameters of COM transmission modes in the case the ComFilter evaluates to true.
            container ComTxMode  # This container contains the configuration parameters of COM transmission modes.
              enumeration ComTxModeMode: {DIRECT, MIXED, NONE, PERIODIC}, set at link in variant link-time / pre-compile in variant pre-compile / post-build in variant post-build, default-value=NONE  # The transmission mode determines the Tx properties of the IPdu: - DIRECT: The message is transmitted in the next Com_MainFunctionTx() call after writing to a signal. - PERIODIC: The IPdu is transmitted with the specified cycle time (ComTxModeTimePeriodFactor). - MIXED: Combines the transmission modes of CYCLIC and DIRECT. - NONE: COM does not transmit these IPdus. A transmission must be triggered by Com_PduRTriggerTransmit(). All transmission modes, except NONE, maintain the Minimum Delay Time (ComTxIPduMinimumDelayTimeFactor) and delay a transmission if required.
              integer ComTxModeNumberOfRepetitions [0..1]: 0..255, set at link in variant link-time / pre-compile in variant pre-compile / post-build in variant post-build, default-value=0  # If the transmission mode is DIRECT or MIXED this attribute specifies the number of repetitions for this IPdu. If the value is 0 the transmit request is triggered once but the confirmation is not evaluated.
              integer ComTxModeRepetitionPeriodFactor [0..1]: 0..65535, set at link in variant link-time / pre-compile in variant pre-compile / post-build in variant post-build, default-value=0  # If the transmission mode is DIRECT or MIXED this attribute specifies cycle time for the repetitions specified by ComTxModeNumberOfRepetitions.
              integer ComTxModeTimeOffsetFactor [0..1]: 0..65535, set at link in variant link-time / pre-compile in variant pre-compile / post-build in variant post-build, default-value=0  # If the transmission mode is PERIODIC or MIXED this attribute specifies the time offset of the first transmission after enabling the IPdu. The value must be a multiple of the Com_MainFunctionTx() cycle time.
              integer ComTxModeTimePeriodFactor [0..1]: 0..65535, set at link in variant link-time / pre-compile in variant pre-compile / post-build in variant post-build, default-value=0  # If the transmission mode is PERIODIC or MIXED this attribute specifies the message cycle time. If the transmission mode is NONE, the cycle time is not evaluated. The value must be a multiple of the Com_MainFunctionTx() cycle time.
      container ComIPduGroup [0..254]  # You can specify a name for each IPdu Group. The name must be unique as it is used as short name for the ComIPduGroup container.
        integer ComIPduGroupHandleId: 0..254, set at link in variant link-time+post-build / pre-compile in variant pre-compile, symbolic-name-value=true  # The numerical value used as the ID of this IPdu Group. The ComIPduGroupHandleId is required by the API calls to start and stop IPdu Groups.
        reference ComIPduGroupGroupRef [0..1]: set at link in variant link-time / pre-compile in variant pre-compile / post-build in variant post-build, destination=ComIPduGroup  # If the I-PDU Group belongs to an I-PDU group, this is the name of the I-PDU group it belongs to. This I-PDU Group does not belong to another I-PDU group, if this reference is omitted.
      container ComSignal [0..*]  # Contains the configuration parameters of Com signals. The shortName is used as the symbolic name of the signal (ComSignalName). This name is also used as the handle name for the signal. This parameter is only stored in the XML file, and must not be used within the implementation.
        integer ComBitPosition: 0..65528, set at link in variant link-time / pre-compile in variant pre-compile / post-build in variant post-build  # Specifies the start bit of the ComSignal, ComSignalGroup or ComGroupSignal. If the signal is a Motorola signal this indicates the MSB. If the byte order is a Intel signal this attribute indicates the LSB.
        integer ComBitSize: 0..65528, set at link in variant link-time+post-build / pre-compile in variant pre-compile  # Specifies the size of the ComSignal, ComSignalGroup or ComGroupSignal in bit.
        enumeration ComDataInvalidAction [0..1]: {NONE, NOTIFY, REPLACE}, set at link in variant link-time+post-build / pre-compile in variant pre-compile, default-value=NONE  # This parameter defines the action performed upon reception of an invalid signal. If Replace is used the ComSignalInitValue will be used for the replacement.
        function name ComErrorNotification [0..1]: set at link in variant link-time+post-build / pre-compile in variant pre-compile  # Enter a function name if you require a Tx error notification for this signal. If the field is left empty no function will be configured. The prototype void _Name_(void) will be generated to Rte_Cbk.h or Appl_Cbk.h and has to be implemented by the application.
        integer ComFirstTimeoutFactor [0..1]: 0..65535, set at link in variant link-time / pre-compile in variant pre-compile / post-build in variant post-build, default-value=0  # First timeout time that is used for Rx deadline monitoring. '0' for the first timeout indicates that the signal shall directly be timeout observed with the value given in ComTimeoutFactor. If Update Bits are not used, the shortest first timeout time of all signals of an IPdu is used. The value must be a multiple of the Com_MainFunctionRx() and Com_MainFunctionTx() cycle times.
        integer ComHandleId: set at link in variant link-time+post-build / pre-compile in variant pre-compile, symbolic-name-value=true  # This Parameter is not used in Il_AsrCom! The numerical value used as the ID. For signals it is required by the API calls Com_UpdateShadowSignal, Com_ReceiveShadowSignal and Com_InvalidateShadowSignal. For signals groups it is required by the Com_SendSignalGroup and Com_ReceiveSignalGroup calls.
        function name ComInvalidNotification [0..1]: set at link in variant link-time+post-build / pre-compile in variant pre-compile  # Enter a function name if you require a Rx invalid value notification for this signal. If the field is left empty no function will be configured. The prototype void _Name_(void) will be generated to Rte_Cbk.h or Appl_Cbk.h and has to be implemented by the application.
        function name ComNotification [0..1]: set at link in variant link-time+post-build / pre-compile in variant pre-compile  # Enter a function name if you require a Rx indication or Tx confirmation for this ComSignal or ComSignalGroup. If the field is left empty no function will be configured. The call context depends on the settings made in ComIPduSignalProcessing which can either be 'DEFERRED' or 'IMMEDIATE'. The prototype void _Name_(void) will be generated to Rte_Cbk.h or Appl_Cbk.h and has to be implemented by the application.
        enumeration ComRxDataTimeoutAction [0..1]: {NONE, REPLACE}, set at link in variant link-time+post-build / pre-compile in variant pre-compile, default-value=NONE  # Activate this feature to write the ComSignalInitValue to the ComSignal or ComSignalGroup (REPLACE). Deactivate this feature to disable the timeout default value for this ComSignal or ComSignalGroup (NONE).
        integer ComSignalDataInvalidValue [0..1]: set at link in variant link-time / pre-compile in variant pre-compile / post-build in variant post-build  # Specifies the invalid value of the ComSignal or ComGroupSignal. To configure negative values, enter a HEX value in the two's complement with a bit count of the ComSignalType.
        enumeration ComSignalEndianess: {BIG_ENDIAN, LITTLE_ENDIAN, OPAQUE}, set at link in variant link-time / pre-compile in variant pre-compile / post-build in variant post-build  # Specifies the byte order that is used for this ComSignal or ComGroupSignal. OPAQUE indicates that no byte order conversion is performed (e.g. for byte arrays).
        integer ComSignalInitValue [0..1]: set at link in variant link-time / pre-compile in variant pre-compile / post-build in variant post-build, default-value=0  # Specify the initial value of the ComSignal or ComGroupSignal that is used as value after Com_Init(). To configure negative values, enter a HEX value in the two's complement with a bit count of the ComSignalType. Large signals (>64 bit) are initialized with the pattern '0xFF'.
        integer ComSignalLength [0..1]: 1..8191, set at link in variant link-time / pre-compile in variant pre-compile / post-build in variant post-build, default-value=1  # Indicates the signal length in bytes. Depending on the signal size not all bits might be sent / received using external communication. If the signal type (ComSignalType) is unit8[n] the number of bytes must be equal to the number of bits indicated in the signal size (ComBitSize).
        enumeration ComSignalType: {BOOLEAN, SINT16, SINT32, SINT8, UINT16, UINT32, UINT8, UINT8_N}, set at link in variant link-time / pre-compile in variant pre-compile / post-build in variant post-build  # Specify the application data type of the signal. If UINT8[n] (byte array) is selected the signal size must have the same size as the signal specified in the ECU description or the database.
        integer ComTimeoutFactor [0..1]: 0..65535, set at link in variant link-time / pre-compile in variant pre-compile / post-build in variant post-build, default-value=0  # Timeout time that is used for reception or transmission deadline monitoring. '0' indicates that the signal shall not be timeout observed. The shortest timeout time of all signals and signal groups of an IPdu is used. Rx signals and Rx signal groups with a configured update bit are not evaluated for the I-Pdu based reception timeout time. The value must be a multiple of the Com_MainFunctionRx() and Com_MainFunctionTx() cycle times.
        boolean ComNotificationFlag [0..1]: set at link in variant link-time+post-build / pre-compile in variant pre-compile, origin=Vector Informatik  # Activate the feature to generate a macro to read and clear a indication flag for the ComSignal or ComSignalGroup. Deactivate the feature to disable the feature for this ComSignal or ComSignalGroup. Note: The flag is set in the call context of Com_RxIndication. RESTRICTIONS: 'ComNotificationFlag' is only available, if 'ComEnableIndicationFlags' is set to 'true'.
        boolean ComTimeoutNotificationFlag [0..1]: set at link in variant link-time+post-build / pre-compile in variant pre-compile, origin=Vector Informatik  # Activate the feature to generate a macro to read and clear a timeout flag for the ComSignal or ComSignalGroup. Deactivate the feature to disable the feature for this ComSignal or ComSignalGroup. RESTRICTIONS: 'ComTimeoutNotificationFlag' is only available, if 'ComEnableTimeoutFlags' is set to 'true'.
        boolean ComStateOnFlag [0..1]: set at pre-compile, origin=Vector Informatik  # Activate the feature to generate a macro to read a state on flag for the ComSignal or ComSignalGroup. Deactivate the feature to disable the feature for this ComSignal or ComSignalGroup. RESTRICTIONS: 'ComStateOnFlag' is only available, if 'ComEnableStateOnFlags' is set to 'true'.
        function name ComTimeoutNotification [0..1]: set at link in variant link-time+post-build / pre-compile in variant pre-compile  # Enter a function name if you require a timeout notification for this signal. If the field is left empty no function will be configured. The prototype void _Name_(void) will be generated to Rte_Cbk.h or Appl_Cbk.h and has to be implemented by the application.
        enumeration ComTransferProperty [0..1]: {PENDING, TRIGGERED, TRIGGERED_ON_CHANGE, TRIGGERED_ON_CHANGE_WITHOUT_REPETITION, TRIGGERED_WITHOUT_REPETITION}, set at link in variant link-time / pre-compile in variant pre-compile / post-build in variant post-build, default-value=PENDING  # The transfer behavior for the ComTxModeMode DIRECT or MIXED when writing to the signal can either be - TRIGGERED: the transmission of the message is triggered if the signal is written regardless of the signal value - TRIGGERED_WITHOUT_REPETITION: the transmission of the message is triggered just once without a repetition - TRIGGERED_ON_CHANGE: the transmission of the message is triggered if the signal is written and the signal value has changed - TRIGGERED_ON_CHANGE_WITHOUT_REPETITION: the transmission of the message is triggered just once without a repetition - PENDING: writing to the signal does not cause direct transmission. RESTRICTIONS: 'TRIGGERED_ON_CHANGE' and 'TRIGGERED_ON_CHANGE_WITHOUT_REPETITION' are only available, if 'ComTmsSupport' is set to 'true'.
        integer ComUpdateBitPosition [0..1]: 0..65528, set at link in variant link-time / pre-compile in variant pre-compile / post-build in variant post-build, default-value=0  # The update bit is located in the same IPdu. It is used to signalize that the signal was updated since the previous IPdu transmission. RESTRICTIONS: 'ComUpdateBitPosition' is only available, if 'ComEnableUpdateBitSupport' is set to 'true'.
        boolean ComIssmSignal [0..1]: set at pre-compile in variant pre-compile / link in variant link-time+post-build, origin=Vector Informatik, default-value=false  # Activate the feature to indicate, that the signal is handled by SysService_Issm and not by the application. Deactivate the feature to use the ComSignal with the application.
        integer ComMissingSourceValue [0..1]: set at link in variant link-time / pre-compile in variant pre-compile / post-build in variant post-build, origin=Vector Informatik, default-value=0  # Specify the missing source value of the ComGwSignal that is used as value after a timeout of ComGwSource. RESTRICTIONS: 'ComMissingSourceValue' is only available, if 'ComMissingSourceValueHandling' is set to 'true'.
        boolean ComInternal [0..1]: set at pre-compile in variant pre-compile / link in variant link-time / post-build in variant post-build, origin=Vector Informatik, default-value=false  # If enabled, the signal ID is assigned dynamically at post-build time. This requires the user of the signal (e.g. the application, RTE, gateway) to support the post-build concept as well. If disabled, the signal ID will be assigned statically and will not change at post-build time. This setting is typically required for signals used by the application and RTE. Enable this switch solely for signals that are used by components that support the post-build concept. E.g. signals that are handled by the gateway component only. Signals that have this feature enabled can be removed and added at post-build time without causing the signal ID of other non post-build signals to be changed. Signals that do not have this property must not be removed or added at post-build time as this can have side effects on the signal ID of other (non post-build) signal IDs.
        foreign reference SystemTemplateSystemSignalRef: set at pre-compile, destination-type=ISignalToIPduMapping  # This Parameter is not used in Il_AsrCom! Reference to the ISignalToIPduMapping that contains a reference to the ISignal (System Template) which this ComSignal (or ComGroupSignal) represents.
        container ComFilter [0..1]  # This container contains the configuration parameters of COM Filters. Note: On sender side the container is used to specify the transmission mode conditions.
          enumeration ComFilterAlgorithm: {ALWAYS, MASKED_NEW_DIFFERS_MASKED_OLD, MASKED_NEW_DIFFERS_X, MASKED_NEW_EQUALS_X, NEVER, NEW_IS_OUTSIDE, NEW_IS_WITHIN, ONE_EVERY_N}, set at link in variant link-time / pre-compile in variant pre-compile / post-build in variant post-build  # The supported filter algorithms for Tx signals are: - None: The signal has no filter (Multiplicity of ComFilter) - Always: This filter always evaluates to TRUE - Never: This filter always evaluates to FALSE - MaskedNewDiffersMaskedOld: ((new & mask) != (old & mask)) - MaskedNewEqualsX: ((new & mask) == x) - MaskedNewDiffersX: ((new & mask) != x) - NewIsOutside: ((new < min) || (max < new)) - NewIsWithin: ((min <= new) && (new <= max)) The supported filter algorithms for Rx signals are: - None: The signal has no filter (Multiplicity of ComFilter) - Always: This filter always evaluates to TRUE - MaskedNewDiffersMaskedOld: ((new & mask) != (old & mask))
          integer ComFilterMask [0..1]: set at link in variant link-time / pre-compile in variant pre-compile / post-build in variant post-build  # The specified mask is used for the filters: - MaskedNewDiffersMaskedOld: ((new & mask) != (old & mask)) - MaskedNewEqualsX: ((new & mask) == x) - MaskedNewDiffersX: ((new & mask) != x)
          integer ComFilterMax [0..1]: set at link in variant link-time / pre-compile in variant pre-compile / post-build in variant post-build  # The specified max value is used for the filters: - NewIsOutside: ((new < min) || (max < new)) - NewIsWithin: ((min <= new) && (new <= max))
          integer ComFilterMin [0..1]: set at link in variant link-time / pre-compile in variant pre-compile / post-build in variant post-build  # The specified min value is used for the filters: - NewIsOutside: ((new < min) || (max < new)) - NewIsWithin: ((min <= new) && (new <= max))
          integer ComFilterX [0..1]: set at link in variant link-time / pre-compile in variant pre-compile / post-build in variant post-build  # The specified value X is used for the filters: - MaskedNewEqualsX: ((new & mask) == x) - MaskedNewDiffersX: ((new & mask) != x)
      container ComSignalGroup [0..*]  # Contains the configuration parameters of Com signal groups. The shortName is used as the symbolic name of the signal group (ComSignalGroupName). This name is also used as the handle name for the signal group. This parameter is only stored in the XML file, and must not be used within the implementation.
        integer ComBitPosition: 0..65528, set at link in variant link-time / pre-compile in variant pre-compile / post-build in variant post-build, origin=Vector Informatik  # Specifies the start bit of the ComSignal, ComSignalGroup or ComGroupSignal. If the signal is a Motorola signal this indicates the MSB. If the byte order is a Intel signal this attribute indicates the LSB.
        integer ComBitSize: 0..65528, set at link in variant link-time / pre-compile in variant pre-compile / post-build in variant post-build, origin=Vector Informatik  # Specifies the size of the ComSignal, ComSignalGroup or ComGroupSignal in bit.
        enumeration ComDataInvalidAction [0..1]: {NONE, NOTIFY, REPLACE}, set at link in variant link-time+post-build / pre-compile in variant pre-compile, default-value=NONE  # This parameter defines the action performed upon reception of an invalid value of one of the included signals. If Replace is used the ComSignalInitValue will be used for the replacement.
        function name ComErrorNotification [0..1]: set at link in variant link-time+post-build / pre-compile in variant pre-compile  # Enter a function name if you require a Tx error notification for this signal. If the field is left empty no function will be configured. The prototype void _Name_(void) will be generated to Rte_Cbk.h or Appl_Cbk.h and has to be implemented by the application.
        integer ComFirstTimeoutFactor [0..1]: 0..65535, set at link in variant link-time / pre-compile in variant pre-compile / post-build in variant post-build, default-value=0  # First timeout time that is used for Rx deadline monitoring. '0' for the first timeout indicates that the signal shall directly be timeout observed with the value given in ComTimeoutFactor. If Update Bits are not used, the shortest first timeout time of all signals of an IPdu is used. The value must be a multiple of the Com_MainFunctionRx() and Com_MainFunctionTx() cycle times.
        integer ComHandleId: set at link in variant link-time+post-build / pre-compile in variant pre-compile, symbolic-name-value=true  # This Parameter is not used in Il_AsrCom! The numerical value used as the ID. For signals it is required by the API calls Com_UpdateShadowSignal, Com_ReceiveShadowSignal and Com_InvalidateShadowSignal. For signals groups it is required by the Com_SendSignalGroup and Com_ReceiveSignalGroup calls.
        function name ComInvalidNotification [0..1]: set at link in variant link-time+post-build / pre-compile in variant pre-compile  # Enter a function name if you require a Rx invalid value notification for this signal group. If the field is left empty no function will be configured. The prototype void _Name_(void) will be generated to Rte_Cbk.h or Appl_Cbk.h and has to be implemented by the application.
        function name ComNotification [0..1]: set at link in variant link-time+post-build / pre-compile in variant pre-compile  # Enter a function name if you require a Rx indication or Tx confirmation for this ComSignal or ComSignalGroup. If the field is left empty no function will be configured. The call context depends on the settings made in ComIPduSignalProcessing which can either be 'DEFERRED' or 'IMMEDIATE'. The prototype void _Name_(void) will be generated to Rte_Cbk.h or Appl_Cbk.h and has to be implemented by the application.
        boolean ComNotificationFlag [0..1]: set at link in variant link-time+post-build / pre-compile in variant pre-compile, origin=Vector Informatik  # Activate the feature to generate a macro to read and clear a indication flag for the ComSignal or ComSignalGroup. Deactivate the feature to disable the feature for this ComSignal or ComSignalGroup. Note: The flag is set in the call context of Com_RxIndication. RESTRICTIONS: 'ComNotificationFlag' is only available, if 'ComEnableIndicationFlags' is set to 'true'.
        boolean ComStateOnFlag [0..1]: set at pre-compile, origin=Vector Informatik  # Activate the feature to generate a macro to read a state on flag for the ComSignal or ComSignalGroup. Deactivate the feature to disable the feature for this ComSignal or ComSignalGroup. RESTRICTIONS: 'ComStateOnFlag' is only available, if 'ComEnableStateOnFlags' is set to 'true'.
        enumeration ComRxDataTimeoutAction [0..1]: {NONE, REPLACE}, set at link in variant link-time+post-build / pre-compile in variant pre-compile, default-value=NONE  # Activate the feature to write the ComSignalInitValue to the ComSignal or ComSignalGroup (REPLACE). Deactivate the feature to disable the timeout default value for this ComSignal or ComSignalGroup (NONE).
        integer ComTimeoutFactor [0..1]: 0..65535, set at link in variant link-time / pre-compile in variant pre-compile / post-build in variant post-build, default-value=0  # Timeout time that is used for reception or transmission deadline monitoring. '0' indicates that the signal shall not be timeout observed. The shortest timeout time of all signals and signal groups of an IPdu is used. Rx signals and Rx signal groups with a configured update bit are not evaluated for the I-Pdu based reception timeout time. The value must be a multiple of the Com_MainFunctionRx() and Com_MainFunctionTx() cycle times.
        function name ComTimeoutNotification [0..1]: set at link in variant link-time+post-build / pre-compile in variant pre-compile  # Enter a function name if you require a timeout notification for this signal. If the field is left empty no function will be configured. The prototype void _Name_(void) will be generated to Rte_Cbk.h or Appl_Cbk.h and has to be implemented by the application.
        boolean ComTimeoutNotificationFlag [0..1]: set at link in variant link-time+post-build / pre-compile in variant pre-compile, origin=Vector Informatik  # Activate the feature to generate a macro to read and clear a timeout flag for the ComSignal or ComSignalGroup. Deactivate the feature to disable the feature for this ComSignal or ComSignalGroup. RESTRICTIONS: 'ComTimeoutNotificationFlag' is only available, if 'ComEnableTimeoutFlags' is set to 'true'.
        enumeration ComTransferProperty [0..1]: {PENDING, TRIGGERED, TRIGGERED_ON_CHANGE, TRIGGERED_ON_CHANGE_WITHOUT_REPETITION, TRIGGERED_WITHOUT_REPETITION}, set at link in variant link-time / pre-compile in variant pre-compile / post-build in variant post-build, default-value=PENDING  # The transfer behavior for the ComTxModeMode DIRECT or MIXED when writing to the signal group can either be - TRIGGERED: the transmission of the message is triggered if at least one group signal of signal group is written regardless of the group signal value - TRIGGERED_WITHOUT_REPETITION: the transmission of the message is triggered just once without a repetition - TRIGGERED_ON_CHANGE: the transmission of the message is triggered if at least one group signal of signal group is written and the group signal value has changed - TRIGGERED_ON_CHANGE_WITHOUT_REPETITION: the transmission of the message is triggered just once without a repetition - PENDING: writing to the signal group does not cause direct transmission. Note: If at least one group signal of the signal group has a defined transfer property equal to TRIGGERED or TRIGGERED_ON_CHANGE, the transfer property of the signal group will be ignored and the trigger will be evaluated per group signal. RESTRICTIONS: 'TRIGGERED_ON_CHANGE' and 'TRIGGERED_ON_CHANGE_WITHOUT_REPETITION' are only available, if 'ComTmsSupport' is set to 'true'.
        integer ComUpdateBitPosition [0..1]: 0..65528, set at link in variant link-time / pre-compile in variant pre-compile / post-build in variant post-build, default-value=0  # The update bit is located in the same IPdu. It is used to signalize that the signal group was updated since the previous IPdu transmission. RESTRICTIONS: 'ComUpdateBitPosition' is only available, if 'ComEnableUpdateBitSupport' is set to 'true'.
        boolean ComInternal [0..1]: set at pre-compile in variant pre-compile / link in variant link-time / post-build in variant post-build, origin=Vector Informatik, default-value=false  # If enabled, the signal ID is assigned dynamically at post-build time. This requires the user of the signal (e.g. the application, RTE, gateway) to support the post-build concept as well. If disabled, the signal ID will be assigned statically and will not change at post-build time. This setting is typically required for signals used by the application and RTE. Enable this switch solely for signals that are used by components that support the post-build concept. E.g. signals that are handled by the gateway component only. Signals that have this feature enabled can be removed and added at post-build time without causing the signal ID of other non post-build signals to be changed. Signals that do not have this property must not be removed or added at post-build time as this can have side effects on the signal ID of other (non post-build) signal IDs.
        foreign reference SystemTemplateSignalGroupRef: set at pre-compile, destination-type=ISignalToIPduMapping  # Reference to the ISignalToIPduMapping that contains a reference to the ISignal (SystemTemplate) which this ComSignalGroup represents.
        container ComGroupSignal [0..*]  # This container contains the configuration parameters of group signals. I.e. signals that are included within a signal group. The shortName is used as the symbolic name of the signal (ComSignalName). This name is also used as the handle name for the signal. This parameter is only stored in the XML file, and must not be used within the implementation.
          integer ComBitPosition: 0..65528, set at link in variant link-time / pre-compile in variant pre-compile / post-build in variant post-build  # Specifies the start bit of the ComSignal, ComSignalGroup or ComGroupSignal. If the signal is a Motorola signal this indicates the MSB. If the byte order is a Intel signal this attribute indicates the LSB.
          integer ComBitSize: 0..65528, set at link in variant link-time / pre-compile in variant pre-compile / post-build in variant post-build  # Specifies the size of the ComSignal, ComSignalGroup or ComGroupSignal in bit.
          integer ComHandleId: set at link in variant link-time+post-build / pre-compile in variant pre-compile, symbolic-name-value=true  # This Parameter is not used in Il_AsrCom! The numerical value used as the ID. For signals it is required by the API calls Com_UpdateShadowSignal, Com_ReceiveShadowSignal and Com_InvalidateShadowSignal. For signals groups it is required by the Com_SendSignalGroup and Com_ReceiveSignalGroup calls.
          integer ComSignalDataInvalidValue [0..1]: set at link in variant link-time / pre-compile in variant pre-compile / post-build in variant post-build  # Specifies the invalid value of the ComSignal or ComGroupSignal. To configure negative values, enter a HEX value in the two's complement with a bit count of the ComSignalType.
          enumeration ComSignalEndianess: {BIG_ENDIAN, LITTLE_ENDIAN, OPAQUE}, set at link in variant link-time / pre-compile in variant pre-compile / post-build in variant post-build  # Specifies the byte order that is used for this ComSignal or ComGroupSignal. OPAQUE indicates that no byte order conversion is performed (e.g. for byte arrays).
          integer ComSignalInitValue [0..1]: set at link in variant link-time / pre-compile in variant pre-compile / post-build in variant post-build, default-value=0  # Specify the initial value of the ComSignal or ComGroupSignal that is used as value after Com_Init(). To configure negative values, enter a HEX value in the two's complement with a bit count of the ComSignalType. Large signals (>64 bit) are initialized with the pattern '0xFF'.
          integer ComSignalLength [0..1]: 1..8191, set at link in variant link-time / pre-compile in variant pre-compile / post-build in variant post-build, default-value=1  # Indicates the signal length in bytes. Depending on the signal size not all bits might be sent / received using external communication. If the signal type (ComSignalType) is unit8[n] the number of bytes must be equal to the number of bits indicated in the signal size (ComBitSize).
          enumeration ComSignalType: {BOOLEAN, SINT16, SINT32, SINT8, UINT16, UINT32, UINT8, UINT8_N}, set at link in variant link-time+post-build / pre-compile in variant pre-compile  # Specify the application data type of the signal. If UINT8[n] (byte array) is selected the signal size must have the same size as the signal specified in the ECU description or the database.
          integer ComMissingSourceValue [0..1]: set at link in variant link-time / pre-compile in variant pre-compile / post-build in variant post-build, origin=Vector Informatik, default-value=0  # Specify the missing source value of the ComGwSignal that is used as value after a timeout of ComGwSource. RESTRICTIONS: 'ComMissingSourceValue' is only available, if 'ComMissingSourceValueHandling' is set to 'true'.
          enumeration ComTransferProperty [0..1]: {PENDING, TRIGGERED, TRIGGERED_ON_CHANGE, TRIGGERED_ON_CHANGE_WITHOUT_REPETITION, TRIGGERED_WITHOUT_REPETITION}, set at link in variant link-time / pre-compile in variant pre-compile / post-build in variant post-build, default-value=PENDING  # The transfer behavior for the ComTxModeMode DIRECT or MIXED when writing to the group signal can either be - TRIGGERED: the transmission of the message is triggered if the group signal is written regardless of the group signal value - TRIGGERED_WITHOUT_REPETITION: the transmission of the message is triggered just once without a repetition - TRIGGERED_ON_CHANGE: the transmission of the message is triggered if the group signal is written and the group signal value has changed - TRIGGERED_ON_CHANGE_WITHOUT_REPETITION: the transmission of the message is triggered just once without a repetition - PENDING: writing to the group signal does not cause direct transmission. Note: If all the transfer properties of the group signals of a signal group equals PENDING, the transfer property of the signal group will be evaluated for the group signals. RESTRICTIONS: 'TRIGGERED_ON_CHANGE' and 'TRIGGERED_ON_CHANGE_WITHOUT_REPETITION' are only available, if 'ComTmsSupport' is set to 'true'.
          foreign reference SystemTemplateSystemSignalRef: set at pre-compile, destination-type=ISignalToIPduMapping  # This Parameter is not used in Il_AsrCom! Reference to the ISignalToIPduMapping that contains a reference to the ISignal (System Template) which this ComSignal (or ComGroupSignal) represents.
          container ComFilter [0..1]  # This container contains the configuration parameters of COM Filters. Note: On sender side the container is used to specify the transmission mode conditions.
            enumeration ComFilterAlgorithm: {ALWAYS, MASKED_NEW_DIFFERS_MASKED_OLD, MASKED_NEW_DIFFERS_X, MASKED_NEW_EQUALS_X, NEVER, NEW_IS_OUTSIDE, NEW_IS_WITHIN, ONE_EVERY_N}, set at link in variant link-time / pre-compile in variant pre-compile / post-build in variant post-build  # The supported filter algorithms for Tx signals are: - None: The signal has no filter (Multiplicity of ComFilter) - Always: This filter always evaluates to TRUE - Never: This filter always evaluates to FALSE - MaskedNewDiffersMaskedOld: ((new & mask) != (old & mask)) - MaskedNewEqualsX: ((new & mask) == x) - MaskedNewDiffersX: ((new & mask) != x) - NewIsOutside: ((new < min) || (max < new)) - NewIsWithin: ((min <= new) && (new <= max)) The supported filter algorithms for Rx signals are: - None: The signal has no filter (Multiplicity of ComFilter) - Always: This filter always evaluates to TRUE - MaskedNewDiffersMaskedOld: ((new & mask) != (old & mask))
            integer ComFilterMask [0..1]: set at link in variant link-time / pre-compile in variant pre-compile / post-build in variant post-build  # The specified mask is used for the filters: - MaskedNewDiffersMaskedOld: ((new & mask) != (old & mask)) - MaskedNewEqualsX: ((new & mask) == x) - MaskedNewDiffersX: ((new & mask) != x)
            integer ComFilterMax [0..1]: set at link in variant link-time / pre-compile in variant pre-compile / post-build in variant post-build  # The specified max value is used for the filters: - NewIsOutside: ((new < min) || (max < new)) - NewIsWithin: ((min <= new) && (new <= max))
            integer ComFilterMin [0..1]: set at link in variant link-time / pre-compile in variant pre-compile / post-build in variant post-build  # The specified min value is used for the filters: - NewIsOutside: ((new < min) || (max < new)) - NewIsWithin: ((min <= new) && (new <= max))
            integer ComFilterX [0..1]: set at link in variant link-time / pre-compile in variant pre-compile / post-build in variant post-build  # The specified value X is used for the filters: - MaskedNewEqualsX: ((new & mask) == x) - MaskedNewDiffersX: ((new & mask) != x)
    container ComGeneral  # Contains the general configuration parameters of the Com module.
      string ComConfigurationString [0..1]: set at pre-compile, origin=Vector Informatik  # This ID provides the unique identifier of the post-build configurable configuration part. At runtime the configuration ID can be retrieved by Com_GetConfigurationStringPtr(). RESTRICTIONS: 'ComConfigurationString' is only available, if 'ComGetConfigurationStringPtrApi' is set to 'true'.
      boolean ComProtectIndicationFlags [0..1]: set at pre-compile, origin=Vector Informatik  # Activate the feature to enable an interrupt protection in the generated clear macro for an indication flag for the ComSignal or ComSignalGroup. Deactivate the feature to disable the generated interrupt protection. The application has to ensure the consistency of the flag access. RESTRICTIONS: 'ComProtectIndicationFlags' is only available, if 'ComEnableIndicationFlags' is set to 'true'.
      boolean ComResetTimeoutFlags [0..1]: set at pre-compile, origin=Vector Informatik  # Activate the feature to reset the Rx timeout flag, if the ComSignal or ComSignalGroup is received again after a timeout occured. Deactivate the feature to disable the reset of the timeout flag. RESTRICTIONS: 'ComResetTimeoutFlags' is only available, if 'ComEnableTimeoutFlags' is set to 'true'.
      boolean ComProtectTimeoutFlags [0..1]: set at pre-compile, origin=Vector Informatik  # Activate the feature to enable an interrupt protection in the generated clear macro for an Rx timeout flag for the ComSignal or ComSignalGroup. Deactivate the feature to disable the generated interrupt protection. The application has to ensure the consistency of the flag access. RESTRICTIONS: 'ComProtectTimeoutFlags' is only available, if 'ComEnableTimeoutFlags' is set to 'true'.
      boolean ComEnableRx [0..1]: set at pre-compile, origin=Vector Informatik  # With this option reception of all signals can be disabled.
      boolean ComEnableTx [0..1]: set at pre-compile, origin=Vector Informatik  # With this option transmission of all signals can be disabled.
      boolean ComMissingSourceValueHandling [0..1]: set at pre-compile, origin=Vector Informatik  # This attribute is set automatically -BeforeGeneration- depending on attribute existence in the database. If enabled, the database attribute GenSigMissingSource value is used as Tx signal value in case of a Rx signal timeout. This value is set automatically at generation time if at least one database provides this attribute.
      boolean ComEnableSignalInterface [0..1]: set at pre-compile, origin=Vector Informatik  # Activate the feature to enable the signal API. Deactivate the feature to disable the feature (e.g. if all signals are grouped Com_ReceiveSignal and Com_TransmitSignal are not used).
      boolean ComGwTriggerTxOnInvalidation [0..1]: set at pre-compile, origin=Vector Informatik  # Feature triggers the routed Tx Signals in case of an invalidation caused by a Rx timeout.
      boolean ComGwInvalidateTxOnRxTimeout [0..1]: set at pre-compile, origin=Vector Informatik  # Feature invalidates the routed Tx Signals if a Rx timeout occurs.
      boolean ComQueueFailedTransmitRequests [0..1]: set at pre-compile, origin=Vector Informatik  # If the feature is activated, the COM repeats transmission requests of a Tx I-Pdu to the underlying layer if E_NOT_OK is returned. If the feature is deactivated, the COM will ignore all errors from the underlying communication layer as recommended by AUTOSAR.
      boolean ComGwCanMost [0..1]: set at pre-compile, origin=Vector Informatik  # Activate this feature to enable the CAN MOST Gateway extension.
      boolean ComGwStopTxOnRxTimeout [0..1]: set at pre-compile, origin=Vector Informatik  # Feature stops transmission of Tx PDUs if the Tx PDU has a single Rx PDU only that timed out.
      boolean ComLargeComIPdus [0..1]: set at pre-compile, origin=Vector Informatik  # Activate the feature to enable support for ComIPdus with ComIPduSize greater than 31 bytes. Deactivate the feature if only ComIPdus with ComIPduSize less than 31 bytes are used.
      boolean ComGw03ConsistencyCheck [0..1]: set at pre-compile, origin=Vector Informatik  # Deactivate the feature to skip the check Gw03.
      boolean ComGetConfigurationStringPtrApi [0..1]: set at pre-compile, origin=Vector Informatik  # Activate the feature to enable the API Com_GetConfigurationStringPtr(). Deactivate the feature to disable the feature.
      boolean ComMainFunctionTxApi [0..1]: set at pre-compile, origin=Vector Informatik  # Activate the feature to enable the API Com_MainFunctionTx(). Deactivate the feature to disable the feature.
      boolean ComMainFunctionRxApi [0..1]: set at pre-compile, origin=Vector Informatik  # Activate the feature to enable the API Com_MainFunctionRx(). Deactivate the feature to disable the feature.
      boolean ComShowError0005AsWarning [0..1]: set at pre-compile, origin=Vector Informatik  # Activate the feature to generate the Error message 0005 as a Warning.
      boolean ComVStdLibMemApi [0..1]: set at pre-compile, origin=Vector Informatik  # Activate the feature to use the VSdtLib to set, clear and copy data elements in Com. Deactivate the feature to disable the feature. Note: The feature can be disabled for the Mcs12x if the post build data is located e.g. in the GPAGE.
      boolean ComTriggerTransmissionByCom [0..1]: set at pre-compile, origin=Vector Informatik  # If Com is not required to trigger the transmission of IPdus you can disable this functionality to save resources. This could be for example a Lin or FlexRay only system where transmission is triggered by the lower layer via Com_TriggerTransmit().
      boolean ComOptimizeIdTypes [0..1]: set at pre-compile, origin=Vector Informatik  # Activate the feature to enable ID type optimization (e.g. use uint8 as Com_SignalIdType if sufficient) Deactivate the feature to disable the ID type optimization.
      boolean ComRxSignalWriteAccess [0..1]: set at pre-compile, origin=Vector Informatik  # This feature is required by some RTE configurations. The feature is not specified by AUTOSAR.
      boolean ComTsiTestCode [0..1]: set at pre-compile, origin=Vector Informatik  # Activate the feature to enable test code for the integration of Com. Deactivate the feature to disable the feature.
      boolean ComIPduGroupTransmit [0..1]: set at pre-compile, origin=Vector Informatik  # Activate the feature to enable the API Com_IpduGroupTransmit(). Deactivate the feature to disable the feature.
      boolean ComEnableLoTxConfirmation [0..1]: set at pre-compile, origin=Vector Informatik  # Activate the feature to restart timeout counters based upon the call of Com_TxConfirmation(). Deactivate the feature to restart timeout counters after the call of PduR_ComTransmit(). This feature is necessary if confirmation functions are not supported by the PDUR.
      boolean ComTmsSupport [0..1]: set at pre-compile, origin=Vector Informatik  # Activate the feature to enable the use of ComTxModeFalse. Deactivate the feature to disable the use of ComTxModeFalse and activate only the use of ComTxModeTrue. Due to the deactivation of ComTxModeFalse change of the ComFilterAlgorithm is limited to ALWAYS and MASKED_NEW_DIFFERS_MASKED_OLD (GenSigSendType Cyclic, OnWrite and OnChange are possible).
      boolean ComLargeSignalSupport [0..1]: set at pre-compile, origin=Vector Informatik  # Activate the feature to enable ComSignals with ComBitSize larger than 254 bits. Deactivate the feature if only ComSignals with ComBitSize smaller than 255 bits are used.
      boolean ComTransportProtocolSupport [0..1]: set at pre-compile, origin=Vector Informatik  # Activate the feature to enable the API to transmit IPdus larger than 8 bytes on CAN via CAN TP. Deactivate the feature to disable the feature.
      boolean ComEnableTimeoutFlags [0..1]: set at pre-compile, origin=Vector Informatik  # Activate the feature to enable the Rx timeout flag feature. Deactivate the feature to disable the feature
      boolean ComEnableIndicationFlagOnRxTimeout [0..1]: set at pre-compile, origin=Vector Informatik  # Activate the feature to set the indication flag if the signal value is substituted by the initial value in case of a reception timeout. Deactivate the feature to disable the functionality. RESTRICTIONS: 'ComEnableIndicationFlagOnRxTimeout' is only available, if 'ComConfigurationVariant' is set to 'Variant 1 (Pre-compile Configuration)'.
      boolean ComEnableIndicationFlags [0..1]: set at pre-compile, origin=Vector Informatik  # Activate the feature to enable the indication flag feature. Deactivate the feature to disable the feature.
      boolean ComEnableStateOnFlags [0..1]: set at pre-compile, origin=Vector Informatik  # Activate the feature to enable the state on flag macro interface. Deactivate the feature to disable the state on flag macro interface.
      boolean ComSignalConversionInterface [0..1]: set at pre-compile, origin=Vector Informatik  # Activate the feature to enable the signal conversion API. Deactivate the feature to disable the feature.
      boolean ComIsLibrary [0..1]: set at pre-compile, origin=Vector Informatik  # Activate the feature to indicate, that Com is delivered as a library. Deactivate the feature to indicate, that Com is delivered as source code.
      boolean ComEnableUpdateBitSupport [0..1]: set at pre-compile, origin=Vector Informatik  # Activate the feature to enable the update bit handling. If a database is loaded and a ComSignal is found with the postfix or infix '_UB' and another signal in the same ComPdu is found with the same <SignalName>, the signal API is deactivated for the ComSignal and the signal is configured as update bit. Deactivate the feature to disable the update bit handling. Note: Update bits can be configured for ComSignals and ComSignalGroups.
      boolean ComEnableSignalGroupInterface [0..1]: set at pre-compile, origin=Vector Informatik  # Activate the feature to enable the signal group API. Deactivate the feature to disable the feature.
      float ComConfigurationTimeBase: set at link in variant link-time / pre-compile in variant pre-compile / post-build in variant post-build  # The period between successive calls to the Main Functions (Rx, Tx, Routing) of AUTOSAR COM in seconds.
      float ComConfigurationTimeBaseUpdate [0..1]: set at pre-compile, origin=Vector Informatik  # This Parameter exists, if EcuCGenTool_CsAsrDbUpdate has performed an update and editable Parameters are calculated upon this value.
      float ComConfigurationRxTimeBase [0..1]: set at link in variant link-time / pre-compile in variant pre-compile / post-build in variant post-build, origin=Vector Informatik  # Configure the cycle time in which Com_MainFunctionRx() has to be called.
      float ComConfigurationTxTimeBase [0..1]: set at link in variant link-time / pre-compile in variant pre-compile / post-build in variant post-build, origin=Vector Informatik  # Configure the cycle time in which Com_MainFunctionTx() has to be called.
      boolean ComConfigurationUseDet [0..1]: set at pre-compile, default-value=false  # If 'Development Error Detection' is enabled, all development errors are reported to the Development Error Tracer (DET). The errors are described in the [TechnicalReference_Asr_Com.pdf]. Note: In general, the development error detection is recommended during pre-test phase. It is not recommended to enable the development error detection in production code due to increased runtime and ROM needs.
      boolean ComVersionInfoApi: set at pre-compile  # Activate this feature to enable the function Com_GetVersionInfo() to get major, minor and patch version information.
      boolean ComConfigurationUseDem [0..1]: set at pre-compile, origin=Vector Informatik, default-value=true  # If 'Production Error Detection' is enabled, production relevant errors are reported to the Diagnostics Event Manager (DEM). Disable this option, if no DEM is present in your system.
      boolean ComUseRte [0..1]: set at pre-compile, origin=Vector Informatik, default-value=false  # Enable this option if the ECU uses an RTE. If this option is disabled, callback prototypes are generated into the file Appl_Cbk.h.
      boolean ComSignalAccessMacroApi [0..1]: set at pre-compile, origin=Vector Informatik, default-value=false  # Activate the feature to enable the signal access macro API. Deactivate the feature to disable the signal access macro API.
      boolean ComTriggerTransmitApi [0..1]: set at pre-compile, origin=Vector Informatik, default-value=true  # Activate the feature to enable the API Com_TriggerTransmit(). Deactivate the feature to disable the API Com_TriggerTransmit(). Note: This API is needed if the COM is used with LIN, Flexray or MOST. RESTRICTIONS: 'ComTriggerTransmitApi' is only available, if 'ComConfigurationVariant' is not set to 'Variant 1 (Pre-compile Configuration)'.
      boolean ComTriggerIPDUSendApi [0..1]: set at pre-compile, origin=Vector Informatik, default-value=true  # Activate the feature to enable the API Com_TriggerIPDUSend(). Deactivate the feature to disable the API Com_TriggerIPDUSend().
      boolean ComGetConfigurationIdApi [0..1]: set at pre-compile, origin=Vector Informatik, default-value=true  # Activate the feature to enable the API Com_GetConfigurationId(). Deactivate the feature to disable the API Com_GetConfigurationId().
      boolean ComGetStatusApi [0..1]: set at pre-compile, origin=Vector Informatik, default-value=true  # Activate the feature to enable the API Com_GetStatus(). Deactivate the feature to disable the API Com_GetStatus().
      boolean ComReceptionDMApi [0..1]: set at pre-compile, origin=Vector Informatik, default-value=true  # Activate the feature to enable the API Com_EnableReceptionDM() and Com_DisableReceptionDM(). Deactivate the feature to disable the API Com_EnableReceptionDM() and Com_DisableReceptionDM().
      boolean ComDeInitApi [0..1]: set at pre-compile, origin=Vector Informatik, default-value=true  # Activate the feature to enable the API Com_DeInit(). Deactivate the feature to disable the API Com_DeInit().
      boolean ComSignalInvalidationApi [0..1]: set at pre-compile, origin=Vector Informatik, default-value=true  # Activate the feature to enable the API Com_InvalidateSignal() and Com_InvalidateSignalGroup() and the handling of invalid values for Rx signals if configured. Deactivate the feature to disable the feature.
      string ComUserConfigFile [0..1]: set at pre-compile, origin=Vector Informatik  # A configuration file is generated by GENy. If you want to overwrite settings in the generated configuration file, you can specify a path to a user defined configuration file. The user defined configuration file will be included at the end of the generated file. Therefore definitions in the user defined configuration file can overwrite definitions in the generated configuration file. The content of the user defined configuration file is copied to the end of Com_Cfg.h.
      integer ComPBStartAddress: 0.., set at pre-compile in variant pre-compile / link in variant link-time+post-build, origin=Vector Informatik, default-value=0  # This setting is mandatory when generating a configuration that will be written to the memory of your ECU at post-build time (i.e. when generating a hex-file). This setting is not relevant when generating the initial ECU configuration at link- or pre-compile time (i.e. when generating a C-file that will be linked with your project). The Module Start Address must specify the start address of the memory area, where the generated hex-file will be mapped to. If the ECU supports selectable post-build configuration, the Module Start Address can be any location that is accessible for the BSW module. If selectable post-build configuration is not supported by your ECU, the Module Start Address must be the same address to which the initial configuration was mapped. Please see into your linker map file to get this address. RESTRICTIONS: 'ComPBStartAddress' is only available, if 'ComConfigurationVariant' is set to 'Variant 3 (Post-build Configuration)'.
      integer ComMaxNumberOfRxIPdus: 1..65535, set at link, origin=Vector Informatik, default-value=1  # The number of IPdus in an AUTOSAR system can be changed at post-build time (Variant 3). To allow increasing the number of handled IPdus at post-build time memory must be reserved. Configure the maximum number of Rx IPdus, which shall be able to handle at any time. The minimum number is the currently configured number of Rx IPdus. RESTRICTIONS: 'ComMaxNumberOfRxIPdus' is only available, if 'ComConfigurationVariant' is set to 'Variant 3 (Post-build Configuration)'.
      integer ComMaxNumberOfTxIPdus: 1..65535, set at link, origin=Vector Informatik, default-value=1  # The number of IPdus in an AUTOSAR system can be changed at post-build time (Variant 3). To allow increasing the number of handled IPdus at post-build time memory must be reserved. Configure the maximum number of Tx IPdus, which shall be able to handle at any time. The minimum number is the currently configured number of Tx IPdus. RESTRICTIONS: 'ComMaxNumberOfTxIPdus' is only available, if 'ComConfigurationVariant' is set to 'Variant 3 (Post-build Configuration)'.
      integer ComMaxNumberOfRxUpdateBits: 1..65535, set at link, origin=Vector Informatik, default-value=1  # The number of Rx update bits in an AUTOSAR system can be changed at post-build time (Variant 3). To allow increasing the number of handled Rx update bits at post-build time memory must be reserved. Configure the maximum number of Rx update bits, which shall be able to handle at any time. The minimum number is the currently configured number of Rx update bits. RESTRICTIONS: 'ComMaxNumberOfRxUpdateBits' is only available, if 'ComEnableUpdateBitSupport' is set to 'true' and 'ComConfigurationVariant' is 'Variant 3 (Post-build Configuration)'
      integer ComBufferSize: 0.., set at link, origin=Vector Informatik, default-value=0  # The number of ComPdus in an AUTOSAR system can be changed at post-build time (Variant 3). To allow increasing the number of handled ComPdus at post-build time memory must be reserved at link time. The size of the buffer depends on the current COM configuration and on the scalability the shall be available at post-build time. RESTRICTIONS: 'ComBufferSize' is only available, if 'ComConfigurationVariant' is set to 'Variant 3 (Post-build Configuration)'.
      boolean ComGwSuspendIsrPerPdu [0..1]: set at pre-compile, origin=Vector Informatik, default-value=false  # If this feature is activated, only one ISR suspension is used per routed Rx I-Pdu. Otherwise every single signal access is protected by an own ISR suspension.
      integer ComMaxRxIPduLength [0..1]: 1..65535, set at pre-compile, origin=Vector Informatik, default-value=8  # Configure the maximum length of Rx IPdus in bytes, which shall be able to handle at any time. The minimum length is the currently configured maximum length of Rx IPdus. RESTRICTIONS: 'ComMaxRxIPduLength' is not available, if 'ComConfigurationVariant' is set to 'Variant 1 (Pre-compile Configuration)'.
      boolean ComEnableReceptionFiltering [0..1]: set at pre-compile, origin=Vector Informatik, default-value=true  # Activate the feature to enable the signal reception filtering. Deactivate the feature to disable the signal reception filtering.
      integer ComMaxNumberOfTxSignalGroups: 1..65535, set at link, origin=Vector Informatik, default-value=1  # The number of Tx signal groups in an AUTOSAR system can be changed at post-build time (Variant 3). To allow increasing the number of handled Tx signal groups at post-build time memory must be reserved. Configure the maximum number of Tx signal groups, which shall be able to handle at any time. The minimum number is the currently configured number of Tx signal groups. RESTRICTIONS: 'ComMaxNumberOfTxSignalGroups' is only available, if 'ComEnableSignalGroupInterface' is set to 'true' and 'ComConfigurationVariant' is 'Variant 3 (Post-build Configuration)'
      boolean ComTxTimeoutForTxModeNoneSupport [0..1]: set at pre-compile, origin=Vector Informatik, default-value=false  # If this feature is activated the timeout context of a Tx I-Pdu is configurable by the attribute 'ComTxIPduTimeoutContext' to support transmission deadline monitoring for the transmission mode NONE. This could be used for Tx I-Pdus which are triggered by a bus schedule table (e.g. LIN).
      boolean ComMultipleIPduGroupRefSupport [0..1]: set at pre-compile, origin=Vector Informatik, default-value=false  # If this feature is activated one I-Pdu could be contained in more than one I-Pdu group.
      boolean ComDynamicDlcSupport [0..1]: set at pre-compile, origin=Vector Informatik, default-value=false  # If this feature is activated, the received data length (PduInfoPtr->SduLength) is checked by the function Com_RxIndication, and only completely received signals and signal groups are processed.
      boolean ComGwRxDlMonBasedCyclicRouting [0..1]: set at pre-compile, origin=Vector Informatik, default-value=false  # This feature stops the cyclic transmission of a TxPdu, if no routed Rx Signal was received in the defined timeout time. The timeout is equal to the biggest Timeout Factor of all routed Rx Signals and is automatically calculated before generation. If a timeout is configured (timeout > 0) the cyclic TxPdu transmission starts after the reception of a routed signal.
      boolean ComGwImmediateRouting [0..1]: set at pre-compile, origin=Vector Informatik, default-value=false  # Activate this feature to enable immediate signal routing in the context of Com_RxIndication(). If the signal routing is performed immediate in the context of Com_RxIndication() or deferred by the Com_MainFunctionRouteSignals() depends on ComIPduSignalProcessing of the corresponding Rx I-PDU. Note: Com_MainfunctionTx() is still required for signal routing. Deactivate this feature for AUTOSAR compliance.
      boolean ComGwEnableDlcRouting [0..1]: set at pre-compile, origin=Vector Informatik, default-value=false  # Activate this feature to route the DLC of a received Rx I-PDU to the Tx I-PDUs with a configured routing relation. If the DLC is routed is configurable per Rx I-PDU. Note: The DLC could only be routed to Tx I-PDUs transmitted on CAN bus.
      string ComNotiFctRxPrefix [0..1]: set at pre-compile, origin=Vector Informatik  # This prefix is used for the calculated 'Indication Function' name of a Rx signal or signal group, if the button for the value calculation is used.
      string ComNotiFctTxPrefix [0..1]: set at pre-compile, origin=Vector Informatik  # This prefix is used for the calculated 'Confirmation Function' name of a Tx signal or signal group, if the button for the value calculation is used.
      string ComTimeoutNotiFctRxPrefix [0..1]: set at pre-compile, origin=Vector Informatik  # This prefix is used for the calculated 'Timeout Function' name of a Rx signal or signal group, if the button for the value calculation is used.
      string ComInvalidNotiFctRxPrefix [0..1]: set at pre-compile, origin=Vector Informatik  # This prefix is used for the calculated 'Invalid Function' name of a Rx signal or signal group, if the button for the value calculation is used.
      string ComErrorNotiFctTxPrefix [0..1]: set at pre-compile, origin=Vector Informatik  # This prefix is used for the calculated 'Error Function' name of a Tx signal or signal group, if the button for the value calculation is used.
      string ComIpduCalloutFctPrefix [0..1]: set at pre-compile, origin=Vector Informatik  # This prefix is used for the calculated I-PDU callout name if the button for the value calculation is used.
      string ComIndicationFlagPostfix [0..1]: set at pre-compile, origin=Vector Informatik  # This postfix is used to calculate the name of the indication flag provider macro. The macro name is made up as follows: 'Com_Get' / 'Com_Clr' + 'RxSig' / 'RxSigGrp' + <ComIndicationFlagPostfix> RESTRICTIONS: 'ComIndicationFlagPostfix' is only available, if 'Il_AsrCom.ComEnableIndicationFlags' is set to 'true'.
      string ComTimeoutFlagPostfix [0..1]: set at pre-compile, origin=Vector Informatik  # This postfix is used to calculate the name of the Rx timeout flag provider macro. The macro name is made up as follows: 'Com_Get' / 'Com_Clr' + 'RxSig' / 'RxSigGrp' + <ComTimeoutFlagPostfix> RESTRICTIONS: 'ComTimeoutFlagPostfix' is only available, if 'Il_AsrCom.ComEnableTimeoutFlags' is set to 'true'.
      string ComStateOnFlagPostfix [0..1]: set at pre-compile, origin=Vector Informatik  # This postfix is used to calculate the name of the state on flag provider macro. The macro name is made up as follows: 'Com_Get' + 'RxSig' / 'RxSigGrp' + <ComStateOnFlagPostfix> RESTRICTIONS: 'ComStateOnFlagPostfix' is only available, if 'Il_AsrCom.ComEnableStateOnFlags' is set to 'true'.
      string ComTimeoutNotiFctTxPrefix [0..1]: set at pre-compile, origin=Vector Informatik  # This prefix is used for the calculated 'Timeout Function' name of a Tx signal or signal group, if the button for the value calculation is used.
      boolean ComAmdRuntimeMeasurement [0..1]: set at pre-compile, origin=Vector Informatik, default-value=false  # This parameter defines if AMD Runtime Measurement (RTM) is enabled for this module.
    container VectorCommonData
      string BswmdVersion: set at published-information, origin=Vector Informatik, default-value=3.22.01  # Version of the BSWMD file that has been used to set up the ECU configuration
  module config Com_Pre: definition=Com
  module config Com_Rec: definition=Com
