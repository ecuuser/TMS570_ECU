AUTOSAR XML (schema 3.0.1)
package /MICROSAR
  module config SchM_Rec: definition=SchM, implementation-config-variant=VARIANT-PRE-COMPILE  # Configuration of the SchM (BSW Scheduler) module.
    Dcm (SchMModuleConfiguration): SchMModuleLiteral=Dcm, SchMModuleInclude=Dcm.h, SchMModuleConfigVersion=1.0.0, SchMModuleImplementationRef=Dcm_Impl
      SCHM_DCM_INSTANCE_0 (InstanceConfiguration): SchMInstanceLiteral=SCHM_DCM_INSTANCE_0
        DCM_EXCLUSIVE_AREA_0 (ExclusiveAreaConf): SchMExclusiveAreaLiteral=DCM_EXCLUSIVE_AREA_0, SchMExclusiveAreaDescription=(unset)
    3 x SchMMainFunctionMapping, all with SchMModuleRef=Dcm:
      Dcm_MainFunction: SchMMainFunctionSymbol=Dcm_MainFunction
        SchMBswEvent
          SchMBswDerivedTimingEvent: SchMMainFunctionPeriodParamScale=1.0, SchMMainFunctionPeriodParamRef=/MICROSAR/Dcm/DcmGeneral/DcmTaskTime
      Dcm_TimerTask: SchMMainFunctionSymbol=Dcm_TimerTask
        SchMBswEvent
          SchMBswDerivedTimingEvent: SchMMainFunctionPeriodParamScale=1.0, SchMMainFunctionPeriodParamRef=/MICROSAR/Dcm/DcmGeneral/DcmTaskTime
      Dcm_StateTask: SchMMainFunctionSymbol=Dcm_StateTask
        SchMBswEvent
          SchMBswTimingEvent: SchMMainFunctionPeriod=0.01
