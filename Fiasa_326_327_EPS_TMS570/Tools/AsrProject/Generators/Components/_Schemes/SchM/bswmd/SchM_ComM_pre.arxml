AUTOSAR XML (schema 3.0.1)
package /MICROSAR
  module config SchM_Rec: definition=SchM, implementation-config-variant=VARIANT-PRE-COMPILE  # Configuration of the SchM (BSW Scheduler) module.
    ComM (SchMModuleConfiguration): SchMModuleLiteral=ComM, SchMModuleInclude=ComM.h, SchMModuleConfigVersion=1.0.0, SchMModuleImplementationRef=ComM_Impl
      SCHM_COMM_INSTANCE_0 (InstanceConfiguration): SchMInstanceLiteral=SCHM_COMM_INSTANCE_0
        COMM_EXCLUSIVE_AREA_0 (ExclusiveAreaConf):
          SchMExclusiveAreaLiteral = COMM_EXCLUSIVE_AREA_0
          SchMExclusiveAreaDescription = The exclusive are must lock task interrupts and interrupts sources.
        COMM_EXCLUSIVE_AREA_1 (ExclusiveAreaConf):
          SchMExclusiveAreaLiteral = COMM_EXCLUSIVE_AREA_1
          SchMExclusiveAreaDescription = The exclusive are must lock task interrupts refer to TechnicalReference_Asr_ComM for details
    11 x SchMMainFunctionMapping, all with SchMModuleRef=ComM:
      ComM_MainFunction_0: SchMMainFunctionSymbol=ComM_MainFunction_0
        SchMBswEvent
          SchMBswTimingEvent: SchMMainFunctionPeriod=0.01
      ComM_MainFunction_1: SchMMainFunctionSymbol=ComM_MainFunction_1
        SchMBswEvent
          SchMBswTimingEvent: SchMMainFunctionPeriod=0.01
      ComM_MainFunction_2: SchMMainFunctionSymbol=ComM_MainFunction_2
        SchMBswEvent
          SchMBswTimingEvent: SchMMainFunctionPeriod=0.01
      ComM_MainFunction_3: SchMMainFunctionSymbol=ComM_MainFunction_3
        SchMBswEvent
          SchMBswTimingEvent: SchMMainFunctionPeriod=0.01
      ComM_MainFunction_4: SchMMainFunctionSymbol=ComM_MainFunction_4
        SchMBswEvent
          SchMBswTimingEvent: SchMMainFunctionPeriod=0.01
      ComM_MainFunction_5: SchMMainFunctionSymbol=ComM_MainFunction_5
        SchMBswEvent
          SchMBswTimingEvent: SchMMainFunctionPeriod=0.01
      ComM_MainFunction_6: SchMMainFunctionSymbol=ComM_MainFunction_6
        SchMBswEvent
          SchMBswTimingEvent: SchMMainFunctionPeriod=0.01
      ComM_MainFunction_7: SchMMainFunctionSymbol=ComM_MainFunction_7
        SchMBswEvent
          SchMBswTimingEvent: SchMMainFunctionPeriod=0.01
      ComM_MainFunction_8: SchMMainFunctionSymbol=ComM_MainFunction_8
        SchMBswEvent
          SchMBswTimingEvent: SchMMainFunctionPeriod=0.01
      ComM_MainFunction_9: SchMMainFunctionSymbol=ComM_MainFunction_9
        SchMBswEvent
          SchMBswTimingEvent: SchMMainFunctionPeriod=0.01
      ComM_MainFunction_10: SchMMainFunctionSymbol=ComM_MainFunction_10
        SchMBswEvent
          SchMBswTimingEvent: SchMMainFunctionPeriod=0.01
