AUTOSAR XML (schema 3.0.1)
package /MICROSAR
  module config SchM_Rec: definition=SchM, implementation-config-variant=VARIANT-PRE-COMPILE  # Configuration of the SchM (BSW Scheduler) module.
    Com (SchMModuleConfiguration): SchMModuleLiteral=Com, SchMModuleInclude=Com.h, SchMModuleConfigVersion=1.0.0, SchMModuleImplementationRef=Com_Impl
      SCHM_COM_INSTANCE_0 (InstanceConfiguration): SchMInstanceLiteral=SCHM_COM_INSTANCE_0
        5 x ExclusiveAreaConf:
          COM_EXCLUSIVE_AREA_0: SchMExclusiveAreaLiteral=COM_EXCLUSIVE_AREA_0, SchMExclusiveAreaDescription=
          COM_EXCLUSIVE_AREA_1: SchMExclusiveAreaLiteral=COM_EXCLUSIVE_AREA_1, SchMExclusiveAreaDescription=Set SchMExclusiveAreaImplementation to NONE to lock for every Tx PDU individually, set to AUTO to lock for all Tx PDUs at once, also adjust COM_EXCLUSIVE_AREA_2, SchMExclusiveAreaImplementation=NONE
          COM_EXCLUSIVE_AREA_2: SchMExclusiveAreaLiteral=COM_EXCLUSIVE_AREA_2, SchMExclusiveAreaDescription=Set SchMExclusiveAreaImplementation to AUTO to lock for every Tx PDU individually, set to NONE to lock for all Tx PDUs at once, also adjust COM_EXCLUSIVE_AREA_1
          COM_EXCLUSIVE_AREA_3: SchMExclusiveAreaLiteral=COM_EXCLUSIVE_AREA_3, SchMExclusiveAreaDescription=Set SchMExclusiveAreaImplementation to NONE to lock for every Rx PDU individually, set to AUTO to lock for all Rx PDUs at once, also adjust COM_EXCLUSIVE_AREA_4, SchMExclusiveAreaImplementation=NONE
          COM_EXCLUSIVE_AREA_4: SchMExclusiveAreaLiteral=COM_EXCLUSIVE_AREA_4, SchMExclusiveAreaDescription=Set SchMExclusiveAreaImplementation to AUTO to lock for every Rx PDU individually, set to NONE to lock for all Rx PDUs at once, also adjust COM_EXCLUSIVE_AREA_3
    3 x SchMMainFunctionMapping, all with SchMModuleRef=Com:
      Com_MainFunctionRouteSignals: SchMMainFunctionSymbol=Com_MainFunctionRouteSignals
        SchMBswEvent
          SchMBswTimingEvent: SchMMainFunctionPeriod=0.005
      Com_MainFunctionRx: SchMMainFunctionSymbol=Com_MainFunctionRx
        SchMBswEvent
          SchMBswDerivedTimingEvent: SchMMainFunctionPeriodParamScale=1.0, SchMMainFunctionPeriodParamRef=/MICROSAR/Com/ComGeneral/ComConfigurationRxTimeBase
      Com_MainFunctionTx: SchMMainFunctionSymbol=Com_MainFunctionTx
        SchMBswEvent
          SchMBswDerivedTimingEvent: SchMMainFunctionPeriodParamScale=1.0, SchMMainFunctionPeriodParamRef=/MICROSAR/Com/ComGeneral/ComConfigurationTxTimeBase
