AUTOSAR XML (schema 3.0.1)
package /MICROSAR
  module config SchM_Rec: definition=SchM, implementation-config-variant=VARIANT-PRE-COMPILE  # Configuration of the SchM (BSW Scheduler) module.
    BswM (SchMModuleConfiguration): SchMModuleLiteral=BswM, SchMModuleInclude=BswM.h, SchMModuleConfigVersion=1.0.0, SchMModuleImplementationRef=BswM_Impl
      SCHM_BSWM_INSTANCE_0 (InstanceConfiguration): SchMInstanceLiteral=SCHM_BSWM_INSTANCE_0
        BSWM_EXCLUSIVE_AREA_0 (ExclusiveAreaConf): SchMExclusiveAreaLiteral=BSWM_EXCLUSIVE_AREA_0, SchMExclusiveAreaDescription=(unset)
    BswM_MainFunction (SchMMainFunctionMapping): SchMMainFunctionSymbol=BswM_MainFunction, SchMModuleRef=BswM
      SchMBswEvent
        SchMBswDerivedTimingEvent: SchMMainFunctionPeriodParamScale=1.0, SchMMainFunctionPeriodParamRef=/MICROSAR/BswM/BswMGeneral/BswMMainFunctionPeriod
