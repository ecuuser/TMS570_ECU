AUTOSAR XML (schema 3.0.1)
# COPYRIGHT
# Copyright (c) 2011-2012 by Vector Informatik GmbH. All rights reserved.
# This software is copyright protected and proprietary to Vector Informatik GmbH.
# Vector Informatik GmbH grants to you only those rights as set out in the license conditions.
package /MICROSAR
  module config SchM_Rec: definition=SchM, implementation-config-variant=VARIANT-PRE-COMPILE  # Configuration of the SchM (BSW Scheduler) module.
    CanNm (SchMModuleConfiguration): SchMModuleLiteral=CanNm, SchMModuleInclude=CanNm.h, SchMModuleConfigVersion=1.0.0, SchMModuleImplementationRef=CanNm_Impl
      SCHM_CANNM_INSTANCE_0 (InstanceConfiguration): SchMInstanceLiteral=SCHM_CANNM_INSTANCE_0
        6 x ExclusiveAreaConf:
          CANNM_EXCLUSIVE_AREA_0: SchMExclusiveAreaLiteral=CANNM_EXCLUSIVE_AREA_0, SchMExclusiveAreaDescription=No interruption by any interrupt allowed (i.e. global interrupt locks)
          CANNM_EXCLUSIVE_AREA_1: SchMExclusiveAreaLiteral=CANNM_EXCLUSIVE_AREA_1, SchMExclusiveAreaDescription=No interruption of CanNm_MainFunction by CanNm_SetUserData, CanNm_SetCoordBits or CanNm_SetDiagGwReqId allowed
          CANNM_EXCLUSIVE_AREA_2: SchMExclusiveAreaLiteral=CANNM_EXCLUSIVE_AREA_2, SchMExclusiveAreaDescription=No interruption of CanNm_SetUserData by CanNm_MainFunction allowed
          CANNM_EXCLUSIVE_AREA_3: SchMExclusiveAreaLiteral=CANNM_EXCLUSIVE_AREA_3, SchMExclusiveAreaDescription=No interruption of CanNm_SetCoordBits by CanNm_MainFunction allowed
          CANNM_EXCLUSIVE_AREA_4: SchMExclusiveAreaLiteral=CANNM_EXCLUSIVE_AREA_4, SchMExclusiveAreaDescription=No interruption of CanNm_RxIndication by CanNm_GetUserData or CanNm_GetPduData allowed
          CANNM_EXCLUSIVE_AREA_5: SchMExclusiveAreaLiteral=CANNM_EXCLUSIVE_AREA_5, SchMExclusiveAreaDescription=No interruption of CanNm_GetUserData or CanNm_GetPduData by CanNm_RxIndication allowed
    8 x SchMMainFunctionMapping, all with SchMModuleRef=CanNm:
      CanNm_MainFunction_0: SchMMainFunctionSymbol=CanNm_MainFunction_0
        SchMBswEvent
          SchMBswTimingEvent: SchMMainFunctionPeriod=0.01
      CanNm_MainFunction_1: SchMMainFunctionSymbol=CanNm_MainFunction_1
        SchMBswEvent
          SchMBswTimingEvent: SchMMainFunctionPeriod=0.01
      CanNm_MainFunction_2: SchMMainFunctionSymbol=CanNm_MainFunction_2
        SchMBswEvent
          SchMBswTimingEvent: SchMMainFunctionPeriod=0.01
      CanNm_MainFunction_3: SchMMainFunctionSymbol=CanNm_MainFunction_3
        SchMBswEvent
          SchMBswTimingEvent: SchMMainFunctionPeriod=0.01
      CanNm_MainFunction_4: SchMMainFunctionSymbol=CanNm_MainFunction_4
        SchMBswEvent
          SchMBswTimingEvent: SchMMainFunctionPeriod=0.01
      CanNm_MainFunction_5: SchMMainFunctionSymbol=CanNm_MainFunction_5
        SchMBswEvent
          SchMBswTimingEvent: SchMMainFunctionPeriod=0.01
      CanNm_MainFunction_6: SchMMainFunctionSymbol=CanNm_MainFunction_6
        SchMBswEvent
          SchMBswTimingEvent: SchMMainFunctionPeriod=0.01
      CanNm_MainFunction_7: SchMMainFunctionSymbol=CanNm_MainFunction_7
        SchMBswEvent
          SchMBswTimingEvent: SchMMainFunctionPeriod=0.01
