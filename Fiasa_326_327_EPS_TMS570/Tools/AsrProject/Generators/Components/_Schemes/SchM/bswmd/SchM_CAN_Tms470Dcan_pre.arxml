AUTOSAR XML (schema 3.0.1)
package /MICROSAR
  module config SchM_Rec: definition=SchM, implementation-config-variant=VARIANT-PRE-COMPILE  # Configuration of the SchM (BSW Scheduler) module.
    Can (SchMModuleConfiguration): SchMModuleLiteral=Can, SchMModuleInclude=Can.h, SchMModuleConfigVersion=1.0.0, SchMModuleImplementationRef=Can_Impl
      SCHM_CAN_INSTANCE_0 (InstanceConfiguration): SchMInstanceLiteral=SCHM_CAN_INSTANCE_0
        7 x ExclusiveAreaConf:
          CAN_EXCLUSIVE_AREA_0: SchMExclusiveAreaLiteral=CAN_EXCLUSIVE_AREA_0, SchMExclusiveAreaDescription=Using to secure atomic Hardware access. this Area should be protected with global interrupt locks.
          CAN_EXCLUSIVE_AREA_1: SchMExclusiveAreaLiteral=CAN_EXCLUSIVE_AREA_1, SchMExclusiveAreaDescription=Using inside Can_DisableControllerInterrupts() and Can_EnableControllerInterrupts() to secure Interrupt counters for nested calls. - Duration is short (less than 30 instructions) - No API calls inside - Disable global interrupts
          CAN_EXCLUSIVE_AREA_2: SchMExclusiveAreaLiteral=CAN_EXCLUSIVE_AREA_2, SchMExclusiveAreaDescription=Using inside Can_Write() to secure software states of transmit objects. (Only when no Vector CAN Interface is used - Duration is medium (less than 100 instructions) - No calls inside - Disable global interrupts - or - Disable CAN interrupts and does not call function reentrant.
          CAN_EXCLUSIVE_AREA_3: SchMExclusiveAreaLiteral=CAN_EXCLUSIVE_AREA_3, SchMExclusiveAreaDescription=Using inside Tx confirmation to secure state of transmit object in case of cancelation. - Duration is medium (less 100 instructions) - Call to CanIf_CancelTxConfirmation() inside - Disable global interrupts - or - Disable CAN interrupts and do not call function Can_Write() within.
          CAN_EXCLUSIVE_AREA_4: SchMExclusiveAreaLiteral=CAN_EXCLUSIVE_AREA_4, SchMExclusiveAreaDescription=Using inside received data handling (Rx Queue treatment) to secure Rx Queue counter and data. -Duration is short (less than 20 instructions) - No calls inside - Disable Global Interrupts - or - Disable all CAN interrupts.
          CAN_EXCLUSIVE_AREA_5: SchMExclusiveAreaLiteral=CAN_EXCLUSIVE_AREA_5, SchMExclusiveAreaDescription=Using inside wakeup handling to secure state transition. -Duration is short (less 20 instructions) -Call to DET inside - Disable global interrupts (do no use here CAN interrupt locks)
          CAN_EXCLUSIVE_AREA_6: SchMExclusiveAreaLiteral=CAN_EXCLUSIVE_AREA_6, SchMExclusiveAreaDescription=Using inside Can_SetControllerMode() and BusOff to secure state transition. -Duration is medium (less than 100 instructions); No calls inside - Disable global interrupts (do not use CAN interrupt locks here, except the API for one controller is not called in a context higher than the CAN interrupt)
    4 x SchMMainFunctionMapping, all with SchMModuleRef=Can:
      Can_MainFunction_Write: SchMMainFunctionSymbol=Can_MainFunction_Write
        SchMBswEvent
          SchMBswTimingEvent: SchMMainFunctionPeriod=0.01
      Can_MainFunction_Read: SchMMainFunctionSymbol=Can_MainFunction_Read
        SchMBswEvent
          SchMBswTimingEvent: SchMMainFunctionPeriod=0.01
      Can_MainFunction_BusOff: SchMMainFunctionSymbol=Can_MainFunction_BusOff
        SchMBswEvent
          SchMBswTimingEvent: SchMMainFunctionPeriod=0.01
      Can_MainFunction_Wakeup: SchMMainFunctionSymbol=Can_MainFunction_Wakeup
        SchMBswEvent
          SchMBswTimingEvent: SchMMainFunctionPeriod=0.01
