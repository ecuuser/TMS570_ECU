AUTOSAR XML (schema 3.0.1)
package /MICROSAR
  bsw implementation MemIf_Impl: code-generator=cMICROSAR, programming-language=C, sw-major-version=2, sw-minor-version=1, sw-patch-version=2, vendor-id=30, ar-major-version=1, ar-minor-version=2, ar-patch-version=0, preconfigured-configuration=MemIf_Pre, recommended-configuration=MemIf_Rec, vendor-specific-module-def=MemIf
  module definition MemIf [0..1]: refined-module-def=MemIf, variants pre-compile  # Configuration of the MemIf (Memory Abstraction Interface) module.
    container MemIfGeneral  # Configuration of the memory abstraction interface (Memif) module.
      boolean MemIfDevErrorDetect: configuration-class-affection=affection-kind=NO-AFFECT, set at pre-compile, default-value=false  # Pre-processor switch to enable and disable development error detection. true: Development error detection enabled. false: Development error detection disabled.
      derived integer MemIfNumberOfDevices: 1..255, configuration-class-affection=affection-kind=NO-AFFECT, set at link  # Not used
      boolean MemIfVersionInfoApi: configuration-class-affection=affection-kind=NO-AFFECT, set at pre-compile, default-value=false  # Pre-processor switch to enable / disable the API to read out the modules version information. true: Version info API enabled. false: Version info API disabled.
    container MemIfAdditional  # Container for additional configuration parameters provided by the implementation.
      boolean MemIfCfgChkParamVInfo: configuration-class-affection=affection-kind=NO-AFFECT, set at pre-compile, origin=Vector Informatik, default-value=true  # Check if VersionInfoPtr parameter passed to MemIf_GetVersionInfo() is NULL_PTR
      boolean MemIfCfgChkParamDevIndex: configuration-class-affection=affection-kind=NO-AFFECT, set at pre-compile, origin=Vector Informatik, default-value=true  # Check Device Index Parameter passed to MemIf's service APIs
      boolean MemIfCfgUseFctApi: configuration-class-affection=affection-kind=NO-AFFECT, set at pre-compile, origin=Vector Informatik, default-value=true  # Use Function API instead of macros
      string MemIfCfgIncludeDet: configuration-class-affection=affection-kind=NO-AFFECT, set at pre-compile, origin=Vector Informatik, default-value=Det.h  # File name which contains the API declaration for module DET.
      boolean MemIfDebugReporting: configuration-class-affection=affection-kind=NO-AFFECT, set at pre-compile, origin=Vector Informatik, default-value=true  # This parameter enables/disables Development Error Reporting.
      string MemIfErrorhook: configuration-class-affection=affection-kind=NO-AFFECT, set at pre-compile, origin=Vector Informatik, default-value=Det_ReportError  # This function is called in case a development error has been detected
  module config MemIf_Pre: definition=MemIf
  module config MemIf_Rec: definition=MemIf
