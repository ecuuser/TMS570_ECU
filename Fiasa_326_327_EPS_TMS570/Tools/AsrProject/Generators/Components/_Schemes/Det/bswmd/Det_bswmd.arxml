AUTOSAR XML (schema 3.0.1)
package /MICROSAR
  module definition Det [0..1]: refined-module-def=Det, variants pre-compile
    container DetGlobalConfig
      boolean DetEnableDet: set at pre-compile, origin=Vector Informatik, default-value=true  # Enable reporting of development error
      boolean DetVersionInfoApi: set at pre-compile, origin=Vector Informatik, default-value=false  # En-/ disable the function Det_GetVersionInfo() to get the major, minor and patch version information.
      boolean DetExtDebugSupport: set at pre-compile, origin=Vector Informatik, default-value=false  # En-/ disable ex-tended debug sup-port features includ-ing filtering, logging and flexible break handling. Please refer to the technical reference for details.
      integer DetGlobalFilterSize: 0..255, set at pre-compile, origin=Vector Informatik, default-value=0  # Number of global filters which can be used to discard ir-relevant errors. Please refer to the technical reference about details.
      integer DetBreakFilterSize: 0..255, set at pre-compile, origin=Vector Informatik, default-value=0  # Number of break handler filters which can be used to exit the DET without en-tering the endless loop. Please refer to the technical refer-ence about details.
      integer DetLogBufferSize: 0..255, set at pre-compile, origin=Vector Informatik, default-value=0  # Size of the log buffer which can be used to log errors reported to the DET. Please refer to the technical reference about de-tails.
      boolean DetEntryCallout: set at pre-compile, origin=Vector Informatik, default-value=false  # En-/ disable user extensions by Appl_DetEntryCallout. Please refer to the technical reference for details.
      enumeration DetConfigurationVariant: set at pre-compile, origin=Vector Informatik, default-value=PreCompile  # Specifies the selected configuration variant for the CanNm module
        PreCompile  # Variant 1 (Pre-compile Configuration)
      container DetServicePort [0..*]  # A separate DetServicePort is needed for each AUTOSAR SW-C which wants to report errors to the Det module which corresponds to the service port of the SW-C.
        integer DetModuleId: 256..65535, set at pre-compile, origin=Vector Informatik, symbolic-name-value=true, default-value=256  # Each DetServicePort needs a ModuleId as port defined argument value. This value is set automatically and symbolic name value defines for the ModuleIds are generated.
    container VectorCommonData
      string BswmdVersion: configuration-class-affection=affection-kind=NO-AFFECT, set at published-information, origin=Vector Informatik, default-value=1.09.01  # Version of the BSWMD file that has been used to set up the ECU configuration
  bsw implementation Det_Impl: code-generator=cMICROSAR,GENy, programming-language=C, sw-major-version=6, sw-minor-version=0, sw-patch-version=1, vendor-id=30, ar-major-version=3, ar-minor-version=0, ar-patch-version=0, preconfigured-configuration=Det_Pre, recommended-configuration=Det_Rec, vendor-specific-module-def=Det
  module config Det_Pre: definition=Det
  module config Det_Rec: definition=Det
