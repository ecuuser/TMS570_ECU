AUTOSAR XML (schema 3.0.1)
package /MICROSAR
  bsw implementation CanSM_Impl: code-generator=GENy, programming-language=C, sw-major-version=1, sw-minor-version=21, sw-patch-version=00, vendor-id=30, ar-major-version=1, ar-minor-version=0, ar-patch-version=0, preconfigured-configuration=CanSM_Pre, recommended-configuration=CanSM_Rec, vendor-specific-module-def=CanSM
  module definition CanSM [0..1]: refined-module-def=CanSM, variants pre-compile/link-time/post-build  # Configuration of the CanSM module
    container CanStateManagerConfiguration: multiple-configuration-container=true  # This container contains the global parameters of the CanSM and sub containers, which are for the CAN network specific configuration.
      integer CanSMBorCounterL1ToL2: 0..255, set at link in variant pre-compile+link-time / post-build in variant post-build, default-value=5  # This threshold defines at which bus-off-counter value the bus-off recovery state machine switches from level 1 to level 2. NOT USED PARAMETER
      integer CanSMBorCounterL2Err: 0..255, set at link in variant pre-compile+link-time / post-build in variant post-build, default-value=8  # This threshold defines at which bus-off-counter value the bus-off recovery state machine shall report a failed production error state to the DEM. NOT USED PARAMETER
      boolean CanSMBorDisableRxDlMonitoring: set at link, default-value=false  # If "On" the CanSM disables the deadline monitoring of RX PDU Groups during bus-off recovery to avoid timeouts (False: Off, True: On). NOT USED PARAMETER
      float CanSMBorTimeL1: 0..65.535, set at link in variant pre-compile+link-time / post-build in variant post-build, default-value=1  # This time parameter defines in seconds the duration of the bus-off recovery time in level 1 (short recovery time). NOT USED PARAMETER
      float CanSMBorTimeL2: 0..65.535, set at link in variant pre-compile+link-time / post-build in variant post-build, default-value=3  # This time parameter defines in seconds the duration of the bus-off recovery time in level 2 (long recovery time). NOT USED PARAMETER
      float CanSMBorTimeTxEnsured: 0..65.535, set at link in variant pre-compile+link-time / post-build in variant post-build, default-value=5.0  # This parameter defines in seconds the duration of the bus-off event check. This check assesses, if the recovery has been successful after the recovery reenables the transmit path. If a new bus-off occurs during this time period, the CanSM assesses this bus-off as sequential bus-off without successful recovery. Because a bus-off only can be detected, when PDUs are transmitted, the time has to be great enough to ensure that PDUs are transmitted again. NOT USED PARAMETER
      boolean CanSMDevErrorDetect: set at pre-compile, default-value=true  # If 'Development Error Detection' is enabled, all development errors are reported to the Development Error Tracer (DET). The errors are described in the TechnicalReference_CanSM.pdf. Note: In general, the development error detection is recommended during pre-test phase. It is not recommended to enable the development error detection in production code due to increased runtime and ROM needs.
      boolean CanSMProdErrorDetect: set at pre-compile, origin=Vector Informatik, default-value=true  # If 'Production Error Detection' is enabled, production relevant errors are reported to the Diagnostics Event Manager (DEM). Disable this option, if no DEM is present in your system.
      float CanSMMainFctCycleTime: 0.004..0.1, set at link, origin=Vector Informatik, default-value=0.010  # Specifies the time base of the CanSM. The main function of the CanSM becomes called once each cycle time by the Schedule Manager.
      boolean CanSMVersionInfoApi: set at pre-compile, origin=Vector Informatik, default-value=false  # En-/ disable the function CanSM_GetVersionInfo() to get the major, minor and patch version information.
      string CanSMUserConfigurationFile [0..1]: set at link, origin=Vector Informatik  # If a file path will be specified, the file is read and its contents are put at the end of the CanSM configuration file.
      integer CanSMPostBuildConfigStartAddress: 0..4294967295, set at pre-compile in variant pre-compile / link in variant link-time+post-build, origin=Vector Informatik, default-value=0  # The Modul Start Address must specify the start address of the memory area, where the generated hex-file will be mapped to. If the ECU supports selectable post-build configuration, the Modul Start Address can be any location that is accessible for the BSW module. If selectable post-build configuration is not supported by your ECU, the Modul Start Address must be the same address to which the initial configuration was mapped. Please see to your linker map file to get this address. The attribute is only evaluated and visible if the configuration variant is set to Variant 3 (Post-build configuration).
      integer CanSMHwRepetition: 0..255, set at link, origin=Vector Informatik, default-value=5  # The counter defines how long the CanSM shall repeat the triggering of the CAN controller and the Can Transceiver driver, to perform a state transition of the CAN controller and the CANTransceiver. If the counter expires then the CanSM reports the production error 'CANSM_E_MODE_CHANGE_NETWORK_x'.
      boolean CanSMEcuPassiveMode: set at pre-compile, origin=Vector Informatik, default-value=false  # En-/ disable the Ecu Passive Mode handling.
      boolean CanSMBusOffNotification: set at pre-compile, origin=Vector Informatik, default-value=false  # En-/ disable the BusOff notification functions called Appl_CanSM_BusOffBegin() and Appl_CanSM_BusOffEnd(). For detailed description please refer to the TechnicalReference_CanSM.pdf.
      boolean CanSMDisableDMInSilentCom: set at pre-compile, origin=Vector Informatik, default-value=true  # If the feature is enabled the CanSM disables the deadline monitoring of the RX PDU groups in transition to CANSM_SILENT_COMMUNICATION.
      boolean CanSMPartialNetwork: set at pre-compile, origin=Vector Informatik, default-value=false  # If enabled the CanSM changes the ASR shutdown sequence according to the needs of Partial Network Transceivers.
      boolean CanSMBswMComModeIndication: set at pre-compile, origin=Vector Informatik, default-value=false  # If enabled the CanSM inform the BswM about the communication mode via BswM_CanSM_CurrentState().
      boolean CanSMBorTxConfirmationGlobal: set at pre-compile, origin=Vector Informatik, default-value=false  # If enabled the CanSM polls the CanIf_GetTxConfirmationState API to decide the bus-off state to be recovered instead of using the CanSMBorTimeTxEnsured parameter for this decision. Pay attention that the feature CanIfPublicTxConfirmPollingSupport is activated too
      float CanSMIndicationTimeOut: 0..1, set at link, origin=Vector Informatik, default-value=0.050  # Each request to the transceiver has to be answered by the according indication. This parameter defines how long the CanSM should wait for a indication. If the indication has to be triggered in the call context of the according request function this value can be set to zero. If the duration exceeds the this value CanSM reports the production error 'CANSM_E_MISSING_TRCV_INDICATION_NETWORK_x'.
      boolean CanSMAmdRuntimeMeasurement: set at pre-compile, origin=Vector Informatik, default-value=false  # This parameter is used to support the Amd Runtimemeasurement support.
      container CanStateManagerNetworks [1..*]  # This container contains the CAN network specific parameters of each CAN network
        integer CanSMBorCounterL1ToL2Ch: 0..255, set at link in variant pre-compile+link-time / post-build in variant post-build, origin=Vector Informatik, default-value=5  # The counter defines which bus off counter value the bus off recovery algorithm switch form level 1 to level 2. The second level provides a longer recovery time (depends on the chosen configuration).
        float CanSMBorTimeL1Ch: 0..65.535, set at link in variant pre-compile+link-time / post-build in variant post-build, origin=Vector Informatik, default-value=1  # This time parameter defines in seconds the duration of the bus-off recovery time in level 1 (short recovery time).
        float CanSMBorTimeL2Ch: 0..65.535, set at link in variant pre-compile+link-time / post-build in variant post-build, origin=Vector Informatik, default-value=3  # This time parameter defines in seconds the duration of the bus-off recovery time in level 2 (long recovery time).
        float CanSMBorTimeTxEnsuredCh: 0..65.535, set at link in variant pre-compile+link-time / post-build in variant post-build, origin=Vector Informatik, default-value=5.0  # This parameter defines the duration of the bus off event check. The check assess, if the recovery has been successful after the recovery reenables the transmit path. If a new bus off occurs during this time period, the CanSM assess this bus off as sequential bus off without successful recovery. Because a bus off only can detected, when a PDUs can be transmitted, the time has to be great enough to ensure that PDUs are transmitted again.
        boolean CanSMBorDisableRxDlMonitoringCh: set at link, origin=Vector Informatik, default-value=false  # If Enabled then the CanSM disables the deadline monitoring of the RX PDU groups during the bus off recovery phase to avoid timeouts (no timeout notification will be called).
        boolean CanSMDisableRxPduGroup: set at link, origin=Vector Informatik, default-value=false  # If Enabled then the CanSM disables the RX PDU groups handling for this channel.
        boolean CanSMDisableTxPduGroup: set at link, origin=Vector Informatik, default-value=false  # If Enabled then the CanSM disables the TX PDU groups handling for this channel.
        boolean CanSMInitializeTxPduData: set at link, origin=Vector Informatik, default-value=false  # If Enabled then the CanSM requests the initialization of the data in the I-PDUs of this I-PDU group.
        boolean CanSMInitializeRxPduData: set at link, origin=Vector Informatik, default-value=false  # If Enabled then the CanSM requests the initialization of the data in the I-PDUs of this I-PDU group.
        boolean CanSMBorTxConfirmationPolling: set at link, origin=Vector Informatik, default-value=false  # If enabled the CanSM polls the CanIf_GetTxConfirmationState API to decide the bus-off state to be recovered instead of using the CanSMBorTimeTxEnsured parameter for this decision. The global switch has to be enabled too.
        boolean CanSMTransceiverPnSupport: set at link in variant pre-compile+link-time / post-build in variant post-build, origin=Vector Informatik, default-value=false  # If Enabled then the CanSM changes the shutdown sequence to the needs of the partial network feature. The global switch (CanSMPartialNetwork) has to be enabled too.
        symbolic name reference CanSMNetworkHandle: set at link, destination=ComMChannel  # Unique handle to identify one certain CAN network. Reference to one of the network handles configured for the ComM.
        symbolic name reference CanSMRxPduGroupId: set at link, destination=ComIPduGroup  # Choose the Rx I-PDU Group Handle, which is used by the CanSM to start/stop the Rx PDUs for this channel.
        symbolic name reference CanSMTransceiverId: set at link, destination=CanTrcvChannel  # ID of the CAN transceiver assigned to the configured network handle. Reference to one of the transceivers of CanTrcv configuration.
        symbolic name reference CanSMTxPduGroupId: set at link, destination=ComIPduGroup  # Choose the Tx I-PDU Group Handle, which is used by the CanSM to start/stop the Tx PDUs for this channel.
        container CanStateManagerControllers [1..*]  # This container contains the controller IDs assigned to a CAN network.
          symbolic name reference CanSMControllerId: set at link, destination=CanController  # Unique handle to identify one certain CAN controller. Reference to one of the CAN controllers of CAN driver (Can) configuration.
    container VectorCommonData
      string BswmdVersion: set at published-information, origin=Vector Informatik, default-value=1.18.00  # Bswmd version
  module config CanSM_Pre: definition=CanSM
  module config CanSM_Rec: definition=CanSM
