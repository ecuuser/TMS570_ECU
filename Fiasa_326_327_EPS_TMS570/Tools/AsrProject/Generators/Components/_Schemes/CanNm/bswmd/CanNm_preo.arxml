AUTOSAR XML (schema 3.0.1)
package /MICROSAR
  module config CanNm_Pre: definition=CanNm, implementation-config-variant=VARIANT-PRE-COMPILE
  module config CanNm_Pre_Class1: definition=CanNm
    CanNmGlobalConfig
      CanNmChannelConfig:
        CanNmPduCbvPosition = CANNM_PDU_BYTE_1
        CanNmPduNidPosition = CANNM_PDU_BYTE_0
        CanNmPnEnabled = false
        CanNmCarWakeUpFilterEnabled = false
        CanNmCarWakeUpRxEnabled = false
        CanNmPnEraCalcEnabled = false
        CanNmActiveWakeupBitEnabled = true
  module config CanNm_Rec: definition=CanNm
  module config CanNm_Rec_Class1: definition=CanNm
    CanNmGlobalConfig
      CanNmChannelConfig: CanNmChannelActive=true, CanNmBusLoadReductionActive=true, CanNmActiveWakeupBitEnabled=true
  module config CanNm_Rec_Class2: definition=CanNm
    CanNmGlobalConfig:
      CanNmDevErrorDetect = false
      CanNmPduRxIndicationEnabled = false
      CanNmPassiveModeEnabled = false
      CanNmVersionInfoApi = false
      CanNmBusSynchronizationEnabled = false
      CanNmStateChangeIndEnabled = true
      CanNmExtRemoteSleepIndication = false
      CanNmRemoteSleepIndEnabled = false
      CanNmProdErrorDetect = true
      CanNmBusLoadReductionEnabled = true
      CanNmImmediateRestartEnabled = true
      CanNmComControlEnabled = true
      CanNmActiveWupBitFeatureEnabled = true
      CanNmPduRxIndicationEnabled = false
  module config CanNm_Pre_Class2: definition=CanNm
    CanNmGlobalConfig:
      CanNmNodeDetectionEnabled = false
      CanNmNodeIdEnabled = true
      CanNmApiOptimization = false
      CanNmDiagGatewayExtEnabled = false
      CanNmUserDataEnabled = false
      CanNmImmediateTxconfEnabled = false
      CanNmTransmissionErrorReporting = false
      CanNmRepeatMsgIndEnabled = false
      CanNmExtBusSynchronization = false
      CanNmGatewayExtEnabled = false
      CanNmLimpHomeIndication = false
      CanNmPnFeatureEnabled = false
      CanNmCarWupRxFeatureEnabled = false
      CanNmCarWupFilterFeatureEnabled = false
      CanNmActiveWupBitFeatureEnabled = true
      CanNmImmediateNmTxFeatureEnabled = false
