AUTOSAR XML (schema 3.0.1)
# COPYRIGHT
# Copyright (c) 2011-2013 by Vector Informatik GmbH. All rights reserved.
# This software is copyright protected and proprietary to Vector Informatik GmbH.
# Vector Informatik GmbH grants to you only those rights as set out in the license conditions.
package /MICROSAR
  module definition CanNm [0..1]: refined-module-def=CanNm, variants pre-compile/link-time/post-build  # Configuration Parameters for the Can Nm module.
    container CanNmGlobalConfig: multiple-configuration-container=true  # This container contains the global configuration parameter of the CanNm. The parameters and the parameters of the sub containers shall be mapped to the C data type CanNm_ConfigType (for parameters where it is possible) which is passed to the CanNm_Init function. This container is a MultipleConfigurationContainer (only for variant 3), i.e. this container and its sub-containers exit once per configuration set.
      boolean CanNmBusLoadReductionEnabled: set at pre-compile, default-value=false  # Pre-processor switch for enabling busload reduction support. If this option is disabled the NM message is always transmitted cyclic with 'NM message Cycle Time [ms]'. If it is enabled the NM message is still transmitted cyclically in Repeat Message State, but with a reduced rate in Normal Operation State. In Normal Operation State the two network nodes that have the smallest 'NM message Node Specific Cycle Time [ms]' and require bus-communication transmit their NM message alternately. This option is a network parameter and should be defined by the OEM. Note: Since this is a pre-compile parameter it can only be customized in pre-compile configurations. RESTRICTIONS: If (CanNmPassiveModeEnabled == True) then (CanNmBusLoadReductionEnabled = False)
      derived boolean CanNmBusSynchronizationEnabled: set at pre-compile, default-value=false, calculation-language=INFORMAL  # Pre-processor switch for enabling bus synchronization support. This option allows the transmission of an asynchronous NM message at any time within Network Mode. This may be required for the synchronized shutdown of networks. Therefore this option is usually only enabled in gateways. Note: Since this is a pre-compile parameter it can only be customized in pre-compile configurations. RESTRICTIONS: Derived from NmBusSynchronizationEnabled. If(CanNmPassiveModeEnabled == True) then (CanNmBusSynchronizationEnabled = False)
      derived boolean CanNmComControlEnabled: set at pre-compile, default-value=false  # Pre-processor switch for enabling the Communication Control support. If this option is enabled an additional API is available that allows to enable and disable the transmission of Network Management Messages in the Normal Operation state. While the transmission is disabled the network cannot be released. Note: Since this is a pre-compile parameter it can only be customized in pre-compile configurations. RESTRICTIONS: Derived from NmComControlEnabled. If(CanNmPassiveModeEnabled == True) then (CanNmComControlEnabled = False)
      integer CanNmConfigPtr: 0..0, set at link in variant link-time / pre-compile in variant pre-compile / post-build in variant post-build, default-value=0  # Pointer to configuration of CanNm (not used).
      boolean CanNmDevErrorDetect: set at pre-compile, default-value=true  # Pre-processor switch for enabling development error detection support. If it is enabled development errors are reported to the Development Error Tracer (Det). The following development errors are reported: - service call without intialization of network management - service call with invalid channel handle - network timeout (i.e. the network management timoeut timer has timed out in Repeat Message State or Normal Operation State) - null pointer has been passed as argument - NM transmission path has failed All development errors are reported to the Development Error Tracer. Note: In general, the 'Development Error Detection' is recommended during pre-test phase. It is not recommended to enable it in production code due to increased runtime and ROM needs. Since this is a pre-compile parameter it can only be customized in pre-compile configurations
      boolean CanNmImmediateRestartEnabled: set at pre-compile, default-value=false  # Pre-processor switch for enabling the asynchronous transmission of a NM PDU upon bus-communication request in Prepare-Bus-Sleep mode. Enabling this option may lead to a burst of NM messages if all Nodes get a bus-communication request approximately at the same time. Note: Since this is a pre-compile parameter it can only be customized in pre-compile configurations. RESTRICTIONS: If (CanNmPassiveModeEnabled == True) then (CanNmImmediateRestartEnabled = False)
      boolean CanNmImmediateTxconfEnabled: set at pre-compile, default-value=false  # Pre-processor switch for enabling the Immediate Tx Confirmation. If this option is enabled , the transmission confirmation is given immediately after transmission request. This mechanism can be used in systems which do not want to use the transmission confirmation from CanIf. Note: Since this is a pre-compile parameter it can only be customized in pre-compile configurations. RESTRICTIONS: If (CanNmPassiveModeEnabled == True) then (CanNmImmediateTxConfEnabled = False)
      derived boolean CanNmNodeDetectionEnabled: set at pre-compile, default-value=false  # Pre-processor switch for enabling the node detection support. If a Tester is present in the network 'NodeDetectionEnabled' offers the opportunity to detect all present network nodes. Note: Since this is a pre-compile parameter it can only be customized in pre-compile configurations. RESTRICTIONS: Derived from NmNodeDetectionEnabled. If (CanNmPassiveModeEnabled == True) OR (CanNmNodeIdEnabled == False) then (CanNmNodeDetectionEnabled = False)
      derived boolean CanNmNodeIdEnabled: set at pre-compile, default-value=false  # Pre-processor switch for enabling the source node identifier. This option provides read access to the local node identifier and to the node identifier received in the last NM message. Note: Since this is a pre-compile parameter it can only be customized in pre-compile configurations. RESTRICTIONS: Derived from NmNodeIdEnabled.
      integer CanNmNumberOfChannels: 1..255, set at pre-compile in variant pre-compile / link in variant link-time+post-build, default-value=1  # Number of Can NM channels allowed within one ECU.
      derived boolean CanNmPassiveModeEnabled: set at pre-compile, default-value=false  # Pre-processor switch for enabling support of the Passive Mode. If this option is set, the node is not able to send NM messages. This option can be used for nodes that do not require to keep the bus awake. Note: Since this is a pre-compile parameter it can only be customized in pre-compile configurations. RESTRICTIONS: Derived from NmPassiveModeEnabled
      derived boolean CanNmPduRxIndicationEnabled: set at pre-compile, default-value=false  # Pre-processor switch for enabling the PDU Rx Indication. If 'PduRxIndicationEnabled' option is enabled a callback function for every received Pdu will be triggered. Note: Since this is a pre-compile parameter it can only be customized in pre-compile configurations. RESTRICTIONS: Derived from NmPduRxIndicationEnabled.
      derived boolean CanNmRemoteSleepIndEnabled: set at pre-compile, default-value=false  # Pre-processor switch for enabling remote sleep indication support. 'RemoteSleepIndEnabled' is used in gateways to detect when the synchronized shutdown of networks has to be carried out. It comprises Remote Sleep Indication, Remote Sleep Cancelation and checking of the Remote Sleep Indication State. Remote Sleep Indication is notified when your network node is the only one in the whole network that requests bus-communication for 'Remote Sleep Indication Time [ms]'. Remote Sleep Cancelation is notified if any other network node requires the communcation bus while Remote Sleep Indication takes place in your network node. Note: Since this is a pre-compile parameter it can only be customized in pre-compile configurations. RESTRICTIONS: Derived from NmRemoteSleepIndEnabled. If (CanNmPassiveModeEnabled == True) then (CanNmRemoteSleepIndEnabled == False)
      derived boolean CanNmRepeatMsgIndEnabled: set at pre-compile, default-value=false  # Pre-processor switch for enabling the Repeat Message Notification. This option enables a callback to the NM Interface whenever a state change due to a repeat message request or a repeat message bit occurs. Note: Since this is a pre-compile parameter it can only be customized in pre-compile configurations. RESTRICTIONS: If (CanNmNodeDetectionEnabled != True) then (CanNmRepeatMsgIndEnabled = False)
      derived boolean CanNmStateChangeIndEnabled: set at pre-compile, default-value=false  # Pre-processor switch for enabling the CAN NM state change notification. This option allows to track every change in the NM state machine due to a callback function triggered on every state change. Note: Since this is a pre-compile parameter it can only be customized in pre-compile configurations. RESTRICTIONS: Derived from NmStateChangeIndEnabled.
      derived boolean CanNmUserDataEnabled: set at pre-compile, default-value=false  # Pre-processor switch for enabling user data support. This option provides read and write access to the user data. Location of user data in the NM message depends on the message configuration. Note: Since this is a pre-compile parameter it can only be customized in pre-compile configurations. RESTRICTIONS: Derived from NmUserDataEnabled.
      boolean CanNmVersionInfoApi: set at pre-compile, default-value=false  # Pre-processor switch for enabling version info API support. This option provides access to the version information of the CAN Network Management module. Provided informations are Module identifier, Vendor identifier and vendor specific Version numbers. Note: Since this is a pre-compile parameter it can only be customized in pre-compile configurations.
      string CanNmUserConfigFile [0..1]: set at pre-compile, origin=Vector Informatik  # User configuration file that shall be part of the CAN NM configuration. If you want to overwrite or provide own settings in the generated configuration file, you can specify a path to a user defined configuration file. The user defined configuration file will be included at the end of the generated file. Thus definitions in the user defined configuration file can overwrite definitions in the generated configuration file.
      boolean CanNmTransmissionErrorReporting: set at pre-compile, origin=Vector Informatik, default-value=false  # When this feature is activated the following errors will not be reported to DET / DEM: - CANNM_E_CANIF_TRANSMIT_ERROR (DEM: Transmission Request failed) - CANNM_E_NETWORK_TIMEOUT (DEM: Network Timeout occured) - CANNM_E_DEV_NETWORK_TIMEOUT (DET: Network Timeout occured) Note: Since this is a pre-compile parameter it can only be customized in pre-compile configurations.
      boolean CanNmProdErrorDetect: set at pre-compile, origin=Vector Informatik, default-value=true  # Enable/disable error reporting to diagnostic event manager. If 'Prod Error Detect' is enabled production errors are reported to the Diagnostic Event Manager (Dem). The following production errors are reported: - network timeout (i.e. the network management timoeut timer has timed out in Repeat Message State or Normal Operation State) - NM transmission path has failed - initialization failed All production errors are reported to the Diagnostic Event Manager. Note: Since this is a pre-compile parameter it can only be customized in pre-compile configurations. For AUTOSAR stacks this parameter shall be set to TRUE.
      boolean CanNmApiOptimization: configuration-class-affection=affection-kind=PC-AFFECTS-LT, set at pre-compile, origin=Vector Informatik, default-value=false  # If the CAN NM just consists of a single channel and the pre-compile configuration variant is available the API and parts of the code can be optimized to save ROM, RAM and runtime. Note: Since this is a pre-compile parameter it can only be customized in pre-compile configurations. RESTRICTIONS: If (Number of CanNm Channels > 1) then (CanNmApiOptimization = False) If (CanNmApiOptimization == True) then (Number of CanNm Channels == 1)
      boolean CanNmLimpHomeIndication: set at pre-compile, origin=Vector Informatik, default-value=false  # The 'Limp Home Indication' provides callbacks to detect 'Limp Home' in the AUTOSAR NM, i.e. when for a certain time ('NM Messages Timeout Time') no NM message could be sent or received. Note: Since this is a pre-compile parameter it can only be customized in pre-compile configurations. RESTRICTIONS: Derived from NmLimpHomeIndication. If (CanNmPassiveModeEnabled == True) then (CanNmLimpHomeIndication = False)
      boolean CanNmExtRemoteSleepIndication: set at pre-compile, origin=Vector Informatik, default-value=false  # If the 'Extended Remote Sleep Indication' is enabled the API service 'CanNm_CheckRemoteSleepIndication' is also evaluated in the Repeat Message state. This feature is required for coordinator functionality. Note: Since this is a pre-compile parameter it can only be customized in pre-compile configurations. RESTRICTIONS: If (CanNmRemoteSleepIndEnabled == False) then (CanNmExtRemoteSleepIndication = False)
      integer CanNmStartAddress: 0..4294967295, set at pre-compile in variant pre-compile / link in variant link-time+post-build, origin=Vector Informatik, default-value=0  # This Value specifies the Start Address of the CAN NM Configuration. The Start Address is needed in the post-build configuration process to locate and replace the previous configuration correctly. RESTRICTIONS: Value is only valid for post-build configurations.
      boolean CanNmComUserDataEnabled: set at pre-compile, origin=Vector Informatik, default-value=false  # If this feature is enabled the application can set the NM user data via the signal interface of the Com by setting signals of the corresponding NM I-PDU. The reference to this I-PDU has to be provided in CanNmTxUserDataPduRef. Note that this feature will disable the API CanNm_SetUserData. Since this is a pre-compile parameter it can only be customized in pre-compile configurations. RESTRICTIONS: Derived from NmComUserDataEnabled. If (CanNmPassiveModeEnabled == True) then (CanNmComUserDataEnabled = False)
      boolean CanNmExtBusSynchronization: set at pre-compile, origin=Vector Informatik, default-value=false  # If this feature is enabled the API 'CanNm_RequestBusSynchronization' is available independently from the normal Bus Synchronization feature. Note that it is strongly recommended to use this feature only during start-up. See also the Technical Reference for more details. RESTRICTIONS: If (CanNmPassiveModeEnabled == True) then (CanNmExtBusSynchronization = False)
      boolean CanNmGatewayExtEnabled: set at pre-compile, origin=Vector Informatik, default-value=false  # Pre-processor switch for enabling network management gateway extension support. This feature enables an extended receive message indication function. Please refer to the Technical Reference for more details. Note: Since this is a pre-compile parameter it can only be customized in pre-compile configurations. RESTRICTIONS:If (CanNmPassiveModeEnabled == True) then (CanNmGatewayExtEnabled = False)
      boolean CanNmDiagGatewayExtEnabled: set at pre-compile, origin=Vector Informatik, default-value=false  # Pre-processor switch for enabling diagnostic gateway extension support. This feature enables an extended receive message indication function. Additionally a further API is introduced for setting a specific byte in the user data and request an additional transmission. Please refer to the Technical Reference for more details. Note: Since this is a pre-compile parameter it can only be customized in pre-compile configurations. RESTRICTIONS:If (CanNmPassiveModeEnabled == True) then (CanNmDiagGatewayExtEnabled = False)
      boolean CanNmCarWupRxFeatureEnabled: set at pre-compile, origin=Vector Informatik, default-value=false  # Pre-processor switch for enabling the Car Wake Up bit evaluation in received NM messages. Note: Since this is a pre-compile parameter it can only be customized in pre-compile configurations. RESTRICTIONS: Derived from NmCarWakeUpRxEnabled.
      boolean CanNmCarWupFilterFeatureEnabled: set at pre-compile, origin=Vector Informatik, default-value=false  # Pre-processor switch for enabling the Car Wake Up filter handling for received Car WUPs. Note: Since this is a pre-compile parameter it can only be customized in pre-compile configurations. RESTRICTIONS: If (CanNmCarWupRxFeatureEnabled == False) then (CanNmCarWupFilterFeatureEnabled = False)
      boolean CanNmImmediateNmTxFeatureEnabled: set at pre-compile, origin=Vector Informatik, default-value=false  # Pre-processor switch for enabling the Immediate Nm Transmission Handling. Note: Since this is a pre-compile parameter it can only be customized in pre-compile configurations. RESTRICTIONS: If (CanNmPassiveModeEnabled == True) then (CanNmImmediateNmTxFeatureEnabled = False)
      boolean CanNmActiveWupBitFeatureEnabled: set at pre-compile, origin=Vector Informatik, default-value=false  # Pre-processor switch for enabling the Active Wake Up Bit Handling. Note: Since this is a pre-compile parameter it can only be customized in pre-compile configurations. RESTRICTIONS: If (CanNmPassiveModeEnabled == True) then (CanNmActiveWupBitFeatureEnabled = False)
      boolean CanNmPnFeatureEnabled: set at pre-compile, origin=Vector Informatik, default-value=false  # Pre-processor switch for enabling the Partial Networking. Note: This switch is an extension to AUTOSAR for optimizing the code if the feature is not needed. Since this is a pre-compile parameter it can only be customized in pre-compile configurations.
      boolean CanNmPnEraCalcFeatureEnabled: set at pre-compile, origin=Vector Informatik, default-value=false  # Pre-processor switch for enabling the Partial Networking External Cluster Calculation. Note: This switch is an extension to AUTOSAR for optimizing the code if the feature is not needed. Since this is a pre-compile parameter it can only be customized in pre-compile configurations. RESTRICTIONS: If (CanNmPnFeatureEnabled == False) then (CanNmPnEraCalcFeatureEnabled = False)
      boolean CanNmPnEiraCalcFeatureEnabled [0..1]: set at pre-compile, origin=Vector Informatik, default-value=false  # Pre-processor switch for enabling the Partial Networking External and Internal Cluster Calculation. Note: This switch is an extension to AUTOSAR for optimizing the code if the feature is not needed. Since this is a pre-compile parameter it can only be customized in pre-compile configurations. RESTRICTIONS: If (CanNmPnFeatureEnabled == False) then (CanNmPnEiraCalcFeatureEnabled = False)
      boolean CanNmPnEiraCalcEnabled [0..1]: set at pre-compile in variant pre-compile / link in variant link-time+post-build, origin=Vector Informatik, default-value=false  # This parameter enables/disables the Partial Networking External and Internal Cluster Calculation. RESTRICTIONS: This parameter is only valid if (CanNmPnEnabled == True) for at least one channel. This parameter is only available if (CanNmPnEiraCalcFeatureEnabled == True).
      float CanNmPnResetTime [0..1]: 0.001..65.535, set at pre-compile in variant pre-compile / link in variant link-time+post-build, origin=Vector Informatik  # This parameter defines the runtime of the PN reset timer in seconds (float) RESTRICTIONS: This parameter is only valid if (CanNmPnEnabled == True) for at least one channel. This parameter is only available if (CanNmPnEraCalcFeatureEnabled == True) OR (CanNmPnEiraCalcFeatureEnabled == True).
      boolean CanNmDem2DetEnabled: set at pre-compile, origin=Vector Informatik, default-value=true  # Pre-processor switch for enabling the handling of initialization and transmission production errors as development errors. If this feature is enabled there will be no reporting of the production errors - CANNM_E_INIT_FAILED (Initialization failure) - CANNM_E_CANIF_TRANSMIT_ERROR (transmission request failure). These errors are reported as development errors instead. Note: Since this is a pre-compile parameter it can only be customized in pre-compile configurations.
      boolean CanNmCanIfRangeConfigDLCCheck: set at pre-compile, origin=Vector Informatik, default-value=true  # Enable/disable the handling of CanNm to adjust the Range Configuration 'Minimum Data Length' (CanIfRangeConfigMinimumDLC) setting. If disabled, the Minimum Data Length accepted by CanIf for CanNm PDUs can be adjusted by the user. Disable this setting if there are CanNm RX PDUs with multiple lengths on one channel. If enabled, the Minimum Data Length accepted by CanIf for CanNm PDUs is automatically determined by the 'Pdu Length' (CanNmPduLength) setting for each channel. Enable this setting if all CanNm (RX and TX) PDUs on the same channel have the same length. Note: Since this is a pre-compile parameter it can only be customized in pre-compile configurations.
      boolean CanNmAmdRuntimeMeasurement: set at pre-compile, origin=Vector Informatik, default-value=false  # This parameter defines if AMD Runtime Measurement (RTM) is enabled for this module.
      reference CanNmPnEiraRxNSduRef [0..1]: set at pre-compile in variant pre-compile / link in variant link-time+post-build, origin=Vector Informatik, destination=Pdu  # Reference to a Com Rx PDU. The CanNm provides the External and Internal Cluster Request Information to this PDU if this information changes. This information is aggregated over all CAN channels. RESTRICTIONS: This parameter is only valid if (CanNmPnEiraCalcEnabled == True). This parameter is only available if (CanNmPnEiraCalcFeatureEnabled == True).
      container CanNmChannelConfig [1..*]  # This container contains the channel specific configuration parameter of the CanNm.
        boolean CanNmBusLoadReductionActive: set at link in variant link-time+post-build / pre-compile in variant pre-compile, default-value=false  # This parameter defines if bus load reduction for the respective NM channel is active or not. If 'Bus Load Reduction Active' is disabled the NM message is always transmitted cyclic with 'Msg Cycle Time [ms]'. If 'Bus Load Reduction Active' is enabled the NM message is still transmitted cyclically in Repeat Message State, but with a reduced rate in Normal Operation State. In Normal Operation State the two network nodes that have the smallest 'NM message Node Specific Cycle Time [ms]' and require bus-communication transmit their NM message alternately. This option is a network parameter and should be defined by the OEM. RESTRICTIONS: This parameter is only valid if (CanNmBusLoadReductionEnabled == True)
        boolean CanNmChannelActive: set at link in variant link-time+post-build / pre-compile in variant pre-compile, default-value=true  # This parameter determines if the respective NM channel is active or not. The particular NM-channel shall only be initialized if this parameter is set to TRUE. If this parameter is set to FALSE the respective NM instance shall not be used during runtime.
        float CanNmMainFunctionPeriod: 0.001..0.255, set at link in variant link-time+post-build / pre-compile in variant pre-compile, default-value=0.01  # Call cycle in seconds of CanNm_MainFunction_x for the respective instance. Within the AUTOSAR ECU configuration file the value is provided in seconds (float), within GENy and DBC configurations the value is provided in ms (integer).
        float CanNmMsgCycleOffset: 0..65.535, set at pre-compile in variant pre-compile / link in variant link-time / post-build in variant post-build, default-value=0  # Time offset in the periodic transmission mode. Within the AUTOSAR ECU configuration file the value is provided in seconds (float), within GENy and DBC configurations the value is provided in ms (integer). Whenever the transmission of network management messages is started the transmission start is delayed by this value. Note: For DBC based configurations this value can be set by the database attribute 'NmAsrCanMsgCycleOffset'. In this case the value is not editable in GENy RESTRICTIONS: This parameter is only valid if (CanNmPassiveModeEnabled == False)
        float CanNmMsgCycleTime: 0.001..65.535, set at link in variant link-time+post-build / pre-compile in variant pre-compile, default-value=0.1  # Transmission cycle time of the network management message. Within the AUTOSAR ECU configuration file the value is provided in seconds (float), within GENy and DBC configurations the value is provided in ms (integer). This value determines the periodic rate in the "periodic transmission mode with bus load reduction" and is the basis for transmit scheduling in the "periodic transmission mode without bus load reduction". Note: For DBC based configurations this value can be set by the database attribute 'NmAsrCanMsgCycleTime'. In this case the value is not editable in GENy. RESTRICTIONS: This parameter is only valid if (CanNmPassiveModeEnabled == False)
        float CanNmMsgReducedtime: 0.001..65.535, set at pre-compile in variant pre-compile / link in variant link-time / post-build in variant post-build, default-value=0.08  # Node specific bus cycle time in the periodic transmission mode with bus load reduction. Within the AUTOSAR ECU configuration file the value is provided in seconds (float), within GENy and DBC configurations the value is provided in ms (integer). Note: For DBC based configurations this value can be set by the database attribute 'NmAsrCanMsgReducedTime'. In this case the value is not editable in GENy. RESTRICTIONS: This parameter is only valid if (CanNmBusLoadReductionEnabled == True) and (CanNmBusLoadReductionActive == True). The value must be unique within the network and the following value limitation applies: (0,5 * CanNmMsgCycleTime) <= CanNmMsgReducedTime < CanNmMsgCycleTime
        float CanNmMsgTimeoutTime: 0.001..65.535, set at link in variant link-time+post-build / pre-compile in variant pre-compile, default-value=0.06  # Transmission Timeout Time of the network management message. Within the AUTOSAR ECU configuration file the value is provided in seconds (float), within GENy and DBC configurations the value is provided in ms (integer). If the network management message cannot be transmitted successfully (no message transmission confirmation) within this time the CANNM module shall give an error notification. RESTRICTIONS: This parameter is only valid if (CanNmPassiveModeEnabled == False). It should be a multiple of CanNmMainFunctionPeriod and smaller than CanNmMsgCycleTime. If CanNmBusLoadReductionActive is True, it also should be smaller than CanNmMsgReducedtime.
        integer CanNmNodeId: 0..255, set at pre-compile in variant pre-compile / link in variant link-time / post-build in variant post-build, default-value=0  # The 'NodeId' is transmitted within the network management message if 'Node Id Enabled' (CanNmNodeIdEnabled) is set and 'Pdu Nid Position' (CanNmPduNidPosition) is not configured to OFF. The node identifier is used for the detection of present nodes and can be read by the application at any time. Note: This value is transmitted within the NM message. Value is set automatically and read-only if provided by the database. RESTRICTIONS: This parameter is only valid if (CanNmNodeIdEnabled == True)
        enumeration CanNmPduCbvPosition: {CANNM_PDU_BYTE_0, CANNM_PDU_BYTE_1, CANNM_PDU_OFF}, set at link in variant link-time+post-build / pre-compile in variant pre-compile, default-value=CANNM_PDU_OFF  # Defines the position of the control bit vector within the NM PDU. The value of the parameter represents the location of the control bit vector in the NM PDU (CanNmPduByte0 means byte 0, CanNmPduByte1 means byte 1, CanNmPduOff means source node identifier is not part of the NM PDU) RESTRICTIONS: If (CanNmPduCbvPosition != CanNmPduOff) then (CanNmPduCbvPosition != CanNmPduCbvPosition) and (CanNmPduLength >= CanNmPduCbvPosition) If (CanNmPduNidPosition == CanNmPduOff) then (CanNmPduCbvPosition != CanNmPduByte1)
        integer CanNmPduLength: 0..8, set at link in variant link-time+post-build / pre-compile in variant pre-compile, default-value=0  # Defines the length of the NM PDU. RESTRICTIONS: The value must be equal for all nodes in the network. The value has to match with the length of the NM transmission message.
        enumeration CanNmPduNidPosition: {CANNM_PDU_BYTE_0, CANNM_PDU_BYTE_1, CANNM_PDU_OFF}, set at link in variant link-time+post-build / pre-compile in variant pre-compile, default-value=CANNM_PDU_OFF  # Defines the position of the source node identifier within the NM PDU. The value of the parameter represents the location of the source node identifier in the NM PDU (CanNmPduByte0 means byte 0, CanNmPduByte1 means byte 1, CanNmPduOff means source node identifier is not part of the NM PDU) RESTRICTIONS: If (CanNmPduNidPosition != CanNmPduOff) then (CanNmPduNidPosition != CanNmPduCbvPosition) and (CanNmPduLength >= CanNmPduNidPosition) If (CanNmPduCbvPosition == CanNmPduOff) then (CanNmPduNidPosition != CanNmPduByte1)
        float CanNmRemoteSleepIndTime: 0.001..65.535, set at link in variant link-time+post-build / pre-compile in variant pre-compile, default-value=0.5  # Timeout for Remote Sleep Indication. Within the AUTOSAR ECU configuration file the value is provided in seconds (float), within GENy and DBC configurations the value is provided in ms (integer). Remote Sleep Indication is notified when your network node is the only one in the whole network that requests bus communication for this timing value. Typically it should be equal to: n * CanNmMsgCycleTime, where n denotes the number of NM-Messages that are normally sent before Remote Sleep Indication is detected. The value of n decremented by one determines the amount of lost NM-Messages that can be tolerated by the Remote Sleep Indication procedure. RESTRICTIONS: This parameter is only valid if (CanNmRemoteSleepIndEnabled == True) If (CanNmRemoteSleepIndEnabled == True) then (CanNmRemoteSleepIndTime > 0)
        float CanNmRepeatMessageTime: 0..65.535, set at link in variant link-time+post-build / pre-compile in variant pre-compile, default-value=0.4  # Timeout for Repeat Message State. Within the AUTOSAR ECU configuration file the value is provided in seconds (float), within GENy and DBC configurations the value is provided in ms (integer). It defines how long the NM shall stay in the Repeat Message State. Within Repeat Message State the NM messages are always transmitted cyclically - even if 'Bus Load Reduction' is enabled. Typically it should be equal to: n * CanNmMsgCycleTime, where n denotes the number of NM-Messages that are normally sent in the Repeat Message State. The value of n decremented by one determines the amount of lost NM-Messages that can be tolerated by the node detection procedure. The value 0 denotes that no Repeat Message State is configured. It means that Repeat Message State is transient what implicates that it is left immediately after entrance and in result no start-up stability is guaranteed and no node detection procedure is possible. Note: For DBC based configurations this value can be set by the database attribute 'NmAsrRepeatMessageTime'. In this case the value is not editable in GENy. RESTRICTIONS: This parameter is only valid if (CanNmPassiveModeEnabled == False) If (CanNmNodeDetectionEnabled == True) then (CanNmRepeatMessageTime > 0)
        float CanNmTimeoutTime: 0.002..65.535, set at link in variant link-time+post-build / pre-compile in variant pre-compile, default-value=1.0  # Network Timeout for the reception and transmission of network management messages. Within the AUTOSAR ECU configuration file the value is provided in seconds (float), within GENy and DBC configurations the value is provided in ms (integer). If in Network Mode (Repeat Message State, Normal Operation State or Ready Sleep State) your network node does not require the communication bus anymore and no more NM messages are received within this time 'Prepare Bus-Sleep' is entered. It shall be equal for all nodes in the cluster. It shall be greater than CanNmMsgCycleTime. Typically it should be equal to: n * CanNmMsgCycleTime, where n denotes the number of NM-Message cycle times in the Ready Sleep State before transition into the Bus-Sleep Mode is initiated. The value of n decremented by one determines the amount of lost NM-Messages that can be tolerated by the coordination algorithm. Note: For DBC based configurations this value can be set by the database attribute 'NmAsrTimeoutTime'. In this case the value is not editable in GENy.
        integer CanNmUserDataLentgh: 0..8, set at link in variant link-time+post-build / pre-compile in variant pre-compile, default-value=0  # Defines the length of the user data contained in the NM PDU. Note: The value is determined by the difference between CanNmPduLength and applied standardized bytes (source node identifier and control bit vector) within the NM PDU. Therefore this value is automatically computed and kept consistent by GENy.
        float CanNmWaitBusSleepTime: 0.001..65.535, set at link in variant link-time+post-build / pre-compile in variant pre-compile, default-value=0.75  # Timeout for bus calm down period (Prepare Bus-Sleep Mode). Within the AUTOSAR ECU configuration file the value is provided in seconds (float), within GENy and DBC configurations the value is provided in ms (integer). The bus calm down period is a safety zone between bus-communciation of application messages and shutdown of the communication bus. It shall be equal for all nodes in the cluster. It shall be long enough to make all Tx-buffer empty. Note: For DBC based configurations this value can be set by the database attribute 'NmAsrWaitBusSleepTime'. In this case the value is not editable in GENy.
        integer CanNmMessageCount: 2..256, set at pre-compile in variant pre-compile / link in variant link-time+post-build, origin=Vector Informatik, default-value=64  # 'Network Management Message Count' defines the number of network management message that are received by your network node. The identifiers of the network managment messages are within the range ['Network Management Base Address', 'Network Management Base Address' + 'Network Management Message Count' - 1]. This value must be a power of 2. Note: Since the 'Network Management Message Count' is a network parameter it is set by the database attribute 'NmAsrMessageCount'.
        integer CanNmBaseAddress: 0..536870911, set at pre-compile in variant pre-compile / link in variant link-time+post-build, origin=Vector Informatik, default-value=1024  # 'Network Management Base Address' defines the start address of the network management message range. Only network management messages within the range are received by your network node. Refer also to the parameter 'NM Message Count' (CanNmMessageCount). Note: For DBC based configurations this value can be set by the database attribute 'NmAsrBaseAddress'. In this case the value is not editable in GENy.
        boolean CanNmCarWakeUpRxEnabled: set at pre-compile in variant pre-compile / link in variant link-time+post-build, origin=Vector Informatik, default-value=false  # This parameter enables/disables the Car Wake Up bit evaluation of received NM messages. RESTRICTIONS: This parameter is only valid if (CanNmCarWupRxFeatureEnabled == True)
        integer CanNmCarWakeUpBytePosition: 0..7, set at pre-compile in variant pre-compile / link in variant link-time+post-build, origin=Vector Informatik, default-value=2  # This parameter defines the Car Wake Up byte position within the NM message. Note that this parameter has to be set to a valid byte position within the user data of the NM PDU. RESTRICTIONS: This parameter is only valid if (CanNmCarWakeUpRxEnabled == True)
        integer CanNmCarWakeUpBitPosition: 0..7, set at pre-compile in variant pre-compile / link in variant link-time+post-build, origin=Vector Informatik, default-value=0  # This parameter defines the Car Wake Up bit position within the NM message. Note that this parameter has to be set to a value between 0 and 7. RESTRICTIONS: This parameter is only valid if (CanNmCarWakeUpRxEnabled == True)
        boolean CanNmCarWakeUpFilterEnabled: set at pre-compile in variant pre-compile / link in variant link-time+post-build, origin=Vector Informatik, default-value=false  # This parameter enables/disables the Car Wake Up Filter. RESTRICTIONS: This parameter is only valid if (CanNmCarWakeUpFilterFeatureEnabled == True) AND (CanNmCarWakeUpRxEnabled == True)
        integer CanNmCarWakeUpFilterNodeId: 0..255, set at pre-compile in variant pre-compile / link in variant link-time+post-build, origin=Vector Informatik, default-value=0  # This parameter defines the node identifier which is considered as Car Wake Up request. Note that this parameter has to be set to a value between 0 and 255. RESTRICTIONS: This parameter is only valid if (CanNmCarWakeUpFilterEnabled == True)
        integer CanNmImmediateNmTransmissions: 0..255, set at pre-compile in variant pre-compile / link in variant link-time+post-build, origin=Vector Informatik, default-value=0  # This parameter defines the number of fast NM transmissions if the ECU awakes the bus. Note that this parameter has to be set to a value between 0 and 255. RESTRICTIONS: This parameter is only valid if (CanNmImmediateNmTxFeatureEnabled == true)
        float CanNmImmediateNmCycleTime [0..1]: 0.001..65.535, set at pre-compile in variant pre-compile / link in variant link-time+post-build, origin=Vector Informatik, default-value=0.1  # This parameter defines cycle time for fast NM message transmission if the ECU awakes the bus. Within the AUTOSAR ECU configuration file the value is provided in seconds (float), within GENy and DBC configurations the value is provided in ms (integer). Note that this parameter has to be set to a value between 0.001 and 65.535. RESTRICTIONS: This parameter is only valid if (CanNmImmediateNmTxFeatureEnabled == true)
        boolean CanNmActiveWakeupBitEnabled: set at pre-compile in variant pre-compile / link in variant link-time+post-build, origin=Vector Informatik, default-value=false  # This parameter defines if the active wakeup bit is set in the CBV for this channel. RESTRICTIONS: This parameter is only valid if (CanNmActiveWupBitFeatureEnabled == True)
        boolean CanNmPnEnabled [0..1]: set at pre-compile in variant pre-compile / link in variant link-time / post-build in variant post-build, origin=Vector Informatik, default-value=false  # This parameter enables/disables the Partial Networking. RESTRICTIONS: This parameter is only available if (CanNmPnFeatureEnabled == True).
        boolean CanNmPnEraCalcEnabled [0..1]: set at pre-compile in variant pre-compile / link in variant link-time+post-build, origin=Vector Informatik, default-value=false  # This parameter enables/disables the PN External Cluster Calculation for this channel. RESTRICTIONS: This parameter is only valid if (CanNmPnEnabled == True) This parameter is only available if (CanNmPnEraCalcFeatureEnabled == True).
        boolean CanNmAllNmMessagesKeepAwake [0..1]: set at pre-compile in variant pre-compile / link in variant link-time+post-build, origin=Vector Informatik, default-value=false  # This parameter enables/disables if all received NM messages shall keep the ECU awake. If disabled only NM messages with CRI bit = TRUE and containing relevant cluster request for this ECU will keep the ECU awake. RESTRICTIONS: This parameter is only valid if (CanNmPnEnabled == True) This parameter is only available if (CanNmPnFeatureEnabled == True).
        boolean CanNmPnHandleMultipleNwRequests [0..1]: set at pre-compile in variant pre-compile / link in variant link-time+post-build, origin=Vector Informatik, default-value=false  # This parameter enables/disables the behavior whether CanNm_NetworkRequest calls have an effect in Network Mode. If disabled CanNm_NetworkRequest is ignored in Network Mode. If enabled CanNm_NetworkRequest triggers a change from Network Mode to Repeat Message. RESTRICTIONS: This parameter is only valid if (CanNmPnEnabled == True) for at least one channel.
        reference CanNmNetworkHandle: set at pre-compile in variant pre-compile / link in variant link-time+post-build, destination=CanStateManagerNetworks  # Channel identifier configured for the respective instance of the NM. The CanNmChannelHandle shall be encoded in the canNmRxPduId parameter which is passed to CanNm_RxIndication() function called by the CanIf.
        symbolic name reference CanNmChannelIdRef: set at pre-compile in variant pre-compile / link in variant link-time+post-build, destination=NmChannelConfig  # Channel identifier configured for the respective AUTOSAR NM cluster. It is used by referring to the respective NM channel handle. It must be unique for each AUTOSAR NM cluster within one ECU (not used).
        reference CanNmPnEraRxNSduRef [0..1]: set at pre-compile in variant pre-compile / link in variant link-time+post-build, origin=Vector Informatik, destination=Pdu  # Reference to a Com Rx PDU. The CanNm provides the External Cluster Request Information to this PDU if this information changes. This information is reported per channel. RESTRICTIONS: This parameter is only valid if (CanNmPnEraCalcEnabled == True) This parameter is only available if (CanNmPnEraCalcFeatureEnabled == True).
        container CanNmTxPdu [0..1]  # This container contains the CanNmTxPduId and the CanNmTxPduRef.
          integer CanNmTxPduId: 0..65535, set at pre-compile in variant pre-compile / link in variant link-time / post-build in variant post-build, default-value=0  # L-PDU handle of the NM PDU to be transmitted by CanIf_Transmit and passed to CanNm_TxConfirmation by the CanIf. This handle specifies the corresponding CAN frame ID and implicitly the CAN driver instance as well as the corresponding CAN controller device. RESTRICTIONS: This parameter is only valid if CanNmPassiveModeEnabled = False. ImplementationType: PduIdType
          reference CanNmTxPduRef: set at link in variant link-time / pre-compile in variant pre-compile / post-build in variant post-build, destination=Pdu  # The reference to the common PDU structure. RESTRICTIONS: This parameter is only valid if CanNmPassiveModeEnabled = False.
        container CanNmUserDataTxPdu [0..1]  # This container contains the CanNmTxUserDataPduRef and the CanNmTxUserDataPduId.
          integer CanNmTxUserDataPduId: 0..65535, set at pre-compile in variant pre-compile / link in variant link-time / post-build in variant post-build, origin=Vector Informatik, default-value=0  # L-PDU handle of the NM user data PDU to be collected from the PduR by PduR_CanNmTriggerTransmit. This handle specifies the corresponding PDU ID within the PduR. RESTRICTIONS: This parameter is only valid if CanNmComUserDataEnabled = True. ImplementationType: PduIdType
          reference CanNmTxUserDataPduRef: set at pre-compile in variant pre-compile / link in variant link-time / post-build in variant post-build, origin=Vector Informatik, destination=Pdu  # Reference to the NM user data I-PDU. RESTRICTIONS: This parameter is only valid if CanNmComUserDataEnabled = True.
      container CanNmPnInfo [0..1]  # Cluster information configuration
        integer CanNmPnInfoOffset: 1..7, set at pre-compile in variant pre-compile / link in variant link-time+post-build, origin=Vector Informatik, default-value=1  # This parameter defines the byte offset of the PN request information within the NM message. Note that this parameter has to be set to a valid byte position within the user data of the NM PDU. RESTRICTIONS: This parameter is only valid if (CanNmPnEnabled == True) for at least one channel. This parameter is only available if (CanNmPnFeatureEnabled == True).
        integer CanNmPnInfoLength: 0..7, set at pre-compile in variant pre-compile / link in variant link-time+post-build, origin=Vector Informatik, default-value=1  # This parameter defines the length in bytes of the PN request information within the NM message. Note that this parameter has to be set to a value less or equal to user data length. RESTRICTIONS: This parameter is only valid if (CanNmPnEnabled == True) for at least one channel. This parameter is only available if (CanNmPnFeatureEnabled == True).
        container CanNmPnFilterMaskByte [0..7]  # Filter mask byte configuration
          integer CanNmPnFilterMaskByteIndex: 0..6, set at pre-compile in variant pre-compile / link in variant link-time+post-build, origin=Vector Informatik, default-value=0  # This parameter defines the index of the mask byte array which is used for the filter algorithm for relevant NM messages. RESTRICTIONS: This parameter is only valid if (CanNmPnEnabled == True) for at least one channel. This parameter is only available if (CanNmPnFeatureEnabled == True).
          integer CanNmPnFilterMaskByteValue: 0..255, set at pre-compile in variant pre-compile / link in variant link-time+post-build, origin=Vector Informatik, default-value=0  # This parameter defines the value of the mask byte which is used for the filter algorithm for relevant NM messages. RESTRICTIONS: This parameter is only valid if (CanNmPnEnabled == True) for at least one channel. This parameter is only available if (CanNmPnFeatureEnabled == True).
    container VectorCommonData
      string BswmdVersion: set at published-information, origin=Vector Informatik, default-value=1.16.02  # Bswmd version
  bsw implementation CanNm_Impl: code-generator=cMICROSAR,GENy, programming-language=C, sw-major-version=4, sw-minor-version=22, sw-patch-version=2, vendor-id=30, ar-major-version=3, ar-minor-version=0, ar-patch-version=1, preconfigured-configuration=CanNm_Pre, recommended-configuration=CanNm_Rec, vendor-specific-module-def=CanNm
  module config CanNm_Pre: definition=CanNm
  module config CanNm_Rec: definition=CanNm
