AUTOSAR XML (schema 3.2.1)
package /MICROSAR
  bsw implementation Rte_Impl: code-generator=DVRteGen, programming-language=C, sw-major-version=2, sw-minor-version=19, sw-patch-version=1, vendor-id=30, ar-major-version=2, ar-minor-version=4, ar-patch-version=0, vendor-specific-module-def=Rte
  module definition Rte [0..1]: refined-module-def=Rte, variants pre-compile  # Configuration of the Rte (Runtime Environment) module.
    container ComponentTypeCalibration [0..*]  # Specifies for each CalprmComponentType or AtomicSoftwareComponentType whether calibration is enabled.
      boolean CalibrationSupportEnabled: set at pre-compile  # Enables calibration support for the specified CalprmComponentType or AtomicSoftwareComponentType.
      foreign reference ComponentTypeRef: set at pre-compile, destination-type=ComponentType  # Reference to the CalprmComponentType or AtomicSoftwareComponentType.
    container RteGeneration  # This container holds the parameters for the configuration of the RTE Generation.
      enumeration RteCalibrationSupport: {DOUBLE_POINTERED, INITIALIZED_RAM, NONE, SINGLE_POINTERED}, set at pre-compile  # The RTE generator shall have the option to switch off support for calibration for generated RTE code. This option shall influence complete RTE code at once.
      enumeration RteGenerationMode: {COMPATIBILITY_MODE, VENDOR_MODE}, set at pre-compile  # Switch between the two available generation modes of the RTE generator.
      boolean RteMeasurementSupport: set at pre-compile  # The RTE generator shall have the option to switch off support for measurement for generated RTE code. This option shall influence complete RTE code at once.
      enumeration RteOptimizationMode: {MEMORY, RUNTIME}, set at pre-compile  # Switch between the two available optimization modes of the RTE generator.
      integer RteVfbTrace: set at pre-compile  # The RTE generator shall globally enable VFB tracing when RTE_VFB_TRACE is defined in the RTE configuration header file as a non-zero integer. The RTE generator shall globally disable VFB tracing when RTE_VFB_TRACE is defined in the RTE configuration header file as 0.
      function name RteVfbTraceFunction [0..*]: set at pre-compile  # The RTE generator shall enable VFB tracing for a given hook function when there is a #define in the RTE configuration header file for the hook function name and tracing is globally enabled. Example: #define Rte_WriteHook_i1_p1_a_Start
      boolean RteXcpEventSupport [0..1]: configuration-class-affection=affection-kind=NO-AFFECT, set at pre-compile, origin=Vector Informatik, default-value=false  # If set to true, the RTE generator uses the Xcp driver to send Xcp Events when the runnables of a task were processed. These events can be used to trigger the measurement of variables in a measurement and calibration tool. This also allows the measurement of sender / receiver ports when implicit inter-ECU communication is used.
      enumeration RteA2LVersion [0..1]: {V151, V160}, configuration-class-affection=affection-kind=NO-AFFECT, set at pre-compile, origin=Vector Informatik, default-value=V151  # When measurement is enabled, the RTE generator generates an a2l file that contains the measurement and characteristic objects of the generated RTE. This parameter specifies the ASAM MCD-2MC standard to which the a2l file is compliant. Version 1.6.0 supports additional features like linker map references for the measurement objects.
    container SwComponentInstance [1..*]  # Representation of one SW-Component instance located on the to be configured ECU. All subcontainer configuration aspects are in relation to this SW-Component instance. The SwComponentInstance can be either an ApplicationSoftwareComponenInstance or a ServiceComponentInstance.
      foreign reference ImplementationRef [0..1]: set at pre-compile, destination-type=SwcImplementation  # The Implementation which is assiged to the ComponentPrototype.
      foreign reference ServiceComponentPrototypeRef [0..1]: set at pre-compile, destination-type=ServiceComponentPrototype  # Reference to the ServiceComponentPrototype representing an particular service on this ECU. If ServiceComponentPrototypeRef is specified there shall not be the SoftwareComponentInstanceRef specified.
      instance reference SoftwareComponentInstanceRef [0..1]: set at pre-compile, destination-context=ComponentPrototype*, destination-type=ComponentPrototype  # Reference to a SW-Component ComponentPrototype. If SoftwareComponentInstanceRef is specified there shall not be the ServiceComponentPrototypeRef specified. Semantic Constraint: Only ComponentPrototypes which have an AtomicSoftwareComponentType as <<isOfType>> shall be referenced here.
      container ExclusiveAreaImplementation [0..*]  # Specifies the implementation to be used for the data consistency of this ExclusiveArea.
        enumeration ExclusiveAreaImplMechanism: {COOPERATIVE_RUNNABLE_PLACEMENT, INTERRUPT_BLOCKING, NON_PREEMPTIVE_TASK, OS_RESOURCE}, set at pre-compile  # To be used implementation mechanism for the specified ExclusiveArea.
        foreign reference ExclusiveAreaRef: set at pre-compile, destination-type=ExclusiveArea  # Reference to the ExclusiveArea.
      container NVRamAllocation [0..*]  # Specifies the relationship between the SW-Components NVRAMMapping / NVRAM needs and the NvM module configuration.
        linker symbol def RamBlockLocationSymbol: lower-multiplicity=0, upper-multiplicity=1, set at pre-compile  # This is the name of the linker object name where the NVRam Block will be mirrored by the Nvm. This symbol will be resolved into the parameter "NvmRamBlockDataAddress" from the "NvmBlockDescriptor".
        linker symbol def RomBlockLocationSymbol: lower-multiplicity=0, upper-multiplicity=1, set at pre-compile  # This is the name of the linker object name where the NVRom Block will be accessed by the Nvm. This symbol will be resolved into the parameter "NvmRomBlockDataAddress" from the "NvmBlockDescriptor".
        instance reference SwNvRamMappingReference: set at pre-compile, destination-context=ComponentPrototype*, destination-type=NVRAMMapping  # Reference to the NVRAMMapping instance to be configured.
        symbolic name reference NvmBlockRef: set at pre-compile, destination=NvmBlockDescriptor  # Reference to the used NvM block for storage of the NVRAMMapping information.
      container RunnableEntityMapping [0..*]  # Maps a RunnableEntity onto one OS Task based on the activating RTEEvent. Even if a RunnableEntity is executed in the caller's context this RunnableEntityMapping shall be specified, but no MappedToTask and PositionInTask elements given.
        float ActivationOffset [0..1]: set at pre-compile  # Activation offset in seconds.
        integer PositionInTask [0..1]: set at pre-compile  # Each RunnableEntities mapped to an OsTask has a specific position within the task execution. For periodic activation this is the order of execution. For event driver activation this is the order of evaluation which actual RunnableEntity has to be executed.
        enumeration RteCyclicTriggerImplementation [0..1]: {Auto, None}, configuration-class-affection=affection-kind=NO-AFFECT, set at pre-compile, origin=Vector Informatik, default-value=Auto  # If set to 'Auto' the RTE generator automatically creates the necessary OS alarm to realize the cyclic trigger with the configured activation offset. If set to 'None' the trigger is not implemented by the RTE generator. It has to be implemented by the user either by configuring an appropriate OS alarm or an OS schedule table. The OS task and optional the OS event for that trigger can be found in the generated RTE report.
        foreign reference RTEEventRef: set at pre-compile, destination-type=RTEEvent  # Reference to the description of the RTEEvent which is pointing to the RunnableEntity being mapped. This allows a fine grained mapping of RunnableEntites based on the activating RTEEvent.
        reference MappedToTaskRef [0..1]: set at pre-compile, destination=OsTask  # Reference to the OsTask the RunnableEntity is mapped to. If no reference to the OsTask is specified the RunnableEntity is executed in the context of the caller.
        reference UsedOsEventRef [0..1]: set at pre-compile, destination=OsEvent  # If an OsEvent is used to activate the RunnableEntity it shall be referenced here.
