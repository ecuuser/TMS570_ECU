AUTOSAR XML (schema 3.2.1)
# COPYRIGHT
# Copyright (c) 2012 by Vector Informatik GmbH. All rights reserved.
# This software is copyright protected and proprietary to Vector Informatik GmbH.
# Vector Informatik GmbH grants to you only those rights as set out in the license conditions.
package /MICROSAR/Can_Tms470Dcan
  bsw implementation Can_Impl: code-generator=cMICROSAR,GENy, programming-language=C, sw-major-version=1, sw-minor-version=23, sw-patch-version=00, vendor-id=30, ar-major-version=2, ar-minor-version=5, ar-patch-version=0, preconfigured-configuration=Can_Pre, recommended-configuration=Can_Rec, vendor-specific-module-def=Can
  module definition Can [0..1]: refined-module-def=Can, variants pre-compile/link-time/post-build  # This container holds the configuration of a single CAN Driver.
    container CanConfigSet: multiple-configuration-container=true  # This is the multiple configuration set container for CAN Driver
      container CanController [1..*]  # This container contains the configuration parameters of the CAN controller(s).
        enumeration CanBusoffProcessing: {INTERRUPT, POLLING}, set at pre-compile, default-value=INTERRUPT  # Enables / disables API Can_MainFunction_BusOff() for handling busoff events in polling mode. Polling mode for the BusOff status. If this feature is enabled, the function Can_MainFunction_BusOff() has to be called to poll the BusOff status of the CAN Controller.
        boolean CanControllerActivation: set at pre-compile in variant pre-compile / link in variant link-time+post-build, default-value=true  # Defines if a CAN controller is used in the configuration. Deactivated controller does not take active part on communication.
        integer CanControllerBaudRate [0..1]: set at pre-compile in variant pre-compile / link in variant link-time / post-build in variant post-build, default-value=500  # Not Used. CanConfigSet/CanController/CanInitStructure used intead to set baudrate and bittiming as concrete baudrate register values. Specifies the buadrate of the controller in kbps.
        integer CanControllerId: 0..255, set at pre-compile in variant pre-compile / link in variant link-time+post-build, symbolic-name-value=true  # This parameter provides the controller ID which is unique in a given CAN Driver. The value for this parameter starts with 0 and continue without any gaps.
        integer CanControllerPropSeg [0..1]: set at pre-compile in variant pre-compile / link in variant link-time / post-build in variant post-build  # Not Used. CanConfigSet/CanController/CanInitStructure used intead to set baudrate and bittiming as concrete baudrate register values. Specifies propagation delay in time quantas. CanControllerBaudRate, CanControllerPropSeg, CanControllerSeg1, CanControllerSeg2. These parameters are derived from the system description and only evaluated when loading an initial EcuC and are then used to calculate hardware register values. In later configuration steps, only the hardware register values are used.
        integer CanControllerSeg1 [0..1]: set at pre-compile in variant pre-compile / link in variant link-time / post-build in variant post-build  # Not Used. CanConfigSet/CanController/CanInitStructure used intead to set baudrate and bittiming as concrete baudrate register values. Specifies phase segment 1 in time quantas. CanControllerBaudRate, CanControllerPropSeg, CanControllerSeg1, CanControllerSeg2. These parameters are derived from the system description and only evaluated when loading an initial EcuC and are then used to calculate hardware register values. In later configuration steps, only the hardware register values are used.
        integer CanControllerSeg2 [0..1]: set at pre-compile in variant pre-compile / link in variant link-time / post-build in variant post-build  # Not Used. CanConfigSet/CanController/CanInitStructure used intead to set baudrate and bittiming as concrete baudrate register values. Specifies phase segment 2 in time quantas. CanControllerBaudRate, CanControllerPropSeg, CanControllerSeg1, CanControllerSeg2. These parameters are derived from the system description and only evaluated when loading an initial EcuC and are then used to calculate hardware register values. In later configuration steps, only the hardware register values are used.
        float CanControllerTimeQuanta [0..1]: set at pre-compile in variant pre-compile / link in variant link-time / post-build in variant post-build  # Not Used. CanConfigSet/CanController/CanInitStructure used intead to set baudrate and bittiming as concrete baudrate register values. Specifies the time quanta for the controller. The calculation of the resulting prescaler value depending on module clocking and time quanta shall be done offline Hardware specific.
        enumeration CanRxProcessing: {INTERRUPT, POLLING}, set at pre-compile, default-value=INTERRUPT  # Enables / disables API Can_MainFunction_Read() for handling PDU reception events in polling mode. Polling mode for Rx mailboxes. This includes the Rx BasicCAN object and Rx FullCAN objects. If this feature is enabled, the Rx events have to be polled by call Can_MainFunction_Read() and no Interrupt will appear.
        enumeration CanTxProcessing: {INTERRUPT, POLLING}, set at pre-compile, default-value=INTERRUPT  # Enables / disables API Can_MainFunction_Write() for handling PDU transmission events in polling mode. Polling mode for Tx mailboxes. This includes the Tx BasicCAN object and Tx FullCAN objects. If this feature is enabled, the Tx events have to be polled by call Can_MainFunction_Write() and no Interrupt will appear.
        enumeration CanWakeupProcessing: {INTERRUPT, POLLING}, set at pre-compile, default-value=INTERRUPT  # Enables / disables API Can_MainFunction_Wakeup() for handling wakeup events in polling mode. Polling mode for the Wakeup event. If this feature is enabled, the function Can_MainFunction_Wakeup() has to be called to poll the Wa-keup event of the CAN Controller. RESTRICTIONS: 'CanWakeupProcessing' is only available, if hardware supports this by mean wakeup detection by bus event.
        integer CanWakeupSourceId [0..1]: set at pre-compile in variant pre-compile / link in variant link-time+post-build, origin=Vector Informatik  # Wakeup Source given by ECUM RESTRICTIONS: 'CanWakeupSourceId' is only when no ECU State Manager Reference is available in the ECUc.
        integer CANBaseAddress: 1..4294967295, set at pre-compile in variant pre-compile / link in variant link-time+post-build, origin=Vector Informatik, default-value=4294433792  # The DCAN module may have multiple hardware channels. With this option the user specifies the channel to use.
        integer CanNumberOfBasicCANObjects [0..1]: 1..255, set at pre-compile in variant pre-compile / link in variant link-time / post-build in variant post-build, origin=Vector Informatik, default-value=1  # Amount of used BasicCAN Objects. Increase this to optimize BasicCAN filtering. RESTRICTIONS: 'CanNumberOfBasicCANObjects' is only available, if 'CanMultipleBasicCANObjects' is activated.
        integer CanMailboxPerBasicCANObjects [0..1]: 1..255, set at pre-compile in variant pre-compile / link in variant link-time / post-build in variant post-build, origin=Vector Informatik, default-value=2  # Amount of used Mailboxes per BasicCAN Objects. Increase this to buffer more BasicCAN messages before execute reception (avoid overrun in polling). RESTRICTIONS: 'CanMailboxPerBasicCANObjects' is only available, if 'CanMultipleBasicCANObjects' is activated and hardware supports this.
        boolean CanCommonCAN [0..1]: set at pre-compile, origin=Vector Informatik, default-value=false  # Activate this when you like to connect two physical CAN channels to one logical CAN Controller. This allow you to use more FullCAN for this Controller. Only the Rx FullCAN can be configured on second physical channel. RESTRICTIONS: 'CanCommonCAN' is a project specific feature and may is not available/supported for every platform.
        boolean CanPnControllerEnable [0..1]: set at pre-compile in variant pre-compile / link in variant link-time / post-build in variant post-build, origin=Vector Informatik, default-value=false  # Partial Network Enable | Activate this when there is a partial network transceiver on this controller active and used.
        reference CanCpuClockRef [0..1]: set at pre-compile in variant pre-compile / link in variant link-time+post-build, destination=McuClockReferencePoint  # Not Used. Reference to the CPU clock configuration, which is set in the MCU driver configuration
        symbolic name reference CanWakeupSourceRef [0..1]: set at pre-compile in variant pre-compile / link in variant link-time+post-build, destination=EcuMWakeupSource  # This parameter contains a reference to the Wakeup Source for this controller as defined in the ECU State Manager. Implementation Type: reference to EcuM_WakeupSourceType RESTRICTIONS: 'CanWakeupSourceRef' is only when a ECU State Manager Reference is available in the ECUc.
        foreign reference CanControllerSystemRef [0..1]: set at pre-compile in variant pre-compile / link in variant link-time+post-build, origin=Vector Informatik, destination-type=CanCommunicationController  # optional reference to a "CanCommunicationController" that defines baud rate limiations
        container CanFilterMask [0..*]  # Not Used. CanConfigSet/CanController/CanInitStructure/CanAcceptanceFilter used intead to set BasicCAN Filter This container contains the configuration (parameters) of the CAN Filter Mask(s). Unused, see CanInitStructure
          integer CanFilterMaskValue [0..1]: set at pre-compile in variant pre-compile / link in variant link-time / post-build in variant post-build, default-value=0  # Not Used. CanConfigSet/CanController/CanInitStructure/CanAcceptanceFilter used intead to set BasicCAN Filter Describes a mask for hardware-based filtering of CAN identifiers It shall be distinguished between - Standard identifier mask - Extended identifier mask.
        container CanInitStructure [1..3]  # Define a set of Baudrate and Filter Masks for Basic CAN This allow more than one set of Baudrate and multiple Basic CAN Filters for one controller. First InitStruct contain the same Baudrate as defined under Controller (standard AutoSar use-case)
          integer Baudrate: 0..1000000, set at pre-compile in variant pre-compile / link in variant link-time / post-build in variant post-build, origin=Vector Informatik, default-value=33333  # Value of the baudrate determinated form CBT0,CBT1 and CBT2. This value will not be used for the baudrate setting. It is only set if the BSWMD file was exported from a GenTool_Geny configuration. For use with GenTool_GeneratorGeny it is not necessary to set this.
          integer CBT0: 0..65536, set at pre-compile in variant pre-compile / link in variant link-time / post-build in variant post-build, origin=Vector Informatik, default-value=12  # This is the value of the lowest 8 bit (BRP, SJW) of the bit timing register (DCAN BTR). The value can be calculated in the bustiming configuration. For more information about the bit timing configuration of the DCAN read the data sheets fromTexas Instruments.
          integer CBT1: 0..65536, set at pre-compile in variant pre-compile / link in variant link-time / post-build in variant post-build, origin=Vector Informatik, default-value=35  # This is the value of the 8 bits TSEG1 and TSEG2 of the bit timing register (DCAN BTR). The value can be calculated in the bustiming configuration. For more information about the bit timing configuration of the DCAN read the data sheets fromTexas Instruments.
          integer CBT2: 0..65536, set at pre-compile in variant pre-compile / link in variant link-time / post-build in variant post-build, origin=Vector Informatik, default-value=0  # This is the value of the bits BRPE of the bit timing register (DCAN BTR). The value can be calculated in the bustiming configuration. For more information about the bit timing configuration of the DCAN read the data sheets fromTexas Instruments.
          container CanAcceptanceFilter [0..*]  # For each used BasicCAN one Acceptance Filter can be defined. The Fiter is defined by Code and Mask part: pass Filter when: receiveID & (~Mask) == Code For Standard ID the Values has to be shifted by 18 to the left. 32nd bit is used for Extended Id information. e.g. STD ID 0x20 - 0x2F should be received use Mask:(0xF<<18) and Code:(0x20<<18) EXT ID 0x40, 0x50 should be received use Mask:0x00000010 and Code:0x00000040
            boolean IsLocked: set at pre-compile, origin=Vector Informatik, default-value=false  # Lock the Acceptance Filter (Gen-Tool do no more optimization)
            integer Mask: set at pre-compile in variant pre-compile / link in variant link-time / post-build in variant post-build, origin=Vector Informatik  # Value of BasicCAN mask register. The value of the BasicCAN mask register determinate together with the value of the BasicCAN code register whether a message will be received or not received by the Basic CAN object. For more information about the acceptance filtering of the DCAN read the data sheets fromTexas Instruments. With a "0" in the BasicCAN mask register the corresponding bit in the BasicCAN code register will not be used for acceptance filtering (don’t care). With a "1" in the BasicCAN mask register the corresponding bit in the BasicCAN code register will be used for acceptance filtering.
            integer Code: set at pre-compile in variant pre-compile / link in variant link-time / post-build in variant post-build, origin=Vector Informatik  # Value of BasicCAN code register. The value of the BasicCAN code register determinate together with the value of the BasicCAN mask register whether a message will be received or not received by the Basic CAN object. For more information about the acceptance filtering of the DCAN read the data sheets fromTexas Instruments. If there is a "1" in the BasicCAN mask register the corresponding bit in the BasicCAN code register will be used for acceptance filtering. In this case, a message will be received, if the corresponding bit in the BasicCAN code register has the same value ( "0" or "1" ) as the message Id.
      container CanHardwareObject [1..*]  # This container contains the configuration (parameters) of CAN Hardware Objects.
        enumeration CanHandleType: {BASIC, FULL}, set at pre-compile in variant pre-compile / link in variant link-time / post-build in variant post-build, default-value=BASIC  # Specifies the type (Full-CAN or Basic-CAN) of a hardware object.
        enumeration CanIdType: {EXTENDED, MIXED, STANDARD}, set at pre-compile in variant pre-compile / link in variant link-time / post-build in variant post-build, default-value=STANDARD  # Specifies whether the IdValue is of type - standard identifier - extended identifier - mixed mode ImplementationType: Can_IdType
        integer CanIdValue: 0..536870911, set at pre-compile in variant pre-compile / link in variant link-time / post-build in variant post-build, default-value=0  # FullCAN messages: Contain the ID value of the message. Rx BasicCAN message: Specifies (together with the filter mask) the identifiers range that passes the hardware filter.
        integer CanObjectId [0..1]: 0..65535, set at pre-compile in variant pre-compile / link in variant link-time / post-build in variant post-build, symbolic-name-value=true, default-value=0  # Holds the handle ID of HRH or HTH. The value of this parameter is unique in a given CAN Driver, and it should start with 0 and continue without any gaps. The HRH and HTH Ids are defined under two different name-spaces. Example: HRH0-0, HRH1-1, HTH0-2, HTH1-3
        enumeration CanObjectType: {RECEIVE, TRANSMIT}, set at pre-compile in variant pre-compile / link in variant link-time / post-build in variant post-build, default-value=RECEIVE  # Specifies if the HardwareObject is used as Transmit or as Receive object
        boolean CanHwProcessing [0..1]: set at pre-compile, origin=Vector Informatik, default-value=false  # Enable Polling Processing | Define this hardware object to be polled or not. Usage depends on CanIndividualProcessing switch.
        enumeration CanCommonCANNode [0..1]: {A, B}, set at pre-compile in variant pre-compile / link in variant link-time / post-build in variant post-build, origin=Vector Informatik, default-value=A  # Use this when Feature 'CanCommonCAN' is activated to select the physical channel for this hardware object. RESTRICTIONS: Feature 'CanCommonCAN' has to be activate. Only selectable for Rx Full CAN hardware objects (all other will be used on channel 'A')
        reference CanControllerRef: set at pre-compile in variant pre-compile / link in variant link-time / post-build in variant post-build, destination=CanController  # Reference to CAN Controller to which the HOH is associated to.
        reference CanFilterMaskRef [0..1]: set at pre-compile in variant pre-compile / link in variant link-time / post-build in variant post-build, destination=CanFilterMask  # Not Used. CanConfigSet/CanController/CanInitStructure/CanAcceptanceFilter used intead to set BasicCAN Filter Reference to the filter mask that is used for hardware filtering together with the CAN_ID_VALUE Different CanHardwareObjects with different CanIdTypes (STANDARD, MIXED, EXTENDED) can share the same CanFilterMask (i.e., the CanFilterMaskRef parameters of these CanHardwareObjects reference the very same CanFilterMask container). This shall be allowed and must be supported by the configuration generators.
    container CanGeneral  # This container contains the parameters related each CAN Driver Unit.
      boolean CanDevErrorDetection: set at pre-compile, default-value=true  # Switches the Development Error Detection and Notification ON or OFF.
      boolean CanHardwareCancellation: set at pre-compile, default-value=false  # Transmit Cancellation | Specifies if hardware cancellation shall be supported.ON or OFF Support Hardware Transmit Cancelation. Enable/disable the usage of transmit cancelation out of hardware mailboxes, so that the canceled message wont be send. (avoid internal priority inversion) RESTRICTIONS: 'CanHardwareCancellation' is only available, if hardware supports this by mean of cancel mailboxes and CanIf-Tx-buffer activated.
      integer CanIndex [0..1]: set at pre-compile  # Not Used. Only one instance is supported now Specifies the InstanceId of this module instance. If only one instance is present it shall have the Id 0.
      function name CanLPduReceiveCalloutFunction [0..1]: set at pre-compile  # Not Used. (Use instead 'CanGenericPrecopy') This parameter defines the existence and the name of a callout function that is called after a successful reception of a received CAN Rx L-PDU. If this parameter is omitted no callout shall take place.
      float CanMainFunctionBusoffPeriod [0..1]: set at pre-compile  # Not Used. This parameter describes the period for cyclic call to Can_MainFunction_Busoff. Unit is seconds.
      float CanMainFunctionReadPeriod [0..*]: set at pre-compile  # Not Used. This parameter describes the period for cyclic call to Can_MainFunction_Read. Unit is seconds.
      float CanMainFunctionWakeupPeriod [0..1]: set at pre-compile  # Not Used. This parameter describes the period for cyclic call to Can_MainFunction_Wakeup. Unit is seconds.
      float CanMainFunctionWritePeriod [0..*]: set at pre-compile  # Not Used. This parameter describes the period for cyclic call to Can_MainFunction_Write. Unit is seconds.
      boolean CanMultiplexedTransmission: set at pre-compile, default-value=false  # Specifies if multiplexed transmission shall be supported.ON or OFF RESTRICTIONS: 'CanMultiplexedTransmission' is only available, if hardware supports this by mean of multiple priorized mailboxes.
      integer CanTimeoutDurationFactor: 1..4294967295, set at pre-compile, default-value=10000  # Specifies the maximum number of loops for blocking function until a timeout is raised in short term wait loops. This value is used for all hardware loop checks. RESTRICTIONS: 'CanTimeoutDurationFactor' is only available, if 'CanHardwareLoopCheck' is enabled.
      boolean CanVersionInfoApi: set at pre-compile, default-value=false  # Switches the Can_GetVersionInfo() API ON or OFF.
      boolean CanWakeupSupport: set at pre-compile, default-value=false  # CAN driver support for wakeup over CAN Bus. RESTRICTIONS: 'CanWakeupSupport' is only available when Hardware supports Wakeup over Bus.
      boolean CanProdErrorDetection: set at pre-compile, origin=Vector Informatik, default-value=true  # Switches the Production Error Detection and Notification ON or OFF. Use Dem_ReportError functionality to report production errors
      integer CanMaxControllerTableSize [0..1]: 1..255, set at pre-compile in variant pre-compile / link in variant link-time+post-build, origin=Vector Informatik, default-value=8  # The amount of all controllers. This is the table size in RAM to handle the controllers. Set it to a maximum value that will not been exceeded, for future use (adding controllers). RESTRICTIONS: 'CanMaxControllerTableSize' is only used within postbuild variant.
      integer CanMaxNrOfTxObjects [0..1]: 1..255, set at pre-compile in variant pre-compile / link in variant link-time+post-build, origin=Vector Informatik, default-value=20  # Max Number Of Tx Pdu | The amount of all Tx messages/PDU (normal Tx and FullCAN Tx) over all controllers. This is the table size in RAM to handle the mailboxes. Set it to a maximum value that will not been exceeded (you may like to set use more Tx messages at postbuild time than at link time). RESTRICTIONS: 'CanMaxNrOfTxObjects' is only used within postbuild variant.
      integer CanModuleStartAdress [0..1]: 0..4294967295, set at pre-compile in variant pre-compile / link in variant link-time+post-build, origin=Vector Informatik  # Memory start address for postbuild data. RESTRICTIONS: 'CanModuleStartAdress' is only used within postbuild variant.
      boolean CanGenericPrecopy: set at pre-compile, origin=Vector Informatik, default-value=false  # Generic Precopy function activation. A generic precopy, common for all Rx events will be called
      boolean CanDevTimeoutDetect: set at pre-compile, origin=Vector Informatik, default-value=false  # Report CAN_E_TIMEOUT DEM as DET 0x07 notification. RESTRICTIONS: 'CanDevTimeoutDetect' is only available, if 'CanDevErrorDetection' is enabled.
      integer CanConfigurationId [0..1]: 0..4294967295, set at pre-compile in variant pre-compile / link in variant link-time / post-build in variant post-build, origin=Vector Informatik, default-value=0  # This ID provides the unique identifier of the post-build configurable configuration part. (Use this unique ID to verify correct version of configuration data) RESTRICTIONS: 'CanConfigurationId' is only used within postbuild variant.
      boolean CanHardwareLoopCheck: set at pre-compile, origin=Vector Informatik, default-value=true  # Under some conditions, the CAN driver has to wait for hard-ware dependent events. Waiting is done in a so-called 'Hardware Loop'. To secure that this loop will not called infinite, only a given amount of loops will be performed and than the loop is breaked. Activating this feature you have to define the Timeout Du-ration as the loop count where the loop will be breaked and the code just continue and a DEM notification appear. RESTRICTIONS: 'CanHardwareLoopCheck' is only available, if hardware supports/needs this.
      boolean CanMemMapping [0..1]: set at pre-compile, origin=Vector Informatik, default-value=false  # Not Used. Mem Mapping for generated data
      boolean CanSecureTempBuffer [0..1]: set at pre-compile, origin=Vector Informatik, default-value=false  # Using temporary Rx buffer in hw-mailbox object to secure buffer RESTRICTIONS: 'CanSecureTempBuffer' is only available, if hardware supports a secure memory section for rx data buffering.
      integer CanBaudrateQuartzFrequency [0..1]: set at pre-compile in variant pre-compile / link in variant link-time / post-build in variant post-build, origin=Vector Informatik  # Quartz frequency in kHertz used for baudrate calculation
      string CanUserConfigFile [0..1]: set at pre-compile, origin=Vector Informatik  # Path of User confiuration file to setup specials see Technical Reference of the CAN driver
      boolean CanRxFullCANSupport: set at pre-compile, origin=Vector Informatik, default-value=true  # Use this feature when your configuration include Rx FullCAN mailboxes. Deactivate it to save ROM and runtime consumption.
      boolean CanTxFullCANSupport: set at pre-compile, origin=Vector Informatik, default-value=true  # Use this feature when your configuration include Tx FullCAN mailboxes. Deactivate it to save ROM and runtime consumption.
      boolean CanRxBasicCANSupport: set at pre-compile, origin=Vector Informatik, default-value=true  # Use this feature when your configuration include Rx BasicCAN mailboxes. Deactivate it to save ROM and runtime consumption.
      boolean CanUseNestedCANInterrupts: set at pre-compile, origin=Vector Informatik, default-value=false  # CAN ISRs from different controllers can interrupt each other (only with higher priority). deactivate to reduce runtime consumption. RESTRICTIONS: 'CanUseNestedCANInterrupts' is only available, if hardware supports this by mean higher prior interruts can be configured to interrupt CAN interrupts.
      boolean CanHardwareCancelByAppl: set at pre-compile, origin=Vector Informatik, default-value=false  # Hardware Loop check cancelation timeout observation done by application if activated. (Handling of Hardware Loop Check done by application - Timeout duration will be ignored) ApplCanTimerStart() ApplCanTimerLoop() ApplCanTimerEnd() Callbacks has to be implemented in application. RESTRICTIONS: 'CanHardwareCancelByAppl' is only available, if 'CanHardwareLoopCheck' is enabled.
      boolean CanIndividualProcessing [0..1]: set at pre-compile, origin=Vector Informatik, default-value=false  # Activate this when you like to configure each Rx and Tx mailbox object separate (deactivate to reduce runtime and memory consumption). RESTRICTIONS: 'CanIndividualProcessing' influences the settings of 'CanRxProcessing' and 'CanTxProcessing'. It is only available, if hardware supports/needs this and Highend licence is given.
      enumeration CanPowerDownModeSelect: {Local, Global}, set at pre-compile, origin=Vector Informatik, default-value=Local  # The Sleep Mode can be achieved by either a global power down or a local power down of the DCAN module. The global mechanism is controlled by the PCR module while the local one is controlled within the DCAN registers.
      boolean CanGenericConfirmation: set at pre-compile, origin=Vector Informatik, default-value=false  # Generic Confirmation function activation. A generic confirmation, common for all Tx events will be called
      boolean CanRxQueue [0..1]: set at pre-compile, origin=Vector Informatik, default-value=false  # Rx Queue activation. All Rx events will be queued (id, dlc and data) and processed when calling Can_MainFunction_Read() RESTRICTIONS: 'CanMultipleBasicCANObjects' is only available, if hardware supports/needs this and Highend licence is given.
      boolean CanSupportMixedID: set at pre-compile, origin=Vector Informatik, default-value=false  # Force mixed ID handling while compile time to be free af-terwards using standard, extended or mixed IDs. No more ID type optimization! RESTRICTIONS: 'CanSupportMixedID' is only available, if hardware supports mixed ID handling. And it is not modify-able when mixed ID used in database.
      integer CanRxQueueSize [0..1]: 1..255, set at pre-compile, origin=Vector Informatik, default-value=10  # Size of the Rx Queue. how many messages will be buffered. If no Can_Mainfunction_Read() is called there will be overruns after receive this amount of messages. RESTRICTIONS: 'CanRxQueueSize' is only available, if 'CanRxQueue' is enabled.
      boolean CanMultipleBasicCANObjects [0..1]: set at pre-compile, origin=Vector Informatik, default-value=false  # Activate this when you like to optimized Basic CAN reception by use more than one Filter. RESTRICTIONS: 'CanMultipleBasicCANObjects' is only available, if hardware supports/needs this and Highend licence is given.
      enumeration CanHardwareHandleType: {UINT8, UINT16}, set at pre-compile, origin=Vector Informatik, default-value=UINT8  # Depend on the Platform, there is the need to use more than 8bit 'hardware mailbox handles' (defined by AutoSar 3.x). So it is possible to use 8bit or 16bit types (defined by AutoSar 4.x). RESTRICTIONS: 'CanHardwareHandleType' need to be set to 8bit when CanInterface without this support is used (Vector Interface >= 4.12 support 16bit).
      boolean CanDynamicFullCANTxID: set at pre-compile, origin=Vector Informatik, default-value=true  # FullCAN Tx ID will be used dynamic (inside Can_Write()). If this option is activated FullCAN Tx IDs will be written for each Can_Write() call. Otherwise this ID will be only written in Can_InitController(). This will save runtime. 'CanDynamicFullCANTxID' does only work when FullCAN Tx are used.
      boolean CanOptimizeOneController: set at pre-compile, origin=Vector Informatik, default-value=false  # Optimize runtime for One Controller system. RESTRICTIONS: 'CanOptimizeOneController' does only work when one controller is used, and limited to one controller in case of postbuild (CanMaxControllerTableSize).
      integer CanErrata22Iterations: 0..65535, set at pre-compile, origin=Vector Informatik, default-value=255  # This is the number of iterations for the dummy "while" loop implemented due to DCAN#22 erratum. The user has to calibrate this value according to the CPU and CAN clock. In case that DCAN#22 erratum workaround is disabled (C_DISABLE_DCAN_ISSUE22_WORKAROUND is defined) then this value becomes irrelevant for the code. RESTRICTIONS: According to Texas Intruments the run-time corresponding to this dummy "while" loop must be at least 6 CAN clock input clocks.
      enumeration CanInterruptCategory [0..1]: {CATEGORY2, CATEGORY1, VOIDFUNCVOID}, set at pre-compile in variant pre-compile / link in variant link-time+post-build, origin=Vector Informatik, default-value=CATEGORY2  # Specifies the type of Interrupt Function. Category 1: Interrupt Function has to be added to the interrupt vector table. Category 2: Interrupt Function is defined with ISR() define. void Func(void): Interrupt Function is defined as void Func(void) function. RESTRICTIONS: 'Category 2' is only relevant when AutoSar or OSEK OS is used otherwise the Interrupt will be Category 1.
      boolean CanGetStatus [0..1]: set at pre-compile, origin=Vector Informatik, default-value=false  # Support Can_GetStatus() API that return the hardware states: CAN_STATUS_STOP, CAN_STATUS_INIT, CAN_STATUS_INCONSISTENT, CAN_STATUS_WARNING, CAN_STATUS_PASSIVE, CAN_STATUS_BUSOFF, CAN_STATUS_SLEEP
      enumeration CanInterruptLock [0..1]: set at pre-compile, origin=Vector Informatik, default-value=DRIVER  # Disable and Restore Can Interrupt by CAN Driver or Application or CAN Driver and Application. Reason may be, that the CAN driver should not access the Interrupt controller for CAN interrupts or there are other restrictions (special security level) or Application has to care about additional Interrupts like Wakeup.
        DRIVER  # Driver lock Interrupts
        APPL  # Application lock Interrupts
        BOTH  # Driver lock Interrupts and Notification to Appl
      boolean CanPnEnable [0..1]: set at pre-compile, origin=Vector Informatik, default-value=false  # Partial Network Enable | Activate this when you like to support a parital network that will be woken up by special NM message. This feature have to be enabled if one of the controllers will wakeup by partial network transceiver.
      enumeration CanRamCheck: {None, Active, MailboxNotification}, set at pre-compile, origin=Vector Informatik, default-value=None  # MICROSAR PARAMETER DEFINITION: 'CanRamCheck' Activate RAM check for Rx and Tx mailboxes and call Application notification "ApplCanCorruptMailbox" and "ApplCanMemCheckFailed" in case of RAM is corrupted. Controller will be deactivated and no communication will be processed. None: Feature deactive Active: Feature active and "ApplCanMemCheckFailed" will be called Mailbox Notification: Feature active "ApplCanMemCheckFailed" and "ApplCanCorruptMailbox" will be called
      enumeration CanOverrunNotification: {None, DET, Application}, set at pre-compile, origin=Vector Informatik, default-value=None  # Deactivate Rx Overrun Notification by select 'None' or activate it and call 'DET' or 'Application' in case of overrun occur.
      boolean CanReinitStart: set at pre-compile, origin=Vector Informatik, default-value=false  # ReInitialization While Start Transition | MICROSAR PARAMETER DEFINITION: 'CanReinitStart' process a full controller reinitialization at start transition (include hardware Rx and Tx mailboxes and control registers) This cause significant runtime.
      boolean CanGenericPreTransmit: set at pre-compile, origin=Vector Informatik, default-value=false  # MICROSAR PARAMETER DEFINITION: 'CanGenericPreTransmit' A generic pretransmit, common for all Tx messages will be called when this checkbox is enabled. Use this to change data or abort transmission right before the message will be send.
      boolean CanIdenticalIdCancellation: set at pre-compile, origin=Vector Informatik, default-value=true  # Enables/disables cancellation of pending PDUs with identical ID. 'Hardware Transmit Cancelation" also cancel messages with same identifier (newer data will be send) out of hardware mailboxes. otherwise only lower prior identifiers will be cancelled. (older data will be send) RESTRICTIONS: 'CanIdenticalIdCancellation' is only used when CAN Interface parameter 'CanIfTransmitCancellation' is set.
      boolean CanAmdRuntimeMeasurement: set at pre-compile, origin=Vector Informatik, default-value=false  # Activate Amd Runtime Measurement. By including the AmdRtm.h file in the CAN driver source file
      reference CanMainFunctionReadPeriodRef [0..1]: set at pre-compile, destination=CanHardwareObject  # Not Used. Reference to CAN Hardware Object which shall be polled with the configured CanMainFunctionReadPeriod. This reference shall only be configurable if more than one period is configured via CanMainFunctionReadPeriod.
      reference CanMainFunctionWritePeriodRef [0..1]: set at pre-compile, destination=CanHardwareObject  # Not Used. Reference to CAN Hardware Object which shall be polled with the configured CanMainFunctionWritePeriod. This reference shall only be configurable if more than one period is configured via CanMainFunctionWritePeriod.
    container VectorCommonData
      string BswmdVersion: configuration-class-affection=affection-kind=NO-AFFECT, set at published-information, origin=Vector Informatik, default-value=2.12.00
  module config Can_Pre: definition=Can
  module config Can_Rec: definition=Can
