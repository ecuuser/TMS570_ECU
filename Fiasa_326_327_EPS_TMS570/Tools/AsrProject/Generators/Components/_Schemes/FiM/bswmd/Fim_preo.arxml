AUTOSAR XML (schema 3.0.1)
package /MICROSAR
  module config Fim_Pre: definition=Fim, implementation-config-variant=VARIANT-PRE-COMPILE
  module config Fim_Rec: definition=Fim
    FimGeneral: FimDevErrorDetect=false, FimVersionInfoApi=false
