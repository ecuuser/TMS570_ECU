AUTOSAR XML (schema 3.0.2)
package /MICROSAR
  bsw implementation BswM_Impl: code-generator=GENy, programming-language=C, sw-major-version=1, sw-minor-version=9, sw-patch-version=0, vendor-id=30, ar-major-version=2, ar-minor-version=0, ar-patch-version=0, preconfigured-configuration=BswM_Pre, recommended-configuration=BswM_Rec, vendor-specific-module-def=BswM
  module definition BswM [0..1]: variants pre-compile  # Configuration of the BswM (Basic SW Mode Manager) module.
    container BswMConfig: multiple-configuration-container=true  # This container contains the configuration parameters and sub containers of the AUTOSAR BswM module. This container is a MultipleConfigurationContainer, i.e. this container and its sub-containers exist once per configuration set.
      reference BswMEcuMConfigurationRef: set at pre-compile, origin=Vector Informatik, destination=EcuMConfiguration  # Internaly reference used by loader
      container BswMArbitration [0..1]  # This container includes all configuration sub-containers and parameters related to the mode arbitration functionality of the BswM.
        container BswMLogicalExpression [0..*]  # This container describes the logical expressions that can be used for the mode arbitration. The logical expressions are built of a set of arguments and a logical operator. Each argument can either be a mode condition or a sub-expression to allow definition of more complex logical expressions. There may be an unlimited number of arguments in each logical expression. Note that the order of evaluation of the expressions is not defined.
          enumeration BswMLogicalOperator [0..1]: {BSWM_AND, BSWM_NAND, BSWM_OR, BSWM_XOR}, set at pre-compile, origin=Vector Informatik  # This parameter specifies the logical operator to be used in the logical expression. If the expression only consists of a single condition this parameter shall not be used.
          choice reference BswMArgumentRef [1..*]: set at pre-compile, origin=Vector Informatik, destination=[BswMLogicalExpression, BswMModeCondition]  # This is a choice reference either to a mode condition or a sub-expression.
        container BswMModeCondition [0..*]  # This container describes the BswM mode conditions that can be used either by itself to form a rule or as a part of a logical expression.
          enumeration BswMConditionType: {BSWM_EQUALS, BSWM_EQUALS_NOT}, set at pre-compile, origin=Vector Informatik  # This parameter specifies what kind of comparison that is made for the evaluation of the mode condition.
          reference BswMConditionMode: set at pre-compile, origin=Vector Informatik, destination=BswMModeRequestPort  # This parameter references the mode request port that is used for the condition.
          choice container BswMConditionValue  # This container holds the parameters and references necessary to identify the mode type and the value that the mode request is compared to.
            container BswMBswMode [0..1]  # This container defines the value and type of a mode in the BSW.
              string BswMBswRequestedMode: set at pre-compile, origin=Vector Informatik  # This parameter contains the symbolic name (as a string) of a certain mode/state that can be requested/indicated by the BSW modules.
            container BswMUserCondMode [0..1]
              string BswMUserCondition: set at pre-compile, origin=Vector Informatik
        container BswMModeRequestPort [0..*]  # Each instance of this container defines a mode request interface that is used to requests or indicate modes from/to the BswM. These interfaces are implemented as ports or as ordinary C-functions based upon if the request is made by an SW-C or a BSW module. There are different types of mode requests: 1. Mode requests from the SW-C:s 2. Mode Requests from other BSW modules such as the DCM. 3. State/mode indications from the RTE or other BSW modules such as the bus specific State Managers. Note that the BswM treats all request and indications in the exact same way.
          string BswMModeInitValue [0..1]: set at pre-compile, origin=Vector Informatik  # This parameter defines the initial mode value that is used by BswM for the corresponding mode request after initialization. This parameter is optional and shall only be used for Mode Requests that does not already have an initial value.
          enumeration BswMRequestProcessing: {BSWM_DEFERRED, BSWM_IMMEDIATE}, set at pre-compile, origin=Vector Informatik  # This parameter defines if the processing of the mode arbitration shall be done immediately when a mode request is received or if it shall be deferred to the processing of the main function of BswM.
          enumeration BswMModeReqPortType: {BSWM_BSW_MODE, BSWM_BSW_PREV_MODE, BSWM_GEN_MODE, BSWM_TIMER_MODE}, set at pre-compile, origin=Vector Informatik  # This Attribute is an internal model attribute.
          choice container BswMModeRequestSource  # This choice container specifies the source of the mode request or state/mode indication. The requester of a mode can be both SW-C:s and other BSW Modules, such as the bus specific State Managers.
            container BswMCanSMIndication [0..1]  # This is an indication of the current state of the CAN State Manager.
              symbolic name reference BswMCanSMChannelRef: set at pre-compile, origin=Vector Informatik, destination=CanStateManagerNetworks  # This is a reference to the CAN channel handle that the mode request corresponds to.
            container BswMComMIndication [0..1]  # This is an indication of the current communication mode of a channel in the Communication Manager.
              symbolic name reference BswMComMChannelRef: set at pre-compile, origin=Vector Informatik, destination=ComMChannel  # This is a reference to the Communication Manager channel handle that the indication corresponds to.
            container BswMDcmComModeRequest [0..1]  # The source of the mode request is the Diagnostic Communication Manager.
              reference BswMDcmComMNetworkRef: set at pre-compile, origin=Vector Informatik, destination=ComMChannel
            container BswMDcmResetModeRequest [0..1]  # This is a reset mode request from the DCM. This container does not contain any parameters since there are no further configuration needed for this type of request.
            container BswMFrSMIndication [0..1]  # This is an indication of the current state of the FlexRay State Manager.
              symbolic name reference BswMFrSMChannelRef: set at pre-compile, origin=Vector Informatik, destination=FrSmCluster  # This is a reference to the FlexRay Cluster handle that the mode request corresponds to.
            container BswMGenericRequest [0..1]  # This mode request originates from a requester that is not among the list of standardized mode requesters (i.e. the different resource managers).
              string BswMTriggerFunction: set at pre-compile, origin=Vector Informatik
              boolean BswMUseRte: set at pre-compile, origin=Vector Informatik, default-value=false
              enumeration BswMPortInterfaceType: {BSWM_CLIENT_SERVER, BSWM_SENDE_RECEIVER}, set at pre-compile, origin=Vector Informatik, default-value=BSWM_CLIENT_SERVER  # Defines the port interface type.
              container BswMGenericMode [0..*]
                integer BswMGenericModeId: 0..255, set at pre-compile, origin=Vector Informatik, default-value=0
            container BswMLinSMIndication [0..1]  # This is an indication of the current state of the LIN State Manager.
              symbolic name reference BswMLinSMChannelRef: set at pre-compile, origin=Vector Informatik, destination=LinSMChannel  # This is a reference to the LIN channel handle that the mode request corresponds to.
            container BswMLinTpModeRequest [0..1]  # This is a LinTp mode request from the LinIf. This port corresponds to a call of the BswM_LinTp_RequestMode API.
              symbolic name reference BswMLinTpChannelRef: set at pre-compile, origin=Vector Informatik, destination=LinIfChannel  # This is a reference to the LIN Interface Channel that the mode request corresponds to.
            container BswMNmModeRequest [0..1]  # This is an indication of the current state of the Nm.
              reference BswMNmNetworkRef: set at pre-compile, origin=Vector Informatik, destination=NmFiatBChannelConfig  # This is a reference to the Fiat Class B channel container that the mode request corresponds to.
            container BswMLinSMCurrentSchedule [0..1]  # This is an indication of the current schedule of the LIN State Manager.
              reference BswMLinSMChannelRef: set at pre-compile, origin=Vector Informatik, destination=LinSMChannel  # This is a reference to the LIN channel handle that the mode request corresponds to.
            container BswMComMPncModeRequest [0..1]  # This is a mode request of the Communication Manager when a PNC state changes.
              reference BswMComMPncRef: set at pre-compile, origin=Vector Informatik, destination=ComMPnc  # This is a reference to the Communication Manager PNC handle that the mode request corresponds to.
            container BswMTimer [0..1]
              integer BswMTimerValue: 0..65535, set at pre-compile, origin=Vector Informatik, default-value=0  # Specify the initial timer value that is used when the timer is started.
            container BswMLinSMScheduleEnd [0..1]  # This is an indication of the schedule end of the current schedule table.
              reference BswMLinSMChannelRef: set at pre-compile, origin=Vector Informatik, destination=LinSMChannel  # This is a reference to the LIN channel handle that the mode request corresponds to.
            container BswMNmClassCModeRequest [0..1]  # This is an indication of the current state of the Nm Class C.
              reference BswMNmNetworkRef: set at pre-compile, origin=Vector Informatik, destination=NmFiatCChannelConfig  # This is a reference to the Fiat Class C channel container that the mode request corresponds to.
            container BswMNmDirOsekModeRequest [0..1]  # This is an indication of the current state of the Nm Osek.
              reference BswMNmNetworkRef: set at pre-compile, origin=Vector Informatik, destination=Nm_DirOsekChannelConfig  # This is a reference to the OSEK Network Management channel container that the mode request corresponds to.
        container BswMRule [0..*]  # Each instance of this container describes a BswM arbitration rule. The rule either consists of a simple mode condition or a more complex logical expression. This container also references the action lists that shall be invoked when the rule is evaluated to True or False.
          enumeration BswMRuleInitState: {BSWM_FALSE, BSWM_TRUE, BSWM_UNDEFINED}, set at pre-compile, origin=Vector Informatik  # This parameter is a part of the reset/initialization behavior of BswM. Action lists are executed when the result of a rule evaluation have changed since the last evaluation. This parameter defines the "previous evaluation result" of a rule to be used after initialization of the BswM. If this parameter is set to BSWM_UNDEFINED, the evaluation result is always treated as changed at the first evaluation of the rule after initialization. If this parameter is set to BSWM_TRUE, the evaluation result is treated as changed if the rule is evaluated to false. If this parameter is set to BSWM_FALSE, the evaluation result is treated as changed if the rule is evaluated to true.
          reference BswMRuleExpressionRef: set at pre-compile, origin=Vector Informatik, destination=BswMLogicalExpression  # This choice reference either references the mode condition or the logical expression that is evaluated for each rule.
          reference BswMRuleFalseActionList [0..1]: set at pre-compile, origin=Vector Informatik, destination=BswMFalseActionList  # This is a reference to the action list that shall be executed when the rule is evaluated to False
          reference BswMRuleTrueActionList [0..1]: set at pre-compile, origin=Vector Informatik, destination=BswMTrueActionList  # This is a reference to the action list that shall be executed when the rule is evaluated to True
      container BswMModeControl [0..1]  # This container includes all configuration sub-containers and parameters related to the mode control functionality of the BswM.
        container BswMAction [0..*]  # Each container of this type defines an action. These actions can be part of one or several action lists.
          choice container BswMAvailableActions  # Choice container including the available actions to be used in the action lists.
            container BswMDeadlineMonitoringControl [0..1]  # This container includes all parameters related to enabling and disabling of deadline monitoring for one or several PDUs in COM.
              enumeration BswMDMControl: {BSWM_ENABLE_RX_DM, BSWM_DISABLE_RX_DM}, set at pre-compile, origin=Vector Informatik
              symbolic name reference BswMDMPduGroupRef [0..*]: set at pre-compile, origin=Vector Informatik, destination=ComIPduGroup  # This is a reference to a PDU Group for which the Deadline Monitoring should be enabled.
            container BswMLinScheduleSwitch [0..1]  # This container includes all parameters related to a switch of LIN schedule table.
              symbolic name reference BswMLinScheduleRef: set at pre-compile, origin=Vector Informatik, destination=LinIfScheduleTable  # This is a reference to the LIN schedule table that the LIN SM shall change to.
              reference BswMLinChannelRef: set at pre-compile, origin=Vector Informatik, destination=LinIfChannel
            container BswMNMControl [0..1]  # This container includes all parameters related to enabling and disabling of Network Management communication. Disabling of NM communication can be requested by DCM.
              enumeration BswMNMAction: {BSWM_NM_DISABLE, BSWM_NM_ENABLE}, set at pre-compile, origin=Vector Informatik  # This parameter specifies if the communication of the corresponding NM channel should be enabled or disabled.
              symbolic name reference BswMNMChannelRef: set at pre-compile, origin=Vector Informatik, destination=NmChannelConfig  # This is a reference to the NM Channel for which the communication should be enabled or disabled.
            container BswMPduGroupSwitch [0..1]  # This container includes references to the PDU groups that shall be enabled and disabled.
              boolean BswMPduGroupSwitchReinit: set at pre-compile, origin=Vector Informatik, default-value=false  # This parameter defines if the the values for the parameters like periodical timer, minimum delay timer etc is retainer or reinitialized during a PDU Group Switch.
              enumeration BswMPduGroupSwitchType: {BSWM_PDU_GROUP_START, BSWM_PDU_GROUP_STOP}, set at pre-compile, origin=Vector Informatik
              symbolic name reference BswMPduGroupRef [0..*]: set at pre-compile, origin=Vector Informatik, destination=ComIPduGroup  # This is a reference to a PDU Group that should be enabled.
            container BswMPduRouterControl [0..1]  # This container includes all parameters related to enabling and disabling of routing of Routing Path Groups in the PDU Router.
              enumeration BswMPduRouterAction: {BSWM_PDUR_DISABLE, BSWM_PDUR_ENABLE}, set at pre-compile, origin=Vector Informatik  # This parameter specifies if the routing of the corresponding PDU should be enabled or disabled.
              symbolic name reference BswMPduRoutingPathGroupRef [0..*]: set at pre-compile, origin=Vector Informatik, destination=PduRRoutingPathGroup  # This is a reference to the PDU Routing Path Group for which the routing in the PDU Router should be enabled or disabled.
            container BswMUserCallout [0..1]  # This container includes all details needed for a user defined function call.
              string BswMUserCalloutFunction: set at pre-compile, origin=Vector Informatik  # This parameter specifies the complete function call including all parameters. The parameters are specified during configuration time, and cannot be changed during run time. Any return values passed by the callout will be ignored.
            container BswMTimerControl [0..1]
              enumeration BswMTimerAction: {BSWM_TIMER_START, BSWM_TIMER_STOP}, set at pre-compile, origin=Vector Informatik, default-value=Vector Informatik  # Specify the action for the timer. The timer can be started or stopped.
              reference BswMTimerRef: set at pre-compile, origin=Vector Informatik, destination=BswMModeRequestPort  # Specify the Timer Name string for which the timer action shall be executed.
            container BswMModeChange [0..1]
              reference BswMSourceModeRef: set at pre-compile, origin=Vector Informatik, destination=BswMModeRequestPort
              reference BswMNotifiedModeRef: set at pre-compile, origin=Vector Informatik, destination=BswMGenericMode
        container BswMTrueActionList [0..*]  # Each instance of this container defines an action list that is invoked based on the BswM Rules. An action list contains a list of numbered action items to be processed. An action list can also include other action lists.
          enumeration BswMActionListExecution: {BSWM_CONDITION, BSWM_TRIGGER}, set at pre-compile, origin=Vector Informatik  # This parameter controls if the corresponding action list shall be executed every time the rule is evaluated or only when the result of the evaluation changes.
          container BswMActionListItem [1..*]  # This container defines an item in an action list.
            boolean BswMAbortOnFail: set at pre-compile, origin=Vector Informatik, default-value=false
            choice reference BswMActionListItemRef: set at pre-compile, origin=Vector Informatik, destination=[BswMAction, BswMActionList, BswMRule]  # The action item can either be an atomic action or a reference to another action list or rule.
        container BswMFalseActionList [0..*]  # Each instance of this container defines an action list that is invoked based on the BswM Rules. An action list contains a list of numbered action items to be processed. An action list can also include other action lists.
          enumeration BswMActionListExecution: {BSWM_CONDITION, BSWM_TRIGGER}, set at pre-compile, origin=Vector Informatik  # This parameter controls if the corresponding action list shall be executed every time the rule is evaluated or only when the result of the evaluation changes.
          container BswMActionListItem [1..*]  # This container defines an item in an action list.
            boolean BswMAbortOnFail: set at pre-compile, origin=Vector Informatik, default-value=false
            choice reference BswMActionListItemRef: set at pre-compile, origin=Vector Informatik, destination=[BswMAction, BswMActionList, BswMRule]  # The action item can either be an atomic action or a reference to another action list or rule.
    container BswMGeneral  # General configuration parameters of the Basic SW Mode Manager.
      boolean BswMDevErrorDetect: set at pre-compile, origin=Vector Informatik, default-value=true  # If 'Development Error Detection' is enabled, all development errors are reported to the Development Error Tracer (DET). The errors are described in the TechnicalReference_BswM.pdf. Note: In general, the development error detection is recommended during pre-test phase. It is not recommended to enable the development error detection in production code due to increased runtime and ROM needs.
      float BswMMainFunctionPeriod: 0.001..10, set at pre-compile, origin=Vector Informatik, default-value=0.01  # The cycle time of the periodic main function of BswM. Defined in seconds .
      boolean BswMVersionInfoApi: set at pre-compile, origin=Vector Informatik, default-value=true  # En-/ disables the function BswM_GetVersionInfo() to get the major, minor and patch version information.
      boolean BswMDcmComControl: set at pre-compile, origin=Vector Informatik, default-value=false  # En-/ disables the Dcm communication control modes of the BswM.
      boolean BswMDcmResteMode: set at pre-compile, origin=Vector Informatik, default-value=false  # Dcm Reset Mode | En-/ disables the Dcm reset modes of the BswM.
      string BswMHeaderFilesPath [0..1]: set at pre-compile, origin=Vector Informatik  # Specify the path to a header file which contains the prototypes for the user condition functions and user callout functions, if required.
      string BswMSoftwareComponentName: set at pre-compile, origin=Vector Informatik, default-value=BswM  # This name is used as component name (ShortName) in the generated software component template. Change this name if you try to import the BswM components of several ECUs and have problems with name clashes.
      boolean BswMDcmPassiveMode: set at pre-compile, origin=Vector Informatik, default-value=false  # En-/ disables the Dcm Passive Mode Handling of the BswM.
      boolean BswMDcmApplicationUpdated: set at pre-compile, origin=Vector Informatik, default-value=false
      boolean BswMDcmApplUpdateAsModePort: set at pre-compile, origin=Vector Informatik, default-value=false
      boolean BswMDcmResetExecutionRequest: set at pre-compile, origin=Vector Informatik, default-value=false  # True: The BswM triggers the Dcm reset mode request after the Bswm is informed about the reset execution by requesting DCM_RESET_EXECUTION from the Dcm False: The BswM executes the Dcm reset mode request immediatly, means the BswM wait not for the Dcm request DCM_RESET_EXECUTION
      boolean BswMAmdRuntimeMeasurement: set at pre-compile, origin=Vector Informatik, default-value=false  # This parameter defines if AMD Runtime Measurement (RTM) is enabled for this module.
    container VectorCommonData
      string BswmdVersion: set at published-information, origin=Vector Informatik, default-value=1.10.00  # Bswmd version
  module config BswM_Pre: definition=BswM
  module config BswM_Rec: definition=BswM
