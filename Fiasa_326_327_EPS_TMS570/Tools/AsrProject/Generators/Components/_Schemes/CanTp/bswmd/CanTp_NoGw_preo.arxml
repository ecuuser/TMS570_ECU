AUTOSAR XML (schema 3.0.1)
package /MICROSAR
  module config CanTp_Pre: definition=CanTp
    CanTpGeneral: CanTpFFProvide2RxBufferCalls=false
