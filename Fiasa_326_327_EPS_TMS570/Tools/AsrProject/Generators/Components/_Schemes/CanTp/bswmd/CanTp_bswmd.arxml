AUTOSAR XML (schema 3.0.1)
# COPYRIGHT
# Copyright (c) 2012-2013 by Vector Informatik GmbH. All rights reserved.
# This software is copyright protected and proprietary to Vector Informatik GmbH.
# Vector Informatik GmbH grants to you only those rights as set out in the license conditions.
package /MICROSAR
  bsw implementation CanTp_Impl: code-generator=GENy, programming-language=C, sw-major-version=1, sw-minor-version=25, sw-patch-version=0, vendor-id=30, ar-major-version=2, ar-minor-version=4, ar-patch-version=0, preconfigured-configuration=CanTp_Pre, recommended-configuration=CanTp_Rec, vendor-specific-module-def=CanTp
  module definition CanTp [0..1]: refined-module-def=CanTp, variants pre-compile/post-build  # Configuration of the CanTp (CAN Transport Protocol) module.
    container CanTpGeneral  # This container contains the general configuration parameters of the CanTp module.
      boolean CanTpDevErrorDetect: set at pre-compile, default-value=false  # Switches the Development Error Detection and Notification ON or OFF. If 'Development Error Detection' is enabled, development errors are reported to the Development Error Tracer (DET). The following development errors may occur within the CanTp: - service call without intialization - invalid channel handle - rejection of service call All development errors are reported to the Development Error Tracer. Note: In general, the development error detection is recommended during pre-test phase. It is not recommended to enable the development error detection in production code due to increased runtime and ROM needs.
      float CanTpMainFunctionPeriod: 0..0.255, set at pre-compile in variant pre-compile / post-build in variant post-build, default-value=0.01  # Allow to configure the time period for the scheduling of the CanTp_MainFunction(). This configuration value must be equal to the value in the ScheduleManger module. All internal timed events (e.g. timeouts) of the CanTp are based on this value.
      boolean CanTpTc: configuration-class-affection=affection-kind=PC-AFFECTS-PB, set at pre-compile, default-value=false  # Switches Transmit Cancellation globally ON or OFF. By enabling this switch, each Tx Sdu can be configured separately with or without transmit cancellation. If this switch is disabled, the API 'CanTp_CancelTransmitRequest' is not available, reducing resource consumption.
      boolean CanTpPaddingActive: set at pre-compile, origin=Vector Informatik, default-value=true  # Switches padding globally ON or OFF. By enabling this switch, each Rx/Tx-Sdu can be configured separately with or without padding. If this switch is disabled, then no padding can be used for any Rx/Tx-Sdu.
      boolean CanTpHavePaddingByte: set at pre-compile, origin=Vector Informatik, default-value=false  # Switches usage of the "CanTpPaddingPattern" ON or OFF. By enabling this switch, each Tx-Sdu, if configured with padding, uses the "CanTpPaddingPattern" to fill up unused frame bytes. If this switch is disabled, then no padding pattern is applied to fill up the unused frame bytes. The frame length is extended to 8 bytes but the unused bytes are not stuffed with the padding pattern and so the content is random. RESTRICTIONS: This switch is only available if "CanTpPaddingActive" is enabled.
      integer CanTpPaddingPattern: 0..255, set at pre-compile, origin=Vector Informatik, default-value=170  # Defines the pattern to be used for padding of Sdus if they are configured accordingly. RESTRICTIONS: This setting is only available if "CanTpPaddingActive" and "CanTpHavePaddingByte" are both enabled.
      derived boolean CanTpVersionInfoApi: set at pre-compile, default-value=true  # Switches the the Version Information Api ON or OFF. If enabled, the function CanTp_GetVersionInfo() can be used to get major, minor and patch version of the CanTp.
      integer CanTpMaxNumRxSdus: 0..65535, set at pre-compile in variant pre-compile / link in variant post-build, origin=Vector Informatik  # Defines the maximum number of different N-Sdu-Ids that will be received simultaneously via the CanTp by this ECU.
      integer CanTpMaxNumTxSdus: 0..65535, set at pre-compile in variant pre-compile / link in variant post-build, origin=Vector Informatik  # Defines the maximum number of different N-Sdu-Ids that will be transmitted simultaneously via the CanTp by this ECU.
      integer CanTpPostbuildStartAddress: 0..4294967295, set at pre-compile in variant pre-compile / link in variant post-build, origin=Vector Informatik, default-value=0  # Defines the start address of the post build data. This setting is mandatory when generating a configuration that will be written to the memory of your ECU at post-build time (i.e. when generating a hex-file). This setting is not relevant when generating the initial ECU configuration at link- or pre-compile time (i.e. when generating a C file that will be linked with your project). The module start address must specify the start address of the memory area which the generated hex-file will be mapped to. If the ECU supports selectable post-build configuration, the module start address can be any location that is accessible for the CanTp module. If selectable post-build configuration is not supported by your ECU, the module start address must be the same address to which the initial configuration was mapped. Please see to your linker map file to get this address.
      boolean CanTpAmdRuntimeMeasurement: set at pre-compile, origin=Vector Informatik, default-value=false  # This parameter defines if AMD Runtime Measurement (RTM) is enabled for this module.
      boolean CanTpDynamicChannelAssignment: set at pre-compile, origin=Vector Informatik, default-value=false  # Switches the restriction of the maximum number of simultaneously active Rx and Tx channels ON or OFF. The maximum number of simultaneously active Rx and Tx channels will be restricted when this switch is active. Else, all CanTp Sdus can be active at the same time.
      integer CanTpMaxNumRxChannels: 0..65535, set at pre-compile in variant pre-compile / post-build in variant post-build, origin=Vector Informatik, default-value=0  # Defines the maximum number of Rx channels that can be active simultaneously. RESTRICTIONS: This setting only has an effect if "CanTpDynamicChannelAssignment" is enabled.
      integer CanTpMaxNumRxChannels_PbLimit: 0..65535, set at pre-compile in variant pre-compile / link in variant post-build, origin=Vector Informatik, default-value=0  # Defines the maximum for parameter 'CanTpMaxNumRxChannels' that can be set during post build configuration. RESTRICTIONS: This setting only has an effect if "CanTpDynamicChannelAssignment" is enabled.
      integer CanTpMaxNumTxChannels: 0..65535, set at pre-compile in variant pre-compile / post-build in variant post-build, origin=Vector Informatik, default-value=0  # Defines the maximum number of Tx channels that can be active simultaneously. RESTRICTIONS: This setting only has an effect if "CanTpDynamicChannelAssignment" is enabled.
      integer CanTpMaxNumTxChannels_PbLimit: 0..65535, set at pre-compile in variant pre-compile / link in variant post-build, origin=Vector Informatik, default-value=0  # Defines the maximum for parameter 'CanTpMaxNumTxChannels' that can be set during post build configuration. RESTRICTIONS: This setting only has an effect if "CanTpDynamicChannelAssignment" is enabled.
      boolean CanTpProdErrorDetect: set at pre-compile, origin=Vector Informatik, default-value=false  # Switches the Production Error Detection and Notification ON or OFF If 'Production Error Detection' is enabled, production relevant errors are reported to the Diagnostics Event Manager (Dem). Disable this option if no Dem is present in your system.
      boolean CanTpOptimizeSingleConnection: set at pre-compile, origin=Vector Informatik, default-value=false  # Switches the single connection optimization ON or OFF. This option optimizes the CanTp implementation for code size. If enabled, the CanTp supports only one physical Rx connection, one functional Rx connection and one physical Tx connection.
      boolean CanTpOptimizeSingleConnPrec: set at pre-compile, origin=Vector Informatik, default-value=false  # Switches the single connection precompile optimization ON or OFF. If enabled, the CanTp implementation is optimized for code size and only supports one physical Rx connection, one functional Rx connection and one physical Tx connection. Additionally the connections are configured at precompile time and can not changed at a later time. RESTRICTIONS: This setting is only available if "CanTpOptimizeSingleConnection" is enabled and a precompile configuration is used.
      boolean CanTpEnableSplitMainFunction: configuration-class-affection=affection-kind=NO-AFFECT, set at pre-compile, origin=Vector Informatik, default-value=false  # Switches the usage of two separate tasks CanTp_MainFunctionTx() and CaTp_MainFunctionRx() instead of one single task ON or OFF. If enabled, the CanTp_Mainfunction() is split into two seperate tasks called CanTp_MainFunctionTx() and CanTp_MainFunctionRx(). Instead of calling one main function it can be more efficient to call the Rx and Tx side of the CanTp separately to accomplish an optimal task call sequence. The CanTp_MainFunction() can still be used. It calls both separate tasks successively.
      boolean CanTpEnableExtendedApiSTMin: set at pre-compile, origin=Vector Informatik, default-value=false  # Switches the support for runtime configuration of "STmin" for Flow Control frames ON or OFF. If enabled, the additional CanTp_SetSTmin() API function is supported which allows to set the 'STmin' (minimum separation time) byte within Flow Control frames dynamically at runtime.
      boolean CanTpEnableExtendedApiBs: set at pre-compile, origin=Vector Informatik, default-value=false  # Switches the support for runtime configuration of "Bs" for Flow Control frames ON or OFF. If enabled the additional CanTp_SetBS() API function is supported which allows to set the "Bs" (BlockSize) byte within Flow Control frames dynamically at runtime.
      string CanTpUserConfigFile [0..1]: set at pre-compile, origin=Vector Informatik  # Path to an external user config file used by the GENy generation tool. If you want to overwrite some of the settings in the generated configuration file (CanTp_Cfg.h), you can specify a path to a user defined configuration file. The user defined configuration file will be included at the end of the generated preprocessor switches. Definitions in the user defined configuration file can overwrite definitions in the generated configuration file. RESTRICTIONS: Not all of the settings can be overwritten simply by triggering the preprocessor switch. Some of the options are complex and the code generator generates less or more code depending on the setting. USE SUCH A FILE ONLY AFTER DISCUSSION WITH VECTOR.
      boolean CanTpEnableRxNSduIdRemapping: set at pre-compile, origin=Vector Informatik, default-value=false  # Switch the support for Rx N-Sdu Id remapping ON or OFF. If enabled, the Rx N-Sdu Identifier for each N-Sdu, which is used for the upper layer communication, is determined by the PduR configuration.
      boolean CanTpEnableTxNSduIdRemapping: set at pre-compile, origin=Vector Informatik, default-value=false  # Switch the support for Tx N-Sdu Id remapping ON or OFF. If enabled, the Tx N-Sdu Identifier for each N-Sdu, which is used for the upper layer communication, is configurable by the user.
      boolean CanTpSupportFullBufferHandlingRx: set at pre-compile, origin=Vector Informatik, default-value=true  # Switch the support for paged buffer handling ON or OFF. The CanTp API requires the application to provide buffers during transmission and reception. If this option is enabled, these buffers may be smaller than the CanTp message received or transmitted. If this option is disabled, this buffer must be large enough to receive the complete CanTp message.
      boolean CanTpSupportFullBufferHandlingTx: set at pre-compile, origin=Vector Informatik, default-value=true  # Switch the support for paged buffer handling ON or OFF. The CanTp API requires the application to provide buffers during transmission and reception. If this option is enabled, these buffers may be smaller than the CanTp message received or transmitted. If this option is disabled, this buffer must be large enough to transmit the complete CanTp message.
      boolean CanTpSupportStandardAddressing: set at pre-compile, origin=Vector Informatik, default-value=true  # Switch the support for Standard Addressing ON or OFF. This switch enables/disables the support for the addressing format "Standard Addressing" defined by the AUTOSAR standard. For optimization purposes, the support can be disabled. For full AUTOSAR compatibility, this switch must be enabled.
      boolean CanTpSupportExtendedAddressing: set at pre-compile, origin=Vector Informatik, default-value=true  # Switch the support for Extended Addressing ON or OFF. This switch enables/disables the support for the addressing format "Extended Addressing" defined by the AUTOSAR standard. For optimization purposes, the support can be disabled. For full AUTOSAR compatibility, this switch must be enabled.
      boolean CanTpSupportMixed11Addressing: set at pre-compile, origin=Vector Informatik, default-value=true  # Switch the support for Mixed11 Addressing ON or OFF. This switch enables/disables the support for the addressing format "Mixed11 Addressing". This addressing format is not part of the AUTOSAR standard.
      boolean CanTpEnableAr40CompliantPduRApi: set at pre-compile, origin=Vector Informatik, default-value=false  # Switch the usage of an AUTOSAR 4.0 compatible PduR Api ON or OFF If enabled, the CanTp will use an AUTOSAR 4.0 compliant PduR Api. As soon as there is a Vector PduR in your GENy configuration, the CanTp will automatically adapt to the API settings given by the PduR configuration.
      boolean CanTpFFProvide2RxBufferCalls: set at pre-compile, origin=Vector Informatik, default-value=false  # Switch support for accelerated transmission of routed messages ON or OFF. If this switch is enabled, the FF is transmitted immediately by the PduR without internal buffering.
      boolean CanTpSuppressPrePassIndication: set at pre-compile, origin=Vector Informatik, default-value=false  # Switch the support for "PrePass" notification of the Dem in case of successful reception or transmission ON or OFF. If this switch is enabled, the Dem will not be notified any longer upon succesful reception or transmission of CanTp messages. The "PreFail" Dem notification upon unsuccessful reception or transmission of CanTp messages is not affected.
      boolean CanTpExtErrorDetect: set at pre-compile, origin=Vector Informatik, default-value=false  # Switch the detection of additional internal development errors ON or OFF. If this switch is enabled, a user callback "void vCanTp_ReportError( uint16 ModuleId, uint8 InstanceId, uint8 ApiId, uint16 ErrorId, uint32 ErrorParam );" has to be provided by the application which is called in case of internal errors. This enhanced error detection is provided by Vector Informatik beyond the AUTOSAR specification.
      boolean CanTpHasRxIndication: set at pre-compile, origin=Vector Informatik, default-value=true  # Switch the Rx Indication function ON or OFF. If enabled, the CanTp has an Rx Indication function. If disabled, the CanTp will not be able to receive Pdus from the CanIf, and hence will not be able to receive FlowControl Pdus in Tx Sdus or support Rx Sdus.
      boolean CanTpHasTxConfirmation: set at pre-compile, origin=Vector Informatik, default-value=true  # Switch the Tx Confirmation function ON or OFF. If enabled, the CanTp has a Tx Confirmation function. If disabled, the CanTp will not be able to transmit Pdus, and hence will not be able to send FlowControl Pdus in Rx Sdus or support Tx Sdus.
      boolean CanTpHasInitCfgPtr: set at pre-compile, origin=Vector Informatik, default-value=false  # Switch the support for configuration pointers for the CanTp_Init() function ON or OFF. If enabled, then a pointer to a configuration structure is passed to the CanTp_Init() function. If disabled, then the only one available configuration, defined at link time, is used by default. The CanTp_Init() function is called with a void parameter.
      boolean CanTpChangeParameterReqApi: set at pre-compile, origin=Vector Informatik, default-value=false  # When switched on, the functions "CanTp_ChangeParameterRequest" and "CanTp_ReadParameterRequest" are provided which can be used to change/read the values of the reception parameters CanTpBs and CanTpSTmin. If switched on, the PduR module must provide the function "PduR_CanTpChangeParameterConfirmation" that can be switched on in the PduR module using the "PduRCanTpChangeParameterReqApi" switch.
      boolean CanTpStrictRxCallSeq: set at pre-compile, origin=Vector Informatik, default-value=false  # When switched off, the reception sequence will always be kept independent of the buffer provision return value, i.e. the PduR_CanTpRxIndication will always be called during a reception, even if the application has already returned that no buffer is available (BUFREQ_E_NOT_OK). When switched on, the Indication function will only be called if the corresponding Buffer-Provision had returned a value different from BUFREQ_E_NOT_OK.
      boolean CanTpRc: set at pre-compile, origin=Vector Informatik, default-value=false  # Switches Receive Cancellation ON or OFF. If this switch is disabled, the API 'CanTp_CancelReceiveRequest' is not available, reducing resource consumption.
      boolean CanTpRcNotifyAlways: set at pre-compile, origin=Vector Informatik, default-value=false  # Switches upper layer notification of receive cancellation ON or OFF. This is an addititional non AUTOSAR switch which is needed for compatibility reasons. In case there are upper layer modules (e.g. Dcm) which require a final indication or confirmation, this switch may be used to hand a final negative notification (NTFRSLT_E_CANCELATION_NOT_OK) to the upper layer which has requested the cancellation instead of just stopping without further notification.
      boolean CanTpTcNotifyAlways: set at pre-compile, origin=Vector Informatik, default-value=false  # Switches upper layer notification of transmit cancellation ON or OFF. This is an addititional non AUTOSAR switch which is needed for compatibility reasons. In case there are upper layer modules (e.g. Dcm) which require a final indication or confirmation, this switch may be used to hand a final negative notification (NTFRSLT_E_CANCELATION_NOT_OK) to the upper layer which has requested the cancellation instead of just stopping without further notification.
      boolean CanTpOperNotSupportedReportDem: configuration-class-affection=affection-kind=PC-AFFECTS-LT-AND-PB, set at pre-compile, origin=Vector Informatik, default-value=false  # Specifies if reporting the production error CANTP_E_OPER_NOT_SUPPORTED to module Dem shall be supported. If disabled, Det error code 0xA0 will be reported instead (only if development error detection is enabled)
      boolean CanTpECommReportDem: configuration-class-affection=affection-kind=PC-AFFECTS-LT-AND-PB, set at pre-compile, origin=Vector Informatik, default-value=false  # Specifies if reporting the production error CANTP_E_COMM to module Dem shall be supported. ON or OFF. If disabled, Det error code 0xB0 will be reported instead (only if development error detection is enabled)
      boolean CanTpIgnoreFcWithReservedStMin: set at pre-compile, origin=Vector Informatik, default-value=false  # According to ISO, flow control - ClearToSend frames with invalid StMin values (0x80-0xF0 and 0xFA-0xFF) are interpreted as STMin 0x7F (127). If this option is enabled, FC.CTS with invalid STMin values will be considered invalid, and silently ignored.
      boolean CanTpIgnoreFcOvflAndInvalidFS: set at pre-compile, origin=Vector Informatik, default-value=false  # According to ISO, flow control overflow (FS 0x2) and flow control frames with invalid FS values (0x3-0xF) will abort the current transmission. If this option is enabled, flow control frames with FS 0x2-0xF will be silently ignored. A transmission still aborts due to timeout.
      boolean CanTpIgnoreCfWithWrongSN: set at pre-compile, origin=Vector Informatik, default-value=false  # According to ISO, consecutive frames with unexpected sequence numbers will abort the reception. If this option is enabled, unexpected consecutive frames will be silently ignored.
      boolean CanTpEnableDcmRequestDetect: set at pre-compile, origin=Vector Informatik, default-value=false  # If this option is enabled, the Tp will call a function 'Dcm_OnRequestDetection' each time a mixed addressed first- or single frame is received, even if no valid RxSDU is addressed.
      boolean CanTpEnableSynchronousTransmit: set at pre-compile, origin=Vector Informatik, default-value=true  # If this option is enabled, the Tp will request transmission buffer during the call to CanTp_Transmit. Otherwise, the transmission buffer will be requested during the next CanTp_MainFunction call. Note: This will reduce CanTp throughput.
      boolean CanTpEnableConstantBS: set at pre-compile, origin=Vector Informatik, default-value=false  # According to ISO (and Asr 4.x), the BS transmitted in the first flow control frame (sent after a first frame has been received) shall be used for each following flow control frame. The Autosar CanTp (ASR 3.x) calculates the BS for each flow control frame based on the available buffer. If this switch is enabled, the ISO / Asr4.x conformant constant BS is used, otherwise the Asr3.x behavior is used. Please note: If the communication partner sends different BS values during a transmission, they will be evalued and used. (See also 'CanTpUseOnlyFirstFC')
      boolean CanTpUseOnlyFirstFc: set at pre-compile, origin=Vector Informatik, default-value=false  # During a transmission Blocksize and STMin will only be evaluated from the first flow control (CTS) frame received in response to a first frame. Any further (valid) flow control frames (received after 'BlockSize' number of ConsecutiveFrames) will only trigger the transmission of the next block of data, its BlockSize and STMin value have no effect.
      boolean CanTpSuppressCancelErrorWhenIdle: set at pre-compile, origin=Vector Informatik, default-value=false  # If a connection, which is currently not active, is cancelled by the CancelTransmit or CancelReceive API, by default the error “operation not supported” is reported to DEM or DET. When activating this switch, the error reporting in this case will be suppressed. Note: this switch has only an effect if the CancelReceive or CancelTransmit API is available.
      boolean CanTpSuppressInvalidBufferFcOvfl: set at pre-compile, origin=Vector Informatik, default-value=false  # According to AUTOSAR 3, an FC.OVFL is sent if the status of the buffer provided by the PduR is either BUFREQ_E_OVFL or BUFREQ_E_NOT_OK. If this switch is activated, FC.OVFL is only sent if BUFREQ_E_OVFL is returned. The status BUFREQ_E_NOT_OK can then be used by the application to terminate the reception immediately, so that no further frame is sent.
      boolean CanTpSupportLowLevelRouting: configuration-class-affection=affection-kind=PC-AFFECTS-PB, set at pre-compile, origin=Vector Informatik, default-value=false  # Enables a set of callouts: <LLR-prefix>LLR_CanTp_CanIf_Transmit <LLR-prefix>LLR_CanIf_CanTp_RxIndication <LLR-prefix>LLR_CanIf_CanTp_TxConfirmation <LLR-prefix> is defined by parameter CanTpLowLevelRoutingPrefix.
      string CanTpLowLevelRoutingPrefix [0..1]: configuration-class-affection=affection-kind=PC-AFFECTS-PB, set at pre-compile, origin=Vector Informatik, default-value=Cdd  # Define the prefix of low level routing callout functions. Only required if CanTpSupportLowLevelRouting is enabled.
      boolean CanTpGwErrorsReportDem: configuration-class-affection=affection-kind=PC-AFFECTS-PB, set at pre-compile, origin=Vector Informatik, default-value=false  # If this switch is enabled, two additional errors are reported to DEM for error analysis when the CanTp is used in gateway applications: - routing failure due to insufficient buffer size - no routing due to missing ECU / no flow control Note: this option is only intended for gateway applications and should only be activated for those. However, the CanTp itself is not able to detect if such a use-case is given and will report these errors also for non-gateway application when this switch is active.
    container CanTpRxNSdu [0..*]: post-build-changeable=true  # The following parameters needs to be configured for each CAN N-Sdu that the CanTp module shall receive.
      enumeration CanTpAddressingFormat: {CANTP_EXTENDED, CANTP_STANDARD, CANTP_MIXED11}, set at pre-compile in variant pre-compile / link in variant post-build, default-value=CANTP_STANDARD  # Defines which communication addressing mode is used for this Rx N-Sdu. Enumeration values: CANTP_STANDARD to use normal addressing format. CANTP_EXTENDED to use extended addressing format. CANTP_MIXED11 to use mixed11 addressing format.
      integer CanTpBs: 0..255, set at pre-compile in variant pre-compile / post-build in variant post-build, default-value=8  # Defines the maximum number of N-Pdus the CanTp receiver allows the sender to send before waiting for an authorization to continue transmission of the following N-Pdus. For further details on this parameter value see ISO 15765-2 specification. Note: For reasons of buffer length, the CanTp can adapt the Bs value within the limit of this maximum Bs.
      float CanTpNar: 0..9999, set at pre-compile in variant pre-compile / post-build in variant post-build, default-value=0.1  # Value of the Nar timeout. Nar is the time for transmission of a CAN frame (any N-Pdu) on the receiver side.
      float CanTpNbr: 0..9999, set at pre-compile in variant pre-compile / post-build in variant post-build, default-value=0.15  # Value of the performance requirement for (Nbr + Nar). Nbr is the elapsed time between the receiving indication of a FF or CF or the transmit confirmation of a FC, until the transmit request of the next FC.
      float CanTpNcr: 0..9999, set at pre-compile in variant pre-compile / post-build in variant post-build, default-value=0.15  # Value of the Ncr timeout. Ncr is the time until reception of the next Consecutive Frame N-Pdu.
      integer CanTpRxChannel: 0..65535, set at published-information, default-value=0  # Link to the Rx connection channel, which has to be used for receiving this N-Pdu.
      integer CanTpRxDl: 1..4095, set at pre-compile in variant pre-compile / post-build in variant post-build, default-value=8  # Data Length Code of this Rx N-Sdu. In case of variable message length, this value indicates the minimum data length. Depending on SF or FF N-Sdu the value will be limited to 7 (6 for an Extended Addressing format) and 4095 respectively.
      enumeration CanTpRxPaddingActivation: {CANTP_OFF, CANTP_ON}, set at pre-compile in variant pre-compile / post-build in variant post-build, default-value=CANTP_ON  # Defines if the receive frame uses padding or not. Enumeration values: CANTP_ON: The N-Pdu received uses padding for SF, FC and the last CF. (N-Pdu length is always 8 bytes) CANTP_OFF: The N-Pdu received does not use padding for SF, FC and the last CF. (N-Pdu length is dynamic) Note: GENy uses a boolean value instead of an enumeration value. "Enabled" equals CANTP_ON, "disabled" equals CANTP_OFF. RESTRICTIONS: This setting is only available if "CanTpPaddingActive" is enabled.
      enumeration CanTpRxTaType: {CANTP_FUNCTIONAL, CANTP_PHYSICAL}, set at pre-compile in variant pre-compile / post-build in variant post-build, default-value=CANTP_PHYSICAL  # Defines the communication type of this Rx N-Sdu. Enumeration values: CANTP_PHYSICAL: Used for 1-to-1 connections CANTP_FUNCTIONAL: Used for 1-to-n connections (Only allowed for Single Frame reception)
      integer CanTpRxWftMax: 0..65535, set at pre-compile in variant pre-compile / post-build in variant post-build, default-value=15  # This parameter defines how many Flow Control wait N-Pdus can be consecutively transmitted by the receiver. It is local to the node and is not transmitted inside the FC protocol data unit. CanTpRxWftMax is used to avoid sender nodes being potentially hooked-up in case of a temporarily reception inability on the part of the receiver nodes, whereas the sender could be waiting continuously. For more details see ISO 15765-2 (chapter "Maximum number of FC.Wait frame transmissions").
      integer CanTpSTmin: 0..249, set at pre-compile in variant pre-compile / post-build in variant post-build, default-value=20  # Defines the duration of the minimum time the CanTp sender shall wait between the transmissions of two CF N-Pdus. For further details on this parameter value see ISO 15765-2 specification.
      boolean CanTpCreatedByTool: set at pre-compile, origin=Vector Informatik, default-value=false  # NOT USED - META INFORMATION Marker used by the configuration tool
      reference CanTpRxNSduRef: set at pre-compile in variant pre-compile / link in variant post-build, destination=Pdu  # Reference to a Pdu in the COM-Stack.
      container CanTpNSa [0..1]  # Contains the parameters needed to configure each Rx N-Sdu or Tx N-Sdu with CanTpAddressingFormat set to CANTP_EXTENDED
        integer CanTpNSa: 0..255, set at pre-compile in variant pre-compile / post-build in variant post-build, default-value=0  # If an Rx N-Sdu is configured to use the Extended Addressing format, this parameter contains the transport protocol source address of the Sdu. RESTRICTIONS: This setting is only relevant if Extended Addressing is configured for the respective Sdu
      container CanTpNTa [0..1]  # The following parameters need to be configured for each Rx N-Sdu or Tx N-Sdu with the CanTpAddressingFormat set to CANTP_EXTENDED or CANTP_MIXED11
        integer CanTpNTa: 0..255, set at pre-compile in variant pre-compile / post-build in variant post-build, default-value=0  # If an Rx N-Sdu is configured to use the Extended Addressing format, this parameter contains the transport protocol target address (NTa). In the case of Mixed11 Addressing, this parameter contains the transport protocol address extension value (NAe). RESTRICTIONS: This setting is only relevant if Extended Addressing or Mixed11 Addressing is used.
      container CanTpRxNPdu  # Used for grouping of the ID of a Pdu and the Reference to a Pdu.
        integer CanTpRxNPduId: 0..65535, set at pre-compile in variant pre-compile / post-build in variant post-build, symbolic-name-value=true  # Unique idenifier used by CanTp to receive the Pdu referenced by CanTpRxNpduRef.
        reference CanTpRxNPduRef: set at pre-compile in variant pre-compile / post-build in variant post-build, destination=Pdu  # Reference to the Rx N-Pdu in the COM-Stack used for the reception of this Rx N-Sdu.
      container CanTpTxFcNPdu [0..1]  # Used for grouping of the ID of a Pdu and the Reference to a Pdu.
        reference CanTpTxFcNPduRef: set at pre-compile in variant pre-compile / post-build in variant post-build, destination=Pdu  # Reference to the Fc N-Pdu in the COM-Stack used for the reception of this Rx N-Sdu.
    container CanTpTxNSdu [0..*]: post-build-changeable=true  # The following parameters needs to be configured for each CAN N-Sdu that the CanTp module shall transmit.
      enumeration CanTpAddressingMode: {CANTP_EXTENDED, CANTP_STANDARD, CANTP_MIXED11}, set at pre-compile in variant pre-compile / link in variant post-build, default-value=CANTP_STANDARD  # Defines which communication addressing format is used for this Tx N-Sdu. Enumeration values: CANTP_STANDARD to use normal addressing format. CANTP_EXTENDED to use extended addressing format. CANTP_MIXED11 to use mixed11 addressing format.
      float CanTpNas: 0..9999, set at pre-compile in variant pre-compile / post-build in variant post-build, default-value=0.1  # Value of the Nas timeout. Nas is the time for transmission of a CAN frame (any N-Pdu) on the sender side.
      float CanTpNbs: 0..9999, set at pre-compile in variant pre-compile / post-build in variant post-build, default-value=0.15  # Value of the Nbs timeout. Nbs is the time of transmission until reception of the next Flow Control N-Pdu.
      float CanTpNcs: 0..9999, set at pre-compile in variant pre-compile / post-build in variant post-build, default-value=0.15  # Value of the performance requirement of (Ncs + Nas). Ncs is the time which elapses between the transmit request of a CF N-Pdu until the transmit request of the next CF N-Pdu.
      integer CanTpTxChannel: 0..65535, set at published-information, default-value=0  # Link to the connection channel which has to be used for transmission of this N-Pdu.
      integer CanTpTxDl: 1..4095, set at pre-compile in variant pre-compile / post-build in variant post-build, default-value=8  # Data Length Code of this Tx N-Sdu. In case of variable length message, this value indicates the minimum data length.
      integer CanTpTxNSduId: 0..65535, set at pre-compile, symbolic-name-value=true  # Unique identifier to a structure that contains all relevant information to process the transmission of a Tx N-Sdu.
      enumeration CanTpTxPaddingActivation: {CANTP_OFF, CANTP_ON}, set at pre-compile in variant pre-compile / post-build in variant post-build, default-value=CANTP_ON  # Defines if the transmit frame use padding or not. Enumeration values: CANTP_ON: The transmit N-Pdu uses padding for SF, FC and the last CF. (N-Pdu length is always 8 bytes) CANTP_OFF: The transmit N-Pdu does not use padding for SF, FC and the last CF. (N-Pdu length is dynamic) Note: GENy uses a boolean value instead of an enumeration value. "Enabled" equals CANTP_ON, "disabled" equals CANTP_OFF. RESTRICTIONS: This setting is only available if "CanTpPaddingActive" is enabled.
      enumeration CanTpTxTaType: {CANTP_FUNCTIONAL, CANTP_PHYSICAL}, set at pre-compile in variant pre-compile / post-build in variant post-build, default-value=CANTP_PHYSICAL  # Defines the communication type of this Tx N-Sdu. Enumeration values: CANTP_PHYSICAL: Used for 1:1 communication. CANTP_FUNCTIONAL: Used for 1:n communication.
      boolean CanTpCreatedByTool: set at pre-compile, origin=Vector Informatik, default-value=false  # NOT USED - META INFORMATION Marker used by the configuration tool
      integer CanTpTxUpperLayerNSduId: 0..65535, set at pre-compile in variant pre-compile / post-build in variant post-build, origin=Vector Informatik, default-value=0  # This parameter contains the N-Sdu Id which shall be used for the upper layer communication.
      boolean CanTpTxTc: set at pre-compile in variant pre-compile / post-build in variant post-build, origin=Vector Informatik, default-value=true  # Enables support for transmit cancellation for this Sdu.
      reference CanTpTxNSduRef: set at pre-compile in variant pre-compile / link in variant post-build, destination=Pdu  # Reference to a Pdu in the COM-Stack.
      container CanTpNSa [0..1]  # Contains the parameters needed to configure each Rx N-Sdu or Tx N-Sdu with CanTpAddressingFormat set to CANTP_EXTENDED.
        integer CanTpNSa: set at pre-compile in variant pre-compile / post-build in variant post-build  # If an Tx N-Sdu is configured to use the Extended Addressing format, this parameter contains the transport protocol source address of the Sdu. RESTRICTIONS: This setting is only relevant if Extended Addressing is configured for the respective Sdu
      container CanTpNTa [0..1]  # The following parameters need to be configured for each Rx N-Sdu or Tx N-Sdu with the CanTpAddressingFormat set to CANTP_EXTENDED or CANTP_MIXED11.
        integer CanTpNTa: set at pre-compile in variant pre-compile / post-build in variant post-build  # If a Tx N-Sdu is configured to use the Extended Addressing format, this parameter contains the transport protocol target address (NTa). In the case of Mixed11 Addressing, this parameter contains the transport protocol address extension value (NAe). RESTRICTIONS: This setting is only relevant if Extended Addressing or Mixed11 Addressing is used.
      container CanTpRxFcNPdu [0..1]  # Used for grouping of the ID of a Pdu and the Reference to a Pdu.
        integer CanTpRxFcNPduId: 0.., set at pre-compile in variant pre-compile / post-build in variant post-build, symbolic-name-value=true  # Unique identifier used by CanTp to receive the Fc Pdu referenced by CanTpRxFcNPduRef.
        reference CanTpRxFcNPduRef: set at pre-compile in variant pre-compile / post-build in variant post-build, destination=Pdu  # Reference to the Fc N-Pdu in the COM-Stack used for the transmission of this Tx N-Sdu.
      container CanTpTxNPdu  # Used for grouping of the ID of a Pdu and the Reference to a Pdu.
        reference CanTpTxNPduRef: set at pre-compile in variant pre-compile / post-build in variant post-build, destination=Pdu  # Reference to the Tx N-Pdu in the COM-Stack used for the transmission of this Tx N-Sdu.
    container VectorCommonData  # NOT USED - META INFORMATION Marker used by the configuration tool
      string BswmdVersion: configuration-class-affection=affection-kind=NO-AFFECT, set at published-information, origin=Vector Informatik, default-value=1.25.00  # NOT USED - META INFORMATION Marker used by the configuration tool
    container CanTpConfigSet: multiple-configuration-container=true
      reference CanTpActiveRxNSduRef [0..*]: set at pre-compile in variant pre-compile / post-build in variant post-build, destination=CanTpRxNSdu  # References active Rx connections in this identity
      reference CanTpActiveTxNSduRef [0..*]: set at pre-compile in variant pre-compile / post-build in variant post-build, destination=CanTpTxNSdu  # References active Tx connections in this identity
    container CanTpChannel [0..*]: post-build-changeable=true  # This container contains the configuration parameters of the CanTp channel.
      enumeration CanTpChannelMode: {CANTP_MODE_FULL_DUPLEX, CANTP_MODE_HALF_DUPLEX}, set at pre-compile, origin=Vector Informatik  # The CAN Transport Layer supports half and full duplex channel modes.
      reference CanTpRxNSduRef [0..1]: set at pre-compile in variant pre-compile / post-build in variant post-build, origin=Vector Informatik, destination=CanTpRxNSdu  # Reference to the Rx NSdu used when receiving on this channel
      reference CanTpTxNSduRef [0..1]: set at pre-compile in variant pre-compile / post-build in variant post-build, origin=Vector Informatik, destination=CanTpTxNSdu  # Reference to the Tx NSdu used to transmit on this channel
  module config CanTp_Pre: definition=CanTp
  module config CanTp_Rec: definition=CanTp
