AUTOSAR XML (schema 3.1.4)
package /TTTECH
  bsw implementation WdgM_Impl: code-generator=TTTech, programming-language=C, sw-major-version=2, sw-minor-version=0, sw-patch-version=3, vendor-id=46, ar-major-version=4, ar-minor-version=0, ar-patch-version=1, vendor-specific-module-def=WdgM
  module definition WdgM [0..1]: refined-module-def=WdgM, variants pre-compile/post-build  # Configuration of the WdgM (Watchdog Manager) module.
    container WdgMConfigSet: multiple-configuration-container=true  # This container describes one of multiple configuration sets of WdgM. This is a MultipleConfigurationContainer, i.e. this container and its sub-containers exist once per configuration set.
      symbolic name reference WdgMInitialMode: set at pre-compile, destination=WdgMMode  # The mode that the Watchdog Manager is in after it has been initialized.
      container WdgMMode [1..255]  # The container describes one of several modes of the Watchdog Manager.
        integer WdgMExpiredSupervisionCycleTol: 0..255, set at pre-compile  # This parameter shall be used to define a value that fixes the amount of expired supervision cycles for how long the blocking of watchdog triggering shall be postponed.
        integer WdgMModeId: 0..255, set at pre-compile, symbolic-name-value=true  # This parameter represents the S-WdgM mode.
        float WdgMTicksPerSecond: 1.., set at pre-compile  # This parameter defines the number of Watchdog Manager ticks per second.
        float WdgMSupervisionCycle: set at pre-compile  # This parameter defines the period with which the main function (WdgM_MainFunction) is called. Unit: [s]
        integer WdgMInitialTriggerModeId: 0..255, set at pre-compile, symbolic-name-value=true, default-value=0  # Denotes the ID of the Trigger Mode which shall be used at system start.
        container WdgMAliveSupervision [0..65535]  # This container collects all configuration parameters of Alive-Supervision.
          integer WdgMExpectedAliveIndications: 0..65535, set at pre-compile  # This parameter contains the amount of expected alive indications within the referenced amount of defined supervision cycles according to corresponding SE.
          integer WdgMMaxMargin: 0..65535, set at pre-compile  # This parameter contains the amount of alive indications that are acceptable to be additional on the expected alive indications within the corresponding supervision reference cycle.
          integer WdgMMinMargin: 0..65535, set at pre-compile  # This parameter contains the amount of alive indications that are acceptable to be missed from the expected alive indications within the corresponding supervision reference cycle.
          integer WdgMSupervisionReferenceCycle: 0..65535, set at pre-compile  # This parameter contains the amount of supervision cycles to be used as reference by the alive-supervision mechanism to perform the checkup with counted alive indications according to corresponding SE.
          symbolic name reference WdgMAliveSupervisionCheckpointRef: set at pre-compile, destination=WdgMCheckpoint  # Reference to the Checkpoint for which this alive counter is configured.
        container WdgMDeadlineSupervision [0..65535]  # This container collects all configuration parameters for Deadline Monitoring for a Supervised Entity.
          float WdgMDeadlineMax: 0.0.., set at pre-compile  # This parameter contains the longest time span after which the deadline is considered to be met. Unit: [s]
          float WdgMDeadlineMin: 0.0.., set at pre-compile  # This parameter contains the shortest time span after which the deadline is considered to be met. Unit: [s]
          symbolic name reference WdgMDeadlineStartRef: set at pre-compile, destination=WdgMCheckpoint  # This is the reference to the start Checkpoint for Deadline Monitoring.
          symbolic name reference WdgMDeadlineStopRef: set at pre-compile, destination=WdgMCheckpoint  # This is the reference to the stop Checkpoint for Deadline Monitoring. Note that the deadline's start and stop references must match an existing local or a global transition.
        container WdgMProgramFlowSupervision [0..65535]  # This container collects all configuration parameters for Logical Program Flow monitoring for a set of connected Supervised Entities.
          symbolic name reference WdgMGlobalCheckpointFinalRef [0..65535]: set at pre-compile, destination=WdgMCheckpoint  # A reference to the final global Checkpoint. Note that there might be several final global checkpoints.
          symbolic name reference WdgMGlobalCheckpointInitialRef [1..65535]: set at pre-compile, destination=WdgMCheckpoint  # A reference to the global initial Checkpoint.
          container WdgMGlobalTransition [0..65535]  # This container collects the Checkpoints for a Global Transition across Supervised Entities.
            symbolic name reference WdgMGlobalTransitionDestRef: set at pre-compile, destination=WdgMCheckpoint  # This is the reference to the source Checkpoint of a Global Transition.
            symbolic name reference WdgMGlobalTransitionSourceRef: set at pre-compile, destination=WdgMCheckpoint  # This is the reference to the source Checkpoint of a Global Transition.
        container WdgMTrigger [0..255]  # This container collects all configuration parameters for the triggering of hardware watchdogs.
          enumeration WdgMWatchdogMode: {WDGIF_FAST_MODE, WDGIF_OFF_MODE, WDGIF_SLOW_MODE}, set at pre-compile  # This parameter contains the watchdog mode that shall be used for the referenced watchdog in this Watchdog Manager mode. Implementation Type: WdgIf_ModeType
          integer WdgMTriggerConditionValue: 1..65535, set at pre-compile  # This parameter defines the maximum possible window time where the watchdog trigger is accepted (window end). The consumer of this parameter is the WdgIf_UpdateTriggerCondition for this watchdog. Unit: [ms]
          integer WdgMTriggerWindowStart: 0..65535, set at pre-compile  # This parameter defines the minimum window time after which a watchdog triggering is allowed (window start). The consumer of this parameter is the WdgIf_UpdateTriggerCondition for this watchdog. Unit: [ms]
          integer WdgMTriggerModeId: 0..254, set at pre-compile, origin=TTTECH, default-value=0  # This parameter indicates the mode of the WdgMTrigger itself. NOTE: Currently not used.
          symbolic name reference WdgMTriggerWatchdogRef: set at pre-compile, destination=WdgMWatchdog  # This parameter is a reference to the configured watchdog.
        container WdgMLocalStatusParams [0..65535]  # This container collects all configuration parameters for the Local Status of a Supervised Entity.
          integer WdgMFailedSupervisionRefCycleTol: 0..65535, set at pre-compile  # This parameter contains the acceptable amount of failed alive supervisions for this Supervised Entity
          enumeration WdgMSupervisedEntityInitialMode: {WDGM_LOCAL_STATUS_DEACTIVATED, WDGM_LOCAL_STATUS_OK, WDGM_LOCAL_STATUS_STATUS_FAILED}, set at pre-compile, default-value=WDGM_LOCAL_STATUS_OK  # Initial local monitoring status of the supervised entity.
          integer WdgMFailedDeadlineRefCycleTol [0..1]: 0..65535, set at pre-compile  # This parameter contains the acceptable amount of violated deadlines for this Supervised Entity.
          integer WdgMDeadlineReferenceCycle [0..1]: 0..65535, set at pre-compile  # This parameter contains the amount of supervision cycles to be used as reference by the deadline supervisions of this SE.
          integer WdgMFailedProgramFlowRefCycleTol [0..1]: 0..65535, set at pre-compile  # This parameter contains the acceptable amount of program flow violations for this Supervised Entity.
          integer WdgMProgramFlowReferenceCycle [0..1]: 0..65535, set at pre-compile  # This parameter contains the amount of supervision cycles to be used as reference by the program flow supervisions of this SE.
          symbolic name reference WdgMLocalStatusSupervisedEntityRef: set at pre-compile, destination=WdgMSupervisedEntity  # Reference to the Supervised Entity for which the parameters of this container are set.
    container WdgMGeneral  # Container structures all general configuration parameters of the Watchdog Manager.
      boolean WdgMDevErrorDetect: set at pre-compile  # Preprocessor switch to enable/disable development error detection and reporting. Shall be used to remove unneeded code segments regarding DET features True: Development error detection is enabled False: Development error detection is disabled
      boolean WdgMDemReport: set at pre-compile  # Preprocessor switch to enable / disable calls to DEM in case of production error detection. True: DEM calls enabled in case of production errors False: DEM calls disabled in case of production errors
      boolean WdgMImmediateReset: set at pre-compile  # This preprocessor switch enables/disablse the immediate reset feature in case of alive, deadline or program flow failure. True: Immediate reset is enabled False: Immediate reset is disabled
      boolean WdgMOffModeEnabled: set at pre-compile  # This preprocessor switch enables/disables the selection of the "OffMode" of the watchdog driver. True: "OffMode" selection is allowed False: "OffMode" selection is disallowed
      boolean WdgMVersionInfoApi: set at pre-compile  # Preprocessor switch to enable/disable the existence of the API WdgM_GetVersionInfo. Shall be used to remove unneeded code segments. True: API is enabled False: API is disabled
      boolean WdgMDefensiveBehavior: set at pre-compile  # Preprocessor switch to enable/disable the defensive behavior of the Watchdog Manager module.
      boolean WdgMUseRte: set at pre-compile, origin=TTTech  # This preprocessor switch instructs the Watchdog Manager to use the by Rte generated defines and typedefs. true: the S-WdgM uses the by Rte generated defines and typedefs false: the S-WdgM uses own defines and typedefs
      boolean WdgMDemSupervisionReport: set at pre-compile, origin=TTTech  # Preprocessor switch to enable / disable call to DEM in case the Safe Watchdog Manager has the WDGM_GLOBAL_STATE_STOPPED reached. True: The DEM call is enabled False: The DEM call is disabled
      boolean WdgMFirstCycleAliveCounterReset: set at pre-compile, origin=TTTech, default-value=false  # When this preprocessor switch is enabled, then the Alive counters in the first Supervision cycle are not evaluated
      boolean WdgMUseOsSuspendInterrupt: set at pre-compile  # This preprocessor switch enables/disables the usage of OS suspend and resume interrupt services within WdgM.
      enumeration WdgMTimebaseSource: {WDGM_INTERNAL_SOFTWARE_TICK, WDGM_INTERNAL_HARDWARE_TICK, WDGM_EXTERNAL_TICK}, set at pre-compile, origin=TTTECH, default-value=WDGM_INTERNAL_SOFTWARE_TICK  # This parameter selects the Tick counter source for Deadline monitoring. WDGM_INTERNAL_SOFTWARE_TICK: The counter is incremented each time `WdgM_MainFunction` is called. WDGM_INTERNAL_HARDWARE_TICK: The counter is based on the microcontroller's hardware counter. WDGM_EXTERNAL_TICK: The counter is incremented each time `WdgM_UpdateTickCount` is called.
      boolean WdgMSecondResetPath: set at pre-compile  # This preprocessor switch generally enables the access to the external Mcu_ImmediateReset() function. This function is used as second reset path a specially when the primary reset path signals failure.
      boolean WdgMTickOverrunCorrection: set at pre-compile  # This preprocessor switch enables/disables 32 bit timebase counter overflow detection and correction.
      boolean WdgMEntityDeactivationEnabled: set at pre-compile  # This preprocessor switch enables generally entity deactivation. Please see additional important safety information regarding this functionality in the S-WdgM Safety Manual
      function name WdgMGlobalStateChangeCbk [0..1]: set at pre-compile in variant pre-compile / post-build in variant post-build  # Callback function for notifying Watchdog Manager global state change.
      boolean WdgMStateChangeNotification: set at pre-compile  # This preprocessor switch enables local and global state callback notifications for the Watchdog Manager.
      choice reference WdgMGlobalMemoryAppTaskRef [0..1]: set at pre-compile, destination=OsApplication  # Reference to an OS Application or Task where the S-WdgM is running. In case of OS SC3 (with memory protection) the global variables of the Watchdog Manager module should be placed in the same memory segment as the application / task in the context of which the Watchdog Manager is running.
      container WdgMSupervisedEntity [0..65535]  # This container collects all common (mode-independent) parameters of a Supervised Entity to be supervised by the Watchdog Manager.
        integer WdgMSupervisedEntityId: 0..65535, set at pre-compile, symbolic-name-value=true  # This parameter contains the identifier of the supervised entity for which the parameters of this container are set.
        integer OSApplication [0..1]: 0..255, set at pre-compile  # The ID of the OS Application that this SE is part of. If defined then the OS Application will receive a partition reset signal each time this SE changes its status from OK to FAILED. Enter 255 (== 0xFF) if this supervised entity is not a part of an OS Application.
        boolean WdgMEnableEntityDeactivation: set at pre-compile  # Enables deactivation of this supervised enitiy.
        enumeration WdgMSupportedAutosarAPI: {API_4_0, API_3_1}, set at pre-compile, origin=TTTECH, default-value=API_4_0  # Defines which version of the AUTOSAR API shall be used.
        function name WdgMLocalStateChangeCbk [0..1]: set at pre-compile in variant pre-compile / post-build in variant post-build  # Callback function for notifying this Supervised Entity's state change.
        symbolic name reference WdgMLocalCheckpointFinalRef [0..65535]: set at pre-compile, destination=WdgMCheckpoint  # A reference to the final local Checkpoint of this supervised entity. Note that there might be several final local checkpoints.
        symbolic name reference WdgMLocalCheckpointInitialRef: set at pre-compile, destination=WdgMCheckpoint  # A reference to the initial local Checkpoint of this supervised entity.
        choice reference WdgMAppTaskRef [0..1]: set at pre-compile, destination=OsApplication  # Reference to an OS Application or Task. In case of OS SC3 the local data of the supervised entity should be placed in the same memory segment as the application / task this supervised entity is part of.
        container WdgMCheckpoint [0..65535]  # This container collects all Checkpoints of this Supervised Entity.
          integer WdgMCheckpointId: 0..65535, set at pre-compile, symbolic-name-value=true  # This parameter shall contain the unique identifier of Checkpoint.
        container WdgMLocalTransition [0..65535]  # This container collects the Checkpoints for a Local Transition within this Supervised Entity.
          symbolic name reference WdgMLocalTransitionDestRef: set at pre-compile, destination=WdgMCheckpoint  # This is the reference to the destination Checkpoint of a Local Transition within this Supervised Entity.
          symbolic name reference WdgMLocalTransitionSourceRef: set at pre-compile, destination=WdgMCheckpoint  # This is the reference to the source Checkpoint of a Local Transition within this Supervised Entity.
      container WdgMWatchdog [0..255]  # This container collects all common (mode-independent) parameters of a Watchdog to be triggered by the Watchdog Manager.
        string WdgMWatchdogName: set at pre-compile, symbolic-name-value=true  # This parameter is a symbolic name of the Watchdog. Is used as comment only.
        symbolic name reference WdgIfDeviceRef: set at pre-compile, destination=WdgIfDevice  # Reference to one device container of Watchdog Interface. In the referenced container WdgIfDevice, the parameter WdgIfDeviceIndex contains the Index parameter that WdgM has to use for WdgIf_Trigger calls for that watchdog instance.
      container WdgMCallerIds  # Contains the definition of valid CallerIds for the callers who have permission to call the function WdgM_SetMode
        integer WdgMCallerId [1..255]: 0..65535, set at pre-compile, symbolic-name-value=true, default-value=0  # This parameter defines one valid CallerId for the callers who have permission to call the function WdgM_SetMode.
