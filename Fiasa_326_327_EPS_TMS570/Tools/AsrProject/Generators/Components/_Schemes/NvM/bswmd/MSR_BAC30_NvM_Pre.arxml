AUTOSAR XML (schema 3.0.1)
package /MICROSAR
  module config NvM_Rec: definition=NvM
    Nvm_30_CommonVendorParams:
      NvmCfgCbkIncludeList = ApplMain.h
      NvmCfgCbkIncludeList = Cdc.h
      NvmCfgCbkIncludeList = sc_ee_data.h
      NvmCfgCbkIncludeList = Darh.h
      NvmCfgCbkIncludeList = Vsm_Client.h
      NvmCfgCbkIncludeList = Coding.h
      NvmCfgCbkIncludeList = Csm.h
      NvmCfgCbkIncludeList = EcuM_Cbk.h
      NvmMultiblockId = MultiBlockRequest
    NvmCommon:
      NvmDevErrorDetect = true
      NvmVersionInfoApi = false
      NvmApiConfigClass = NvmApiConfigClass3
      NvmDatasetSelectionBits = 5
      NvmMultiBlockCallback = EcuM_CB_NfyNvMJobEnd
      NvmDrvModeSwitch = true
    14 x NvmBlockDescriptor, all with NvmBlockCRCType=NVM_CRC16, NvmCalcRamBlockCrc=false, NvmBlockJobPriority=64, NvmUseServicePorts=false, NvmWriteBlockOnce=false, NvmJobendCbkAtReadAll=true:
      NVM_BLOCK_BOOT_PROG_STATUS: NvmBlockManagementType=NVM_BLOCK_NATIVE, NvmBlockUseCrc=false, NvmBlockUsedCrcType=NVM_NOCRC, NvmNvBlockLength=11, NvmNvBlockNum=1, NvmBlockWriteProt=false, NvmResistantToChangedSw=true, NvmSelectBlockForReadall=true, NvmRamBlockDataAddress=BootProgStatus, NvmRomBlockDataAddress=(unset), NvmUseInitCallback=true, NvmInitBlockCallback=Init_BootProgStatus, NvmUseJobendCallback=false, NvmSingleBlockCallback=NULL_PTR
      NVM_BLOCK_BOOT_PROG_COUNTER: NvmBlockManagementType=NVM_BLOCK_NATIVE, NvmBlockUseCrc=false, NvmBlockUsedCrcType=NVM_NOCRC, NvmNvBlockLength=4, NvmNvBlockNum=1, NvmBlockWriteProt=false, NvmResistantToChangedSw=true, NvmSelectBlockForReadall=true, NvmRamBlockDataAddress=BootProgCounter, NvmRomBlockDataAddress=(unset), NvmUseInitCallback=true, NvmInitBlockCallback=Init_BootProgCounter, NvmUseJobendCallback=false, NvmSingleBlockCallback=NULL_PTR
      NVM_BLOCK_BOOT_PROG_DATA: NvmBlockManagementType=NVM_BLOCK_NATIVE, NvmBlockUseCrc=false, NvmBlockUsedCrcType=NVM_NOCRC, NvmNvBlockLength=47, NvmNvBlockNum=1, NvmBlockWriteProt=false, NvmResistantToChangedSw=true, NvmSelectBlockForReadall=true, NvmRamBlockDataAddress=BootProgData, NvmRomBlockDataAddress=(unset), NvmUseInitCallback=true, NvmInitBlockCallback=Init_BootProgData, NvmUseJobendCallback=false, NvmSingleBlockCallback=NULL_PTR
      NVM_BLOCK_SVK_HISTORY_MEM: NvmBlockManagementType=NVM_BLOCK_NATIVE, NvmBlockUseCrc=false, NvmBlockUsedCrcType=NVM_NOCRC, NvmNvBlockLength=207, NvmNvBlockNum=1, NvmBlockWriteProt=false, NvmResistantToChangedSw=true, NvmSelectBlockForReadall=true, NvmRamBlockDataAddress=SvkHistoryMemory, NvmRomBlockDataAddress=(unset), NvmUseInitCallback=true, NvmInitBlockCallback=Init_SvkHistoryMemory, NvmUseJobendCallback=false, NvmSingleBlockCallback=NULL_PTR
      NVM_BLOCK_VSMOMC_DATA: NvmBlockManagementType=NVM_BLOCK_NATIVE, NvmBlockUseCrc=false, NvmBlockUsedCrcType=NVM_NOCRC, NvmNvBlockLength=2, NvmNvBlockNum=1, NvmBlockWriteProt=false, NvmResistantToChangedSw=false, NvmSelectBlockForReadall=true, NvmRamBlockDataAddress=Vsm_OmcNvData, NvmRomBlockDataAddress=Vsm_OmcNvData_Default, NvmUseInitCallback=false, NvmInitBlockCallback=NULL_PTR, NvmUseJobendCallback=false, NvmSingleBlockCallback=NULL_PTR
      NVM_BLOCK_VSMWUR_DATA: NvmBlockManagementType=NVM_BLOCK_NATIVE, NvmBlockUseCrc=false, NvmBlockUsedCrcType=NVM_NOCRC, NvmNvBlockLength=2, NvmNvBlockNum=1, NvmBlockWriteProt=false, NvmResistantToChangedSw=false, NvmSelectBlockForReadall=true, NvmRamBlockDataAddress=Vsm_WurNvData, NvmRomBlockDataAddress=Vsm_WurNvData_Default, NvmUseInitCallback=false, NvmInitBlockCallback=NULL_PTR, NvmUseJobendCallback=false, NvmSingleBlockCallback=NULL_PTR
      NVM_BLOCK_CODING_DATA: NvmBlockManagementType=NVM_BLOCK_NATIVE, NvmBlockUseCrc=true, NvmBlockUsedCrcType=NVM_CRC16, NvmNvBlockLength=153, NvmNvBlockNum=1, NvmBlockWriteProt=true, NvmResistantToChangedSw=false, NvmSelectBlockForReadall=true, NvmRamBlockDataAddress=Coding_NvData, NvmRomBlockDataAddress=Coding_NvDataDefaults, NvmUseInitCallback=false, NvmInitBlockCallback=NULL_PTR, NvmUseJobendCallback=false, NvmSingleBlockCallback=NULL_PTR
      NVM_BLOCK_CODING_STATUS: NvmBlockManagementType=NVM_BLOCK_NATIVE, NvmBlockUseCrc=true, NvmBlockUsedCrcType=NVM_CRC16, NvmNvBlockLength=1, NvmNvBlockNum=1, NvmBlockWriteProt=false, NvmResistantToChangedSw=false, NvmSelectBlockForReadall=true, NvmRamBlockDataAddress=Coding_NvStatus, NvmRomBlockDataAddress=Coding_NvStatusDefaults, NvmUseInitCallback=false, NvmInitBlockCallback=NULL_PTR, NvmUseJobendCallback=false, NvmSingleBlockCallback=NULL_PTR
      NVM_BLOCK_CDC_DATA: NvmBlockManagementType=NVM_BLOCK_NATIVE, NvmBlockUseCrc=true, NvmBlockUsedCrcType=NVM_CRC16, NvmNvBlockLength=3, NvmNvBlockNum=1, NvmBlockWriteProt=false, NvmResistantToChangedSw=false, NvmSelectBlockForReadall=true, NvmRamBlockDataAddress=Cdc_NvData, NvmRomBlockDataAddress=Cdc_NvDataDefault, NvmUseInitCallback=false, NvmInitBlockCallback=NULL_PTR, NvmUseJobendCallback=false, NvmSingleBlockCallback=NULL_PTR
      NVM_BLOCK_DARH_DATA: NvmBlockManagementType=NVM_BLOCK_NATIVE, NvmBlockUseCrc=true, NvmBlockUsedCrcType=NVM_CRC16, NvmNvBlockLength=8, NvmNvBlockNum=1, NvmBlockWriteProt=false, NvmResistantToChangedSw=false, NvmSelectBlockForReadall=true, NvmRamBlockDataAddress=darhNvData, NvmRomBlockDataAddress=darhNvDefaults, NvmUseInitCallback=false, NvmInitBlockCallback=NULL_PTR, NvmUseJobendCallback=false, NvmSingleBlockCallback=NULL_PTR
      NVM_BLOCK_DEM_STATUS: NvmBlockManagementType=NVM_BLOCK_NATIVE, NvmBlockUseCrc=true, NvmBlockUsedCrcType=NVM_CRC16, NvmNvBlockLength=70, NvmNvBlockNum=1, NvmBlockWriteProt=false, NvmResistantToChangedSw=false, NvmSelectBlockForReadall=true, NvmRamBlockDataAddress=Dem_NvStatusData, NvmRomBlockDataAddress=(unset), NvmUseInitCallback=false, NvmInitBlockCallback=NULL_PTR, NvmUseJobendCallback=false, NvmSingleBlockCallback=NULL_PTR
      NVM_BLOCK_DEM_PRIMARY: NvmBlockManagementType=NVM_BLOCK_DATASET, NvmBlockUseCrc=true, NvmBlockUsedCrcType=NVM_CRC16, NvmNvBlockLength=40, NvmNvBlockNum=21, NvmBlockWriteProt=false, NvmResistantToChangedSw=false, NvmSelectBlockForReadall=false, NvmRamBlockDataAddress=Dem_NvGateEntryPrimaryData, NvmRomBlockDataAddress=(unset), NvmUseInitCallback=false, NvmInitBlockCallback=NULL_PTR, NvmUseJobendCallback=true, NvmSingleBlockCallback=Dem_NvMGateEntryPrimaryBlockCallback
      NVM_BLOCK_DEM_SECONDARY: NvmBlockManagementType=NVM_BLOCK_DATASET, NvmBlockUseCrc=true, NvmBlockUsedCrcType=NVM_CRC16, NvmNvBlockLength=25, NvmNvBlockNum=24, NvmBlockWriteProt=false, NvmResistantToChangedSw=false, NvmSelectBlockForReadall=false, NvmRamBlockDataAddress=Dem_NvGateEntrySecondaryData, NvmRomBlockDataAddress=(unset), NvmUseInitCallback=false, NvmInitBlockCallback=NULL_PTR, NvmUseJobendCallback=true, NvmSingleBlockCallback=Dem_NvMGateEntrySecondaryBlockCallback
      NVM_BLOCK_CSM_NV_DATA: NvmBlockManagementType=NVM_BLOCK_NATIVE, NvmBlockUseCrc=true, NvmBlockUsedCrcType=NVM_CRC16, NvmNvBlockLength=42, NvmNvBlockNum=1, NvmBlockWriteProt=false, NvmResistantToChangedSw=false, NvmSelectBlockForReadall=true, NvmRamBlockDataAddress=Csm_NvData, NvmRomBlockDataAddress=Csm_NvDataDefault, NvmUseInitCallback=false, NvmInitBlockCallback=NULL_PTR, NvmUseJobendCallback=false, NvmSingleBlockCallback=NULL_PTR
    ConfigBlock (NvmConfigBlockDescriptor):
      NvmBlockManagementType = NVM_BLOCK_REDUNDANT
      NvmBlockUseCrc = true
      NvmBlockCRCType = NVM_CRC16
      NvmCalcRamBlockCrc = false
      NvmBlockJobPriority = 127
      NvmNvBlockLength = 2
      NvmNvBlockNum = 2
      NvmUseServicePorts = false
      NvmWriteBlockOnce = false
      NvmBlockWriteProt = false
      NvmResistantToChangedSw = true
      NvmSelectBlockForReadall = true
      NvmRamBlockDataAddress = (unset)
      NvmRomBlockDataAddress = NULL_PTR
      NvmUseInitCallback = false
      NvmInitBlockCallback = NULL_PTR
      NvmUseJobendCallback = true
      NvmJobendCbkAtReadAll = false
      NvmSingleBlockCallback = (unset)
