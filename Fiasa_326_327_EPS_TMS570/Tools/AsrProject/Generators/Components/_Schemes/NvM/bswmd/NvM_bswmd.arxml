AUTOSAR XML (schema 3.0.1)
package /MICROSAR
  module definition NvM [0..1]: refined-module-def=NvM, variants link-time  # Configuration of the NvM (NvRam Manager) module.
    container NvmBlockDescriptor [1..65536]  # Container for a management structure to configure the composition of a given NVRAM Block Management Type. Its multiplicity describes thenumber of configured NVRAM blocks, one block is required to be configured. The NVRAM block descriptors are condensed in the NVRAM block descriptor table. The start address of the table is configured in the NVMCommon parameters.
      enumeration NvmBlockCRCType: {NVM_CRC16, NVM_CRC32}, set at link, origin=AUTOSAR_ECUC V1.0.0, default-value=NVM_CRC16  # Defines CRC data width for the NVRAM block. Default: NVM_CRC16, i.e. CRC16 will be used if NVM_BLOCK_USE_CRC==TRUE
      integer NvmBlockJobPriority: 0..255, set at link, origin=AUTOSAR_ECUC V1.0.0, default-value=127  # Defines the job priority for a NVRAM block. The lower the number, the higher the priority. 0 defines immediate write priority, i.e. write job with this priority cancels other jobs with lower priority. Will be ignored, if NvmJobPrioritization is deactivated.
      enumeration NvmBlockManagementType: {NVM_BLOCK_DATASET, NVM_BLOCK_NATIVE, NVM_BLOCK_REDUNDANT}, set at link, origin=AUTOSAR_ECUC V1.0.0, default-value=NVM_BLOCK_NATIVE  # Defines the block management type for the NVRAM block.
      boolean NvmBlockUseCrc: set at link, origin=AUTOSAR_ECUC V1.0.0, default-value=false  # Defines CRC usage for the NVRAM block, i.e. memory space for CRC is reserved in RAM and NV memory.
      boolean NvmBlockWriteProt: set at link, origin=AUTOSAR_ECUC V1.0.0, default-value=false  # Defines an initial write protection of the NV block
      boolean NvmCalcRamBlockCrc: set at link, origin=AUTOSAR_ECUC V1.0.0, default-value=false  # Defines CRC (re)calculation for the permanent RAM block, when NvM_SetRamBlockStatus was called
      function name NvmInitBlockCallback: set at link, origin=AUTOSAR_ECUC V1.0.0, default-value=NULL_PTR  # Entry address of a block specific callback routine which shall be called if no ROM data is available for initialization of the NVRAM block. If a NULL pointer is configured, no specific callback routine shall be called for initialization of the NVRAM block with default data.
      integer NvmNvBlockLength: 1..65535, set at link, origin=AUTOSAR_ECUC V1.0.0, default-value=1  # Defines the NV block data length in bytes
      integer NvmNvBlockNum: 1..255, set at link, origin=AUTOSAR_ECUC V1.0.0, default-value=1  # Defines the number of multiple NV blocks in a contiguous area according to the given block management type. 1-255 For NVRAM blocks to be configured of block management type NVM_BLOCK_DATASET 1 For NVRAM blocks to be configured of block management type NVM_BLOCK_NATIVE 2 For NVRAM blocks to be configured of block management type NVM_BLOCK_REDUNDANT
      string NvmRamBlockDataAddress: set at link, origin=AUTOSAR_ECUC V1.0.0  # Defines the start address of the RAM block data. If a NULL pointer is configured or value is empty (default), no permanent RAM data block is available for the selected block management type.
      boolean NvmResistantToChangedSw: set at link, origin=AUTOSAR_ECUC V1.0.0, default-value=true  # Defines whether a NVRAM block shall be treated resistant to configuration changes or not. If there is no default data available at configuration time then the application shall be responsible for providing the default initialization data. In this case the application has to use NvM_GetErrorStatus()to be able to distinguish between first initialization and corrupted data.
      string NvmRomBlockDataAddress: set at link, origin=AUTOSAR_ECUC V1.0.0  # Defines the start address of the ROM block data. If a NULL pointer is configured or value is empty (default), no ROM block is available for the selected block management type.
      boolean NvmSelectBlockForReadall: set at link, origin=AUTOSAR_ECUC V1.0.0, default-value=true  # Defines whether a NVRAM block shall be processed during NvM_ReadAll or not. This configuration parameter has only influence on those NVRAM blocks which are configured to have a permanent RAM block.
      function name NvmSingleBlockCallback: set at link, origin=AUTOSAR_ECUC V1.0.0, default-value=NULL_PTR  # Entry address of the block specific callback routine which shall be invoked on termination of each asynchronous single block request.
      boolean NvmWriteBlockOnce: set at link, origin=AUTOSAR_ECUC V1.0.0, default-value=false  # Defines write protection after first write. The NVRAM manager sets the write protection bit after the NV block was written the first time. This means that some of the NV blocks in the NVRAM should never be erased nor be replaced with the default ROM data after first initialization. [NVM276]
      integer NvmNvramBlockIdentifier: 1..65535, set at link, origin=AUTOSAR_ECUC V1.0.0, symbolic-name-value=true, default-value=2  # Numeric handle of the NVRAM Block to be passed as BlockId parmater to the NVM. This value will be calucuated automatically. In EAD it is not writeable by user.
      boolean NvmUseServicePorts: set at link, origin=Vector Informatik, default-value=true  # Mark this block as accessible via service ports. The PortName will be derived from the
      enumeration NvmBlockUsedCrcType: {NVM_NOCRC, NVM_CRC16, NVM_CRC32}, set at link, origin=Vector Informatik, default-value=NVM_NOCRC  # Internal CRC configuration --> for better graphical configuration
      string NvmDeviceName: set at link, origin=Vector Informatik  # Device name, only really needed for active blocks
      boolean NvmUseJobendCallback: set at link, origin=Vector Informatik, default-value=true  # Use the configfured Callback for Single Block Job End Notification, either directly or via Service Port (RTE), depending on the "Use Service Ports" setting
      boolean NvmUseInitCallback: set at link, origin=Vector Informatik, default-value=false  # Use the configured Init Callback to provide default data. Note: Since the initialization status of the RTE during ReadAll processing is currently unclear (according to AUTOSAR it is not initialized) The init callback cannot be used by SW-Cs via RTE - the setting will be ignored.
      boolean NvmJobendCbkAtReadAll: set at link, origin=Vector Informatik, default-value=false  # Invoke the job end notification Callback also during ReadAll processing. Whether to enable/disable this feature depends on the Integration - whether the related component and/or the RTE it is initialized before the EcuM requests NvM_ReadAll. The default when using Service Ports is FALSE, otherwise it's true.
      derived integer NvmNvBlockBaseNumber: set at link  # Configuration parameter to perform the link between the NVM_NVRAM_BLOCK_IDENTIFIER used by the SW-Cs and the FEE_BLOCK_NUMBER expected by the memory abstraction modules. The parameter relates directly to the FEE_BLOCK_NUMBER or EA_BLOCK_NUMBER with all configured NVM_DATASET_SELECTION_BITS set to zero (ref. to chapter 7.1.2.1). Calculation Formula: "value = TargetBlockReference.[Ea/Fee]BlockConfiguration.[Ea/Fee]BlockNumber"
      derived integer NvmNvramDeviceId: set at link  # Defines the NVRAM device ID where the NVRAM block is located. Calculation Formula: "value = TargetBlockReference.[Ea/Fee]BlockConfiguration.[Ea/Fee]DeviceIndex"
      integer NvmRomBlockNum: 0..255, set at link, default-value=0  # Not used, because Blocks with multiple ROM Blocks are not supported. Defines the number of multiple ROM blocks in a contiguous area according to the given block management type. 0-255 For NVRAM blocks to be configured of block management type NVM_BLOCK_DATASET. The actual range is limited according to NVM148. 0-1 For NVRAM blocks to be configured of block management type NVM_BLOCK_NATIVE 0-1 For NVRAM blocks to be configured of block management type NVM_BLOCK_REDUNDANT
      string NvmRequirementId: set at link, origin=Vector Informatik  # A requirement ID may be entered here for traceability reasons.
      choice container NvmTargetBlockReference
        container NvmEaRef [0..1]  # EEPROM Abstraction
          symbolic name reference NvmNameOfEaBlock: set at link, destination=EaBlockConfiguration  # reference to EaBlock
        container NvmFeeRef [0..1]  # Flash EEPROM Emulation
          symbolic name reference NvmNameOfFeeBlock: set at link, destination=FeeBlockConfiguration  # reference to FeeBlock
    container NvmCommon  # Container for common configuration options.
      boolean NvmDevErrorDetect: set at pre-compile, origin=AUTOSAR_ECUC V1.0.0, default-value=false  # Preprocessor switch to enable the development error detection
      enumeration NvmApiConfigClass: {NvmApiConfigClass1, NvmApiConfigClass2, NvmApiConfigClass3}, set at pre-compile, origin=AUTOSAR_ECUC V1.0.0, default-value=NvmApiConfigClass3  # Preprocessor switch to enable some API calls which are related to NVM API configuration classes.
      boolean NvmVersionInfoApi: set at pre-compile, origin=AUTOSAR_ECUC V1.0.0, default-value=false  # Preprocessor switch to enable the version info API [NVM285], [NVM286].
      boolean NvmSetRamBlockStatusApi: set at pre-compile, origin=AUTOSAR_ECUC V1.0.0, default-value=true  # Preprocessor switch to enable the API NvM_SetRamBlockStatus.
      boolean NvmDrvModeSwitch: set at pre-compile, origin=AUTOSAR_ECUC V1.0.0, default-value=false  # Preprocessor switch to enable switching memory drivers to fast mode during performing NvM_ReadAll and NvM_WriteAll
      boolean NvmPollingMode: set at pre-compile, origin=AUTOSAR_ECUC V1.0.0, default-value=true  # Preprocessor switch to enable/disable the polling mode in the NVRAM Manager and at the same time disable/enable the callback functions useable by lower layers ON Polling mode enabled/ callbacks disabled OFF Polling mode disabled/callbacks enabled
      boolean NvmDynamicConfiguration: set at pre-compile, origin=AUTOSAR_ECUC V1.0.0, default-value=false  # Preprocessor switch to enable the dynamic configuration management handling by the NvM_ReadAll request
      boolean NvmJobPrioritization: set at pre-compile, origin=AUTOSAR_ECUC V1.0.0, default-value=false  # Preprocessor switch to enable job prioritization handling
      integer NvmCrcNumOfBytes: 1..65535, set at link, origin=AUTOSAR_ECUC V1.0.0, default-value=64  # If CRC is configured for at least one NVRAM block, this parameter defines the maximum number of bytes which shall be processed within one cycle of job processing.
      integer NvmDatasetSelectionBits: 0..8, set at link, origin=AUTOSAR_ECUC V1.0.0, default-value=4  # Defines the number of least significant bits which shall be used to address a certain dataset of a NVRAM block within the interface to the memory hardware abstraction. 0..8: Number of bits which are used for dataset or redundant block addressing. 0: No dataset or redundant NVRAM blocks are configured at all, no selection bits required. 1: In case of redundant NVRAM blocks are configured, but no dataset NVRAM blocks.
      integer NvmSizeImmediateJobQueue: 1..254, set at link, origin=AUTOSAR_ECUC V1.0.0, default-value=1  # Defines the number of queue entries for the immediate priority job queue. If NVM_JOB_PRIORITIZATION is switched OFF this parameter shall be out of scope.
      integer NvmSizeStandardJobQueue: 1..254, set at link, origin=AUTOSAR_ECUC V1.0.0, default-value=8  # Defines the number of queue entries for the standard job queue.
      integer NvmMaxNoOfWriteRetries: 0..7, set at link, origin=AUTOSAR_ECUC V1.0.0, default-value=1  # Defines the maximum number of write retries for a NVRAM block with [NVM061]. Regardless of configuration a consistency check (and maybe write retries) are always forced for each block which is processed by the request NvM_WriteAll.
      derived integer NvmTotalNumOfNvramBlocks: 2..65536, set at link, origin=AUTOSAR_ECUC V1.0.0, default-value=2  # This parameter shall publish the total number of configured NVRAM blocks to offer the possibility to do an over-all block handling, e.g. during start-up by a single SW-C.
      integer NvmCompiledConfigId: 0..65535, set at link, origin=AUTOSAR_ECUC V1.0.0, default-value=1  # Configuration ID regarding the NV memory layout. This configuration ID shall be published as e.g. a SW-C shall have the possibility to write it to NV memory.
      function name NvmMultiBlockCallback: set at link, origin=AUTOSAR_ECUC V1.0.0, default-value=NULL_PTR  # Entry address of the common callback routine which shall be invoked on termination of each asynchronous multi block request
    container Nvm_30_CommonVendorParams  # Contains Vector specific Module Configuration Parameters.
      boolean NvmDebugReporting: set at pre-compile, origin=Vector Informatik, default-value=true  # Enables reporting to DET in Development Mode. Has no effects, if NvmDevErrorDetect == OFF
      string NvmCfgIncludeDet: set at pre-compile, origin=Vector Informatik, default-value=Det.h  # Header file, declaring the Devolopment Error reporting function
      string NvmErrorhook: set at pre-compile, origin=Vector Informatik, default-value=Det_ReportError  # Development error reporting function. Must have following prototype: void <Name>(uint16 ModuleId, uint8 InstanceId, uint8 ServiceId, uint8 ErrorCode);
      boolean NvmCfgChkStatusUninit: set at pre-compile, origin=Vector Informatik, default-value=true  # Enable/Disable UNINIT checks
      boolean NvmCfgChkMngmtType: set at pre-compile, origin=Vector Informatik, default-value=true  # Check for block's Managmement Type in NvM_SetDatIndex() and NvM_GetDataIndex() APIs
      boolean NvmCfgChkBlockProtection: set at pre-compile, origin=Vector Informatik, default-value=true  # Enable/Disable check of Block's write protection in NvM_WriteBlock(), NvM_InvalidateNvBlock() and NvM_EraseNvBlock()
      boolean NvmCfgChkBlockPending: set at pre-compile, origin=Vector Informatik, default-value=true  # Enable/Disable PENDING checks in APIs (There may only one request per Block be pending)
      boolean NvmCfgChkDoParamChk: set at pre-compile, origin=Vector Informatik, default-value=true  # Globally Enable/Disable parameter checks (BlockId, DataIndex, Pointer)
      boolean NvmCfgChkParamBlockid: set at pre-compile, origin=Vector Informatik, default-value=true  # Enable/Disable BlockId checks in all services expecting a BlockId as parameter
      boolean NvmCfgChkParamDataIndex: set at pre-compile, origin=Vector Informatik, default-value=true  # Enable/Disable DataIndex check in NvM_SetDataIndex()
      boolean NvmCfgChkParamPointer: set at pre-compile, origin=Vector Informatik, default-value=true  # Enable/Disable NULL_POINTER_CHECKS in NvM_GetVersionInfo(), NvM_ReadBlock(), NvM_WriteBlock(), NvM_RestoreBlockDefaults(), NvM_GetErrorStatus(), NvM_GetDataIndex()
      string NvmCfgIncludeDem: set at pre-compile, origin=Vector Informatik, default-value=Dem.h
      function name NvmSeterror: set at pre-compile, origin=Vector Informatik, default-value=Dem_ReportErrorStatus  # DEM's error reporting function: void <Name>(Dem_EventNoType EventNo, DemEventStatusType EventStatus)
      string NvmCfgCbkIncludeList [0..*]: set at link, origin=Vector Informatik, default-value=Application.h  # List containing the header file(s) declaring the call back functions, and the blocks' symbol declarations, i.e. the multi block callback the single block call backs, the block init callbacks, the ram block symbols as well as the rom block symbols.
      string NvmMultiblockId: set at link, origin=Vector Informatik, default-value=MultiBlockRequest  # symbolic name if the multi block ID (Block Id 0). May be used in EcuM.
      string NvmServiceComponentName: set at link, origin=Vector Informatik, default-value=NvM  # Service Component Name in SWC-Description. Used to define a unique name space. Proposal: just append an arbitrary name to the default value. Note: The maximum lenght are 20 characters, in order to be able to append some specific characters in the SWC-Description.
      string NvmSrvPortJobEndPrefix: set at published-information, origin=Vector Informatik, default-value=NvM_RpNotifyJobEnd_  # Port Prototype prefix for "Job End Notification" Callback, to be used in - SWC Description generation - Code Generation
      string NvmSrvPortInitBlockPrefix: set at published-information, origin=Vector Informatik, default-value=Nvm_RpNotifyInit_  # Port Prototype prefix for "Block Init Notification" Callback, to be used in - SWC Description generation - Code Generation
      boolean Nvm_UseLongSwcNames: set at link, origin=Vector Informatik, default-value=true  # Generate Long Names for Service Port Names (up to 128 chars, instead of 32). Should be enabled, when using DaVinci. Has no effects, if no NVRAM Block was configured for using Service Ports
      boolean NvmCrcIntBuffer: set at pre-compile, origin=Vector Informatik, default-value=true  # Enabling and disabling internal Crc Buffer. If Internal Crc Buffer is enabled, NvM handles Crc in an internal buffer. Memory for Crc must not be allocated at the end of Ram Block. Is Internal Crc Buffer disabled, Memory for Crc at the end of Ram Block is necessary!
      boolean NvmCfgChkRamBlockLengths: set at link, origin=Vector Informatik, default-value=true  # Check RAM Blocks' Lengths at startup during NvM_Init(), using the sizeof operator Related DET Error Code: NVM_E_ROM_BLOCK_LENGTH
      boolean NvmCfgChkRomBlockLengths: set at link, origin=Vector Informatik, default-value=true  # Check ROM Blocks' Lengths at startup during NvM_Init(), using the sizeof operator Related DET Error Code: NVM_E_RAM_BLOCK_LENGTH
      boolean NvmCfgChkBlockLengthStrict: set at link, origin=Vector Informatik, default-value=true  # Enables strict/loose block length checks. Strict checks require the RAM/ROM Blocks to match the configured Block Lengths exactly. Loose checks require the RAM/ROM Block sizes to be greater than or equal to the related block sizes. The strict check shall help to detect alignment issues in compiler, which would make user data larger than specified in NVM configuration. As a result the NVM would not write/read all user data to/from NV memory.
      boolean NvmCrcPreserveValue: set at pre-compile, origin=Vector Informatik, default-value=true  # Controls CRC calculation: if enabled, the calculated CRC is guaranteed to be independent of the number of steps (depending on NvmCrcNumOfBytes) to be performed to calculate the CRC. The result is always the (standard) CRC value, as if it was calculated with one step. This is important for CRC32. This parameter enables you to keep compatibility with previous releases: Disable it to keep previous behavior. However, disabling is recommended only if you want/need to keep data (with CRC32) already stored in NV memory.
      boolean NvmKillWriteAllApi: set at pre-compile, origin=Vector Informatik, default-value=true  # Gives User (EcuM) the possibility to time-out WriteAll cancellation (NvM_CancelWriteAll)
      reference NvmLockSet: set at link, origin=Vector Informatik, destination=InterruptFunctionSet  # Function set for entering/leaving Critical sections.
    container NvmConfigBlockDescriptor  # Container to configure the composition the config Id Block (BlockId 1).
      enumeration NvmBlockCRCType: {NVM_CRC16, NVM_CRC32}, set at link, origin=Vector Informatik, default-value=NVM_CRC16  # Defines CRC data width for the NVRAM block. Default: NVM_CRC16.
      integer NvmBlockJobPriority: 0..255, set at link, origin=Vector Informatik, default-value=127  # Defines the job priority for a NVRAM block. The lower the number, the higher the priority. 0 defines immediate write priority, i.e. write job with this priority cancels other jobs with lower priority. Will be ignored, if NvmJobPrioritization is deactivated.
      enumeration NvmBlockManagementType: {NVM_BLOCK_DATASET, NVM_BLOCK_NATIVE, NVM_BLOCK_REDUNDANT}, set at link, origin=Vector Informatik, default-value=NVM_BLOCK_REDUNDANT  # Defines the block management type for the NVRAM block.[NVM137] Fixed to "redundant"
      boolean NvmBlockUseCrc: set at link, origin=Vector Informatik, default-value=true  # Defines CRC usage for the NVRAM block, i.e. memory space for CRC is reserved in RAM and NV memory. Fixed to "yes/true/on"
      boolean NvmBlockWriteProt: set at link, origin=Vector Informatik, default-value=false  # Defines an initial write protection (which is set during start-up) of the NV block.
      boolean NvmCalcRamBlockCrc: set at link, origin=Vector Informatik, default-value=true  # Defines CRC (re)calculation for the permanent RAM block
      function name NvmInitBlockCallback: set at link, origin=Vector Informatik, default-value=NULL_PTR  # For ther Config Id Block it is fixed to a NULL pointer,thus no specific callback routine shall be called for initialization of the NVRAM block with default data.
      integer NvmNvBlockLength: 1..65535, set at link, origin=Vector Informatik, default-value=2  # Defines the NV block data length in bytes. The ConfigId Block has a fixed length of 2bytes.
      integer NvmNvBlockNum: 1..255, set at link, origin=Vector Informatik, default-value=2  # Defines the number of multiple NV blocks in a contiguous area according to the given block management type. Fixed to "2" --> redundant block
      string NvmRamBlockDataAddress [0..1]: set at link, origin=Vector Informatik  # Defines the start address of the RAM block data. Enter NULL_PTR or leave empty (default) to let NVM create an internal RAM block on its own. In this case you cannot access the RAM block!
      boolean NvmResistantToChangedSw: set at link, origin=Vector Informatik, default-value=true  # The ConfigId Block must always be resistant against software updates
      string NvmRomBlockDataAddress: set at link, origin=Vector Informatik, default-value=NULL_PTR  # The Config Id BLock does not have ROM defaults.
      boolean NvmSelectBlockForReadall: set at link, origin=Vector Informatik, default-value=true  # Config Id Block will always be read during ReadAll
      function name NvmSingleBlockCallback: set at link, origin=Vector Informatik  # Entry address of the block specific callback routine which shall be invoked on termination of each asynchronous single block request.
      boolean NvmWriteBlockOnce: set at link, origin=Vector Informatik, default-value=false  # Mark this block as write once. The NVRAM manager sets the write protection bit after the NV block was written the first time. This means that some of the NV blocks in the NVRAM should never be erased nor be replaced with the default ROM data after first initialization. [NVM276]
      integer NvmNvramBlockIdentifier: 1..65535, set at link, origin=Vector Informatik, symbolic-name-value=true, default-value=1  # Numeric handle of the NVRAM Block to be passed as BlockId parmater to the NVM. This value will be calucuated automatically. In EAD it is not writeable by user.
      boolean NvmUseServicePorts: set at link, origin=Vector Informatik, default-value=true  # Mark this block as accessible via service ports. The PortName will be derived from the symbolic block Number (here: 1)!.
      string NvmDeviceName: set at link, origin=Vector Informatik  # Device name
      boolean NvmUseJobendCallback: set at link, origin=Vector Informatik, default-value=true  # Use the configfured Callback for Single Block Job End Notification, either directly or via Service Port (RTE), depending on the "Use Service Ports" setting
      boolean NvmUseInitCallback: set at link, origin=Vector Informatik, default-value=false  # Use the configfured Init Callback for , either directly or via Service Port (RTE), depending on the "Use Service Ports" setting. For the Configuration Block, no Init callback is allowed, thus this value is fixed to FALSE
      boolean NvmJobendCbkAtReadAll: set at link, origin=Vector Informatik, default-value=false  # Invoke the job end notification Callback also during ReadAll processing. Whether to enable/disable this feature depends on the Integration - whether the related component and/or the RTE it is initialized before the EcuM requests NvM_ReadAll. The default when using Service Ports is FALSE, otherwise it's true.
      enumeration NvmBlockUsedCrcType: {NVM_NOCRC, NVM_CRC16, NVM_CRC32}, set at link, origin=Vector Informatik, default-value=NVM_CRC16  # Internal CRC configuration --> for better graphical configuration
      derived integer NvmNvBlockBaseNumber: set at link, origin=Vector Informatik  # Configuration parameter to perform the link between the NVM_NVRAM_BLOCK_IDENTIFIER used by the SW-Cs and the FEE_BLOCK_NUMBER expected by the memory abstraction modules. The parameter relates directly to the FEE_BLOCK_NUMBER or EA_BLOCK_NUMBER with all configured NVM_DATASET_SELECTION_BITS set to zero (ref. to chapter 7.1.2.1). Calculation Formula: "value = TargetBlockReference.[Ea/Fee]BlockConfiguration.[Ea/Fee]BlockNumber"
      derived integer NvmNvramDeviceId: set at link, origin=Vector Informatik  # Defines the NVRAM device ID where the NVRAM block is located. Calculation Formula: "value = TargetBlockReference.[Ea/Fee]BlockConfiguration.[Ea/Fee]DeviceIndex"
      integer NvmRomBlockNum: 0..255, set at link, origin=Vector Informatik, default-value=0  # Not used for the Config Id Block. It does not have any ROM Block, at all
      string NvmRequirementId: set at link, origin=Vector Informatik  # A requirement ID may be entered here for traceability reasons.
      choice container NvmTargetBlockReference  # The NV block base number shall be used to access a certain block via the memory abstraction interface. It is needed to make the link between the NVM_NVRAM_BLOCK_IDENTIFIER used by the SW-Cs and the FEE_BLOCK_NUMBER expected by the memory abstraction modules.
        container NvmEaRef [0..1]  # EEPROM Abstraction
          symbolic name reference NvmNameOfEaBlock: set at link, origin=Vector Informatik, destination=EaBlockConfiguration  # reference to EaBlock
        container NvmFeeRef [0..1]  # Flash EEPROM Emulation
          symbolic name reference NvmNameOfFeeBlock: set at link, origin=Vector Informatik, destination=FeeBlockConfiguration  # reference to FeeBlock
  bsw implementation NvM_Impl: code-generator=cMICROSAR, programming-language=C, sw-major-version=3, sw-minor-version=7, sw-patch-version=1, vendor-id=30, ar-major-version=2, ar-minor-version=2, ar-patch-version=0, preconfigured-configuration=NvM_Pre, recommended-configuration=NvM_Rec, vendor-specific-module-def=NvM
  module config NvM_Pre: definition=NvM
  module config NvM_Rec: definition=NvM
