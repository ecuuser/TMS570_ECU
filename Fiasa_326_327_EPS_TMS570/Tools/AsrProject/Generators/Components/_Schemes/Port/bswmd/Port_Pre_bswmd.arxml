AUTOSAR XML (schema 3.1.4)
package /MICROSAR
  module config Port_Pre: definition=Port
    PortConfigSet
      20 x PortContainer, all with PortAvailablePackage1=true:
        GIOA: PortNumberOfPortPins=8, PortName=GIO A, PortRegPostfix=GIOA, PortAvailablePackage0=false, PortAvailablePackage2=true, PortAvailablePackage3=false, PortAvailablePackage4=false, PortRegBaseAddr=4294425648, PortRegStructure=PORT_REG_STRUCT_REGULAR_NO_FUNC, PortContainsPrivReg=false
          8 x PortPin, all with PortPinAvailablePackage0=false, PortPinAvailablePackage1=true, PortPinAvailablePackage2=true, PortPinAvailablePackage3=false, PortPinAvailablePackage4=false, PortPinSlewRate=PORT_PIN_SLEW_RATE_NA:
            PortPinGioA_0: PortPinId=0, PortPinName=GIOA0
            PortPinGioA_1: PortPinId=1, PortPinName=GIOA1
            PortPinGioA_2: PortPinName=GIOA2, PortPinId=2
            PortPinGioA_{3..6}: PortPinId={3..6}, PortPinName=GIOA{3..6}
            PortPinGioA_7: PortPinName=GIOA7, PortPinId=7
        GIOB: PortNumberOfPortPins=8, PortName=GIO B, PortRegPostfix=GIOB, PortAvailablePackage2=true, PortAvailablePackage3=false, PortAvailablePackage4=false, PortAvailablePackage0=true, PortRegBaseAddr=4294425680, PortRegStructure=PORT_REG_STRUCT_REGULAR_NO_FUNC, PortContainsPrivReg=false
          8 x PortPin, all with PortPinAvailablePackage0=true, PortPinAvailablePackage1=true, PortPinAvailablePackage2=true, PortPinAvailablePackage3=false, PortPinAvailablePackage4=false, PortPinSlewRate=PORT_PIN_SLEW_RATE_NA:
            PortPinGioB_{0..7}: PortPinId={0..7}, PortPinName=GIOB{0..7}
        CAN1: PortNumberOfPortPins=2, PortName=CAN 1, PortRegPostfix=CAN1, PortAvailablePackage0=false, PortAvailablePackage2=true, PortAvailablePackage3=false, PortAvailablePackage4=false, PortRegBaseAddr=4294434272, PortRegStructure=PORT_REG_STRUCT_SHORT, PortContainsPrivReg=true
          PortPinCan1_0 (PortPin):
            PortPinId = 0
            PortPinAvailablePackage0 = false
            PortPinAvailablePackage1 = true
            PortPinAvailablePackage2 = true
            PortPinAvailablePackage3 = false
            PortPinAvailablePackage4 = false
            PortPinName = CAN1TX
            PortPinSlewRate = PORT_PIN_SLEW_RATE_NA
          PortPinCan1_1 (PortPin):
            PortPinId = 1
            PortPinAvailablePackage0 = false
            PortPinAvailablePackage1 = true
            PortPinAvailablePackage2 = true
            PortPinAvailablePackage3 = false
            PortPinAvailablePackage4 = false
            PortPinName = CAN1RX
            PortPinSlewRate = PORT_PIN_SLEW_RATE_NA
        CAN2: PortNumberOfPortPins=2, PortName=CAN 2, PortRegPostfix=CAN2, PortAvailablePackage0=false, PortAvailablePackage2=true, PortAvailablePackage3=false, PortAvailablePackage4=false, PortRegBaseAddr=4294434784, PortRegStructure=PORT_REG_STRUCT_SHORT, PortContainsPrivReg=true
          PortPinCan2_0 (PortPin):
            PortPinId = 0
            PortPinAvailablePackage0 = false
            PortPinAvailablePackage1 = true
            PortPinAvailablePackage2 = true
            PortPinAvailablePackage3 = false
            PortPinAvailablePackage4 = false
            PortPinName = CAN2TX
            PortPinSlewRate = PORT_PIN_SLEW_RATE_NA
          PortPinCan2_1 (PortPin):
            PortPinId = 1
            PortPinAvailablePackage0 = false
            PortPinAvailablePackage1 = true
            PortPinAvailablePackage2 = true
            PortPinAvailablePackage3 = false
            PortPinAvailablePackage4 = false
            PortPinName = CAN2RX
            PortPinSlewRate = PORT_PIN_SLEW_RATE_NA
        CAN3: PortNumberOfPortPins=2, PortName=CAN 3, PortRegPostfix=CAN3, PortAvailablePackage0=false, PortAvailablePackage2=true, PortAvailablePackage3=false, PortAvailablePackage4=false, PortRegBaseAddr=4294435296, PortRegStructure=PORT_REG_STRUCT_SHORT, PortContainsPrivReg=true
          PortPinCan3_0 (PortPin):
            PortPinId = 0
            PortPinAvailablePackage0 = false
            PortPinAvailablePackage1 = true
            PortPinAvailablePackage2 = true
            PortPinAvailablePackage3 = false
            PortPinAvailablePackage4 = false
            PortPinName = CAN3TX
            PortPinSlewRate = PORT_PIN_SLEW_RATE_NA
          PortPinCan3_1 (PortPin):
            PortPinId = 1
            PortPinAvailablePackage0 = false
            PortPinAvailablePackage1 = true
            PortPinAvailablePackage2 = true
            PortPinAvailablePackage3 = false
            PortPinAvailablePackage4 = false
            PortPinName = CAN3RX
            PortPinSlewRate = PORT_PIN_SLEW_RATE_NA
        LIN: PortNumberOfPortPins=2, PortName=LIN, PortRegPostfix=LIN, PortAvailablePackage0=false, PortAvailablePackage2=true, PortAvailablePackage3=false, PortAvailablePackage4=false, PortRegBaseAddr=4294435900, PortRegStructure=PORT_REG_STRUCT_REGULAR_SLEW_1, PortContainsPrivReg=false
          PortPinLin1_0 (PortPin):
            PortPinId = 1
            PortPinAvailablePackage0 = false
            PortPinAvailablePackage1 = true
            PortPinAvailablePackage2 = true
            PortPinAvailablePackage3 = false
            PortPinAvailablePackage4 = false
            PortPinName = LINRX
            PortPinSlewRate = PORT_PIN_SLEW_RATE_NA
          PortPinLin1_1 (PortPin):
            PortPinId = 2
            PortPinAvailablePackage0 = false
            PortPinAvailablePackage1 = true
            PortPinAvailablePackage2 = true
            PortPinAvailablePackage3 = false
            PortPinAvailablePackage4 = false
            PortPinName = LINTX
            PortPinSlewRate = PORT_PIN_SLEW_RATE_NA
        SCI: PortNumberOfPortPins=2, PortName=SCI, PortRegPostfix=SCI, PortAvailablePackage0=false, PortAvailablePackage2=true, PortAvailablePackage3=false, PortAvailablePackage4=false, PortRegBaseAddr=4294436156, PortRegStructure=PORT_REG_STRUCT_REGULAR_SLEW_1, PortContainsPrivReg=false
          PortPinSci1_0 (PortPin):
            PortPinId = 1
            PortPinAvailablePackage0 = false
            PortPinAvailablePackage1 = true
            PortPinAvailablePackage2 = true
            PortPinAvailablePackage3 = false
            PortPinAvailablePackage4 = false
            PortPinName = SCIRX
            PortPinSlewRate = PORT_PIN_SLEW_RATE_NA
          PortPinSci1_1 (PortPin):
            PortPinId = 2
            PortPinAvailablePackage0 = false
            PortPinAvailablePackage1 = true
            PortPinAvailablePackage2 = true
            PortPinAvailablePackage3 = false
            PortPinAvailablePackage4 = false
            PortPinName = SCITX
            PortPinSlewRate = PORT_PIN_SLEW_RATE_NA
        I2C: PortNumberOfPortPins=2, PortName=I2C, PortRegPostfix=IIC, PortAvailablePackage0=false, PortAvailablePackage2=true, PortAvailablePackage3=false, PortAvailablePackage4=false, PortRegBaseAddr=4294431816, PortRegStructure=PORT_REG_STRUCT_REGULAR_SLEW_1, PortContainsPrivReg=false
          PortPinIic_0 (PortPin):
            PortPinId = 0
            PortPinAvailablePackage0 = false
            PortPinAvailablePackage1 = true
            PortPinAvailablePackage2 = true
            PortPinAvailablePackage3 = false
            PortPinAvailablePackage4 = false
            PortPinName = I2C_SCL
            PortPinSlewRate = PORT_PIN_SLEW_RATE_NA
          PortPinIic_1 (PortPin):
            PortPinId = 1
            PortPinAvailablePackage0 = false
            PortPinAvailablePackage1 = true
            PortPinAvailablePackage2 = true
            PortPinAvailablePackage3 = false
            PortPinAvailablePackage4 = false
            PortPinName = I2C_SDA
            PortPinSlewRate = PORT_PIN_SLEW_RATE_NA
        SPI1: PortNumberOfPortPins=16, PortName=MBSPI 1, PortRegPostfix=SPI1, PortAvailablePackage2=true, PortAvailablePackage3=true, PortAvailablePackage4=true, PortAvailablePackage0=true, PortRegBaseAddr=4294439956, PortRegStructure=PORT_REG_STRUCT_REGULAR_SLEW_2, PortContainsPrivReg=false
          12 x PortPin, all with PortPinAvailablePackage0=true, PortPinAvailablePackage1=true, PortPinAvailablePackage2=true, PortPinAvailablePackage3=true, PortPinSlewRate=PORT_PIN_SLEW_RATE_NA:
            PortPinSpi1_0: PortPinId=9, PortPinAvailablePackage4=true, PortPinName=SPI1CLK
            PortPinSpi1_1: PortPinId=0, PortPinAvailablePackage4=true, PortPinName=SPI1NCS0
            PortPinSpi1_2: PortPinId=1, PortPinAvailablePackage4=true, PortPinName=SPI1NCS1
            PortPinSpi1_3: PortPinId=2, PortPinAvailablePackage4=false, PortPinName=SPI1NCS2
            PortPinSpi1_4: PortPinId=3, PortPinAvailablePackage4=false, PortPinName=SPI1NCS3
            PortPinSpi1_5: PortPinId=4, PortPinAvailablePackage4=false, PortPinName=SPI1NCS4
            PortPinSpi1_6: PortPinId=5, PortPinAvailablePackage4=false, PortPinName=SPI1NCS5
            PortPinSpi1_7: PortPinId=8, PortPinAvailablePackage4=true, PortPinName=SPI1NENA
            PortPinSpi1_8: PortPinId=10, PortPinAvailablePackage4=true, PortPinName=SPI1SIMO0
            PortPinSpi1_9: PortPinId=17, PortPinAvailablePackage4=true, PortPinName=SPI1SIMO1
            PortPinSpi1_10: PortPinId=11, PortPinAvailablePackage4=true, PortPinName=SPI1SOMI0
            PortPinSpi1_11: PortPinId=25, PortPinAvailablePackage4=true, PortPinName=SPI1SOMI1
        SPI2: PortNumberOfPortPins=8, PortName=SPI 2, PortRegPostfix=SPI2, PortAvailablePackage0=false, PortAvailablePackage2=true, PortAvailablePackage3=false, PortAvailablePackage4=false, PortRegBaseAddr=4294440468, PortRegStructure=PORT_REG_STRUCT_REGULAR_SLEW_2, PortContainsPrivReg=false
          6 x PortPin, all with PortPinAvailablePackage0=false, PortPinAvailablePackage1=true, PortPinAvailablePackage2=true, PortPinAvailablePackage3=false, PortPinAvailablePackage4=false, PortPinSlewRate=PORT_PIN_SLEW_RATE_NA:
            PortPinSpi2_0: PortPinId=9, PortPinName=SPI2CLK
            PortPinSpi2_1: PortPinId=0, PortPinName=SPI2NCS0
            PortPinSpi2_2: PortPinId=1, PortPinName=SPI2NCS1
            PortPinSpi2_5: PortPinId=8, PortPinName=SPI2NENA
            PortPinSpi2_6: PortPinId=10, PortPinName=SPI2SIMO
            PortPinSpi2_7: PortPinId=11, PortPinName=SPI2SOMI
        SPI3: PortNumberOfPortPins=16, PortName=MBSPI 3, PortRegPostfix=SPI3, PortAvailablePackage2=true, PortAvailablePackage3=true, PortAvailablePackage4=true, PortAvailablePackage0=true, PortRegBaseAddr=4294440980, PortRegStructure=PORT_REG_STRUCT_REGULAR_SLEW_2, PortContainsPrivReg=false
          10 x PortPin, all with PortPinSlewRate=PORT_PIN_SLEW_RATE_NA:
            PortPinSpi3_0: PortPinId=9, PortPinAvailablePackage0=true, PortPinAvailablePackage1=true, PortPinAvailablePackage2=true, PortPinAvailablePackage3=true, PortPinAvailablePackage4=true, PortPinName=SPI3CLK
            PortPinSpi3_1: PortPinId=0, PortPinAvailablePackage0=true, PortPinAvailablePackage1=true, PortPinAvailablePackage2=true, PortPinAvailablePackage3=true, PortPinAvailablePackage4=true, PortPinName=SPI3NCS0
            PortPinSpi3_2: PortPinId=1, PortPinAvailablePackage0=true, PortPinAvailablePackage1=true, PortPinAvailablePackage2=true, PortPinAvailablePackage3=true, PortPinAvailablePackage4=true, PortPinName=SPI3NCS1
            PortPinSpi3_3: PortPinId=2, PortPinAvailablePackage0=true, PortPinAvailablePackage1=true, PortPinAvailablePackage2=true, PortPinAvailablePackage3=true, PortPinAvailablePackage4=false, PortPinName=SPI3NCS2
            PortPinSpi3_4: PortPinId=3, PortPinAvailablePackage0=true, PortPinAvailablePackage1=true, PortPinAvailablePackage2=true, PortPinAvailablePackage3=true, PortPinAvailablePackage4=false, PortPinName=SPI3NCS3
            PortPinSpi3_7: PortPinId=8, PortPinAvailablePackage0=true, PortPinAvailablePackage1=true, PortPinAvailablePackage2=true, PortPinAvailablePackage3=true, PortPinAvailablePackage4=true, PortPinName=SPI3NENA
            PortPinSpi3_8: PortPinId=10, PortPinAvailablePackage0=true, PortPinAvailablePackage1=true, PortPinAvailablePackage2=true, PortPinAvailablePackage3=true, PortPinAvailablePackage4=true, PortPinName=SPI3SIMO
            PortPinSpi3_10: PortPinId=11, PortPinAvailablePackage0=true, PortPinAvailablePackage1=true, PortPinAvailablePackage2=true, PortPinAvailablePackage3=true, PortPinAvailablePackage4=true, PortPinName=SPI3SOMI
            PortPinSpi3_5: PortPinId=4, PortPinAvailablePackage0=true, PortPinAvailablePackage1=true, PortPinAvailablePackage2=true, PortPinAvailablePackage3=true, PortPinAvailablePackage4=true, PortPinName=SPI3NCS4
            PortPinSpi3_6: PortPinId=5, PortPinAvailablePackage0=(unset), PortPinAvailablePackage1=(unset), PortPinAvailablePackage2=(unset), PortPinAvailablePackage3=(unset), PortPinAvailablePackage4=(unset), PortPinName=SPI3NCS5
        SPI4: PortNumberOfPortPins=8, PortName=SPI 4, PortRegPostfix=SPI4, PortAvailablePackage0=false, PortAvailablePackage2=true, PortAvailablePackage3=false, PortAvailablePackage4=false, PortRegBaseAddr=4294441492, PortRegStructure=PORT_REG_STRUCT_REGULAR_SLEW_2, PortContainsPrivReg=false
          5 x PortPin, all with PortPinAvailablePackage0=false, PortPinAvailablePackage1=true, PortPinAvailablePackage2=true, PortPinAvailablePackage3=false, PortPinAvailablePackage4=false, PortPinSlewRate=PORT_PIN_SLEW_RATE_NA:
            PortPinSpi4_0: PortPinId=9, PortPinName=SPI4CLK
            PortPinSpi4_1: PortPinId=0, PortPinName=SPI4NCS0
            PortPinSpi4_5: PortPinId=8, PortPinName=SPI4NENA
            PortPinSpi4_6: PortPinId=10, PortPinName=SPI4SIMO
            PortPinSpi4_7: PortPinId=11, PortPinName=SPI4SOMI
        SPI5: PortNumberOfPortPins=16, PortName=MBSPI 5, PortRegPostfix=SPI5, PortAvailablePackage2=true, PortAvailablePackage3=true, PortAvailablePackage4=true, PortAvailablePackage0=true, PortRegBaseAddr=4294442004, PortRegStructure=PORT_REG_STRUCT_REGULAR_SLEW_2, PortContainsPrivReg=false
          14 x PortPin, all with PortPinAvailablePackage0=true, PortPinAvailablePackage1=true, PortPinAvailablePackage2=true, PortPinAvailablePackage3=true, PortPinSlewRate=PORT_PIN_SLEW_RATE_NA:
            PortPinSpi5_0: PortPinId=9, PortPinAvailablePackage4=true, PortPinName=SPI5CLK
            PortPinSpi5_1: PortPinId=0, PortPinAvailablePackage4=true, PortPinName=SPI5NCS0
            PortPinSpi5_2: PortPinId=1, PortPinAvailablePackage4=true, PortPinName=SPI5NCS1
            PortPinSpi5_3: PortPinId=2, PortPinAvailablePackage4=false, PortPinName=SPI5NCS2
            PortPinSpi5_4: PortPinId=3, PortPinAvailablePackage4=false, PortPinName=SPI5NCS3
            PortPinSpi5_5: PortPinId=8, PortPinAvailablePackage4=true, PortPinName=SPI5NENA
            PortPinSpi5_6: PortPinId=10, PortPinAvailablePackage4=true, PortPinName=SPI5SIMO0
            PortPinSpi5_7: PortPinId=17, PortPinAvailablePackage4=true, PortPinName=SPI5SIMO1
            PortPinSpi5_8: PortPinAvailablePackage4=true, PortPinName=SPI5SIMO2, PortPinId=18
            PortPinSpi5_9: PortPinId=19, PortPinAvailablePackage4=true, PortPinName=SPI5SIMO3
            PortPinSpi5_10: PortPinId=11, PortPinAvailablePackage4=true, PortPinName=SPI5SOMI0
            PortPinSpi5_11: PortPinId=25, PortPinAvailablePackage4=true, PortPinName=SPI5SOMI1
            PortPinSpi5_12: PortPinId=26, PortPinAvailablePackage4=true, PortPinName=SPI5SOMI2
            PortPinSpi5_13: PortPinId=27, PortPinAvailablePackage4=true, PortPinName=SPI5SOMI3
        NHET1: PortNumberOfPortPins=32, PortName=NHET1, PortRegPostfix=NHET1, PortAvailablePackage0=false, PortAvailablePackage2=true, PortAvailablePackage3=false, PortAvailablePackage4=false, PortRegBaseAddr=4294424648, PortRegStructure=PORT_REG_STRUCT_REGULAR_NO_FUNC, PortContainsPrivReg=false
          32 x PortPin, all with PortPinAvailablePackage0=false, PortPinAvailablePackage1=true, PortPinAvailablePackage2=true, PortPinAvailablePackage3=false, PortPinAvailablePackage4=false, PortPinSlewRate=PORT_PIN_SLEW_RATE_NA:
            PortPinNHet1_{0..29}: PortPinId={0..29}, PortPinName=NHET1_{0..29}
            PortPinNHet1_30: PortPinName=NHET1_30, PortPinId=30
            PortPinNHet1_31: PortPinId=31, PortPinName=NHET1_31
        NHET2: PortNumberOfPortPins=32, PortName=NHET2, PortRegPostfix=NHET2, PortAvailablePackage0=false, PortAvailablePackage2=true, PortAvailablePackage3=false, PortAvailablePackage4=false, PortRegBaseAddr=4294424904, PortRegStructure=PORT_REG_STRUCT_REGULAR_NO_FUNC, PortContainsPrivReg=false
          18 x PortPin, all with PortPinAvailablePackage0=false, PortPinAvailablePackage1=true, PortPinAvailablePackage2=true, PortPinAvailablePackage3=false, PortPinAvailablePackage4=false, PortPinSlewRate=PORT_PIN_SLEW_RATE_NA:
            PortPinNHet2_{0..16}: PortPinId={0..16}, PortPinName=NHET2_{0..16}
            PortPinNHet2_18: PortPinId=18, PortPinName=NHET2_18
        SYS: PortNumberOfPortPins=1, PortName=ECLK, PortRegPostfix=SYS, PortAvailablePackage0=false, PortAvailablePackage2=true, PortAvailablePackage3=false, PortAvailablePackage4=false, PortRegBaseAddr=4294967040, PortRegStructure=PORT_REG_STRUCT_REGULAR_SLEW_1, PortContainsPrivReg=false
          PortPinEcp_0 (PortPin):
            PortPinId = 0
            PortPinAvailablePackage0 = false
            PortPinAvailablePackage1 = true
            PortPinAvailablePackage2 = true
            PortPinAvailablePackage3 = false
            PortPinAvailablePackage4 = false
            PortPinName = ECLK
        ADC1: PortNumberOfPortPins=1, PortName=MibADC 1, PortRegPostfix=ADC1, PortAvailablePackage0=false, PortAvailablePackage2=true, PortAvailablePackage3=false, PortAvailablePackage4=false, PortRegBaseAddr=4294426872, PortRegStructure=PORT_REG_STRUCT_REGULAR_PERMUTED, PortContainsPrivReg=false
          PortPinADC1_0 (PortPin):
            PortPinId = 0
            PortPinAvailablePackage0 = false
            PortPinAvailablePackage1 = true
            PortPinAvailablePackage2 = true
            PortPinAvailablePackage3 = false
            PortPinAvailablePackage4 = false
            PortPinName = AD1EVT
            PortPinSlewRate = PORT_PIN_SLEW_RATE_NA
        ADC2: PortNumberOfPortPins=1, PortName=MibADC 2, PortRegPostfix=ADC2, PortAvailablePackage0=false, PortAvailablePackage2=true, PortAvailablePackage3=false, PortAvailablePackage4=false, PortRegBaseAddr=4294427384, PortRegStructure=PORT_REG_STRUCT_REGULAR_PERMUTED, PortContainsPrivReg=false
          PortPinADC2_0 (PortPin):
            PortPinId = 0
            PortPinAvailablePackage0 = false
            PortPinAvailablePackage1 = true
            PortPinAvailablePackage2 = true
            PortPinAvailablePackage3 = false
            PortPinAvailablePackage4 = false
            PortPinName = AD2EVT
            PortPinSlewRate = PORT_PIN_SLEW_RATE_NA
        RTP: PortNumberOfPortPins=19, PortName=RTP, PortRegPostfix=RTP, PortAvailablePackage0=false, PortAvailablePackage2=true, PortAvailablePackage3=false, PortAvailablePackage4=false, PortRegBaseAddr=4294965812, PortRegStructure=PORT_REG_STRUCT_REGULAR_NO_SLEW, PortContainsPrivReg=false
          19 x PortPin, all with PortPinAvailablePackage0=false, PortPinAvailablePackage1=true, PortPinAvailablePackage2=true, PortPinAvailablePackage3=false, PortPinAvailablePackage4=false, PortPinSlewRate=PORT_PIN_SLEW_RATE_NA:
            PortPinRtp_{0..15}: PortPinId={0..15}, PortPinName=RPTDATA{0..15}
            PortPinRtp_16: PortPinId=16, PortPinName=RPTSYNC
            PortPinRtp_17: PortPinId=17, PortPinName=RPTCLK
            PortPinRtp_18: PortPinId=18, PortPinName=RPTENA
        DMM: PortNumberOfPortPins=19, PortName=DMM, PortRegPostfix=DMM, PortAvailablePackage2=false, PortAvailablePackage3=false, PortAvailablePackage4=false, PortAvailablePackage0=true, PortRegBaseAddr=4294965100, PortRegStructure=PORT_REG_STRUCT_REGULAR_NO_SLEW, PortContainsPrivReg=false
          19 x PortPin, all with PortPinAvailablePackage0=true, PortPinAvailablePackage1=true, PortPinAvailablePackage2=false, PortPinAvailablePackage3=false, PortPinAvailablePackage4=false, PortPinSlewRate=PORT_PIN_SLEW_RATE_NA:
            PortPinDmm_0: PortPinId=0, PortPinName=DMMSYNC
            PortPinDmm_1: PortPinId=1, PortPinName=DMMCLK
            PortPinDmm_2: PortPinId=2, PortPinName=DMMDATA0
            PortPinDmm_3: PortPinId=3, PortPinName=DMMDATA1
            PortPinDmm_4: PortPinId=4, PortPinName=DMMDATA2
            PortPinDmm_5: PortPinId=5, PortPinName=DMMDATA3
            PortPinDmm_6: PortPinId=6, PortPinName=DMMDATA4
            PortPinDmm_7: PortPinId=7, PortPinName=DMMDATA5
            PortPinDmm_8: PortPinId=8, PortPinName=DMMDATA6
            PortPinDmm_9: PortPinId=9, PortPinName=DMMDATA7
            PortPinDmm_10: PortPinId=10, PortPinName=DMMDATA8
            PortPinDmm_11: PortPinId=11, PortPinName=DMMDATA9
            PortPinDmm_12: PortPinId=12, PortPinName=DMMDATA10
            PortPinDmm_13: PortPinId=13, PortPinName=DMMDATA11
            PortPinDmm_14: PortPinId=14, PortPinName=DMMDATA12
            PortPinDmm_15: PortPinId=15, PortPinName=DMMDATA13
            PortPinDmm_16: PortPinId=16, PortPinName=DMMDATA14
            PortPinDmm_17: PortPinId=17, PortPinName=DMMDATA15
            PortPinDmm_18: PortPinId=18, PortPinName=DMMnENA
      Multiplexing (PortMux): PortMuxName=Port Pin Multiplexing, PortMuxRegPostfix=PINMUX, PortMuxRegBaseAddr=4294961936, PortMuxNumberOfPins=9, PortMuxNumberOfRegs=31
        109 x PortMuxPin:
          Pin_N19_86: PortMuxPinDirection=PORT_MUX_PIN_DIR_OUTPUT, PortMuxPinName=AD1EVT, MII_RX_ER, RMII_RX_ER, PortMuxPinNumberPackage1=N19, PortMuxPinNumberPackage2=86, PortMuxPinRegId=10, PortMuxPinRegPos=0
          Pin_D4: PortMuxPinDirection=PORT_MUX_PIN_DIR_OUTPUT, PortMuxPinName=EMIF_ADDR[0], NHET2[1], PortMuxPinNumberPackage1=D4, PortMuxPinNumberPackage2=(unset), PortMuxPinRegId=22, PortMuxPinRegPos=0
          Pin_D5: PortMuxPinDirection=PORT_MUX_PIN_DIR_OUTPUT, PortMuxPinName=EMIF_ADDR[1], NHET2[3], PortMuxPinNumberPackage1=D5, PortMuxPinNumberPackage2=(unset), PortMuxPinRegId=21, PortMuxPinRegPos=0
          Pin_C8: PortMuxPinDirection=PORT_MUX_PIN_DIR_OUTPUT, PortMuxPinName=EMIF_ADDR[10], RTP_DATA[09], PortMuxPinNumberPackage1=C8, PortMuxPinNumberPackage2=(unset), PortMuxPinRegId=21, PortMuxPinRegPos=16
          Pin_C9: PortMuxPinDirection=PORT_MUX_PIN_DIR_OUTPUT, PortMuxPinName=EMIF_ADDR[11], RTP_DATA[08], PortMuxPinNumberPackage1=C9, PortMuxPinNumberPackage2=(unset), PortMuxPinRegId=20, PortMuxPinRegPos=24
          Pin_C10: PortMuxPinDirection=PORT_MUX_PIN_DIR_OUTPUT, PortMuxPinName=EMIF_ADDR[12], RTP_DATA[06], PortMuxPinNumberPackage1=C10, PortMuxPinNumberPackage2=(unset), PortMuxPinRegId=20, PortMuxPinRegPos=8
          Pin_C11: PortMuxPinDirection=PORT_MUX_PIN_DIR_OUTPUT, PortMuxPinName=EMIF_ADDR[13], RTP_DATA[05], PortMuxPinNumberPackage1=C11, PortMuxPinNumberPackage2=(unset), PortMuxPinRegId=20, PortMuxPinRegPos=0
          Pin_C12: PortMuxPinDirection=PORT_MUX_PIN_DIR_OUTPUT, PortMuxPinName=EMIF_ADDR[14], RTP_DATA[04], PortMuxPinNumberPackage1=C12, PortMuxPinNumberPackage2=(unset), PortMuxPinRegId=18, PortMuxPinRegPos=16
          Pin_C13: PortMuxPinDirection=PORT_MUX_PIN_DIR_OUTPUT, PortMuxPinName=EMIF_ADDR[15], RTP_DATA[03], PortMuxPinNumberPackage1=C13, PortMuxPinNumberPackage2=(unset), PortMuxPinRegId=18, PortMuxPinRegPos=0
          Pin_D14: PortMuxPinDirection=PORT_MUX_PIN_DIR_OUTPUT, PortMuxPinName=EMIF_ADDR[16], RTP_DATA[02], PortMuxPinNumberPackage1=D14, PortMuxPinNumberPackage2=(unset), PortMuxPinRegId=16, PortMuxPinRegPos=16
          Pin_C14: PortMuxPinDirection=PORT_MUX_PIN_DIR_OUTPUT, PortMuxPinName=EMIF_ADDR[17], RTP_DATA[01], PortMuxPinNumberPackage1=C14, PortMuxPinNumberPackage2=(unset), PortMuxPinRegId=16, PortMuxPinRegPos=8
          Pin_D15: PortMuxPinDirection=PORT_MUX_PIN_DIR_OUTPUT, PortMuxPinName=EMIF_ADDR[18], RTP_DATA[0], PortMuxPinNumberPackage1=D15, PortMuxPinNumberPackage2=(unset), PortMuxPinRegId=15, PortMuxPinRegPos=24
          Pin_C15: PortMuxPinDirection=PORT_MUX_PIN_DIR_OUTPUT, PortMuxPinName=EMIF_ADDR[19], RTP_nENA, PortMuxPinNumberPackage1=C15, PortMuxPinNumberPackage2=(unset), PortMuxPinRegId=15, PortMuxPinRegPos=16
          Pin_C16: PortMuxPinDirection=PORT_MUX_PIN_DIR_OUTPUT, PortMuxPinName=EMIF_ADDR[20], RTP_nSYNC, PortMuxPinNumberPackage1=C16, PortMuxPinNumberPackage2=(unset), PortMuxPinRegId=15, PortMuxPinRegPos=8
          Pin_C17: PortMuxPinDirection=PORT_MUX_PIN_DIR_OUTPUT, PortMuxPinName=EMIF_ADDR[21], RTP_CLK, PortMuxPinNumberPackage1=C17, PortMuxPinNumberPackage2=(unset), PortMuxPinRegId=15, PortMuxPinRegPos=0
          Pin_C4: PortMuxPinDirection=PORT_MUX_PIN_DIR_OUTPUT, PortMuxPinName=EMIF_ADDR[6], RTP_DATA[13], NHET2[11], PortMuxPinNumberPackage1=C4, PortMuxPinNumberPackage2=(unset), PortMuxPinRegId=22, PortMuxPinRegPos=16
          Pin_C5: PortMuxPinDirection=PORT_MUX_PIN_DIR_OUTPUT, PortMuxPinName=EMIF_ADDR[7], RTP_DATA[12], NHET2[13], PortMuxPinNumberPackage1=C5, PortMuxPinNumberPackage2=(unset), PortMuxPinRegId=22, PortMuxPinRegPos=8
          Pin_C6: PortMuxPinDirection=PORT_MUX_PIN_DIR_OUTPUT, PortMuxPinName=EMIF_ADDR[8], RTP_DATA[11], NHET2[15], PortMuxPinNumberPackage1=C6, PortMuxPinNumberPackage2=(unset), PortMuxPinRegId=23, PortMuxPinRegPos=0
          Pin_C7: PortMuxPinDirection=PORT_MUX_PIN_DIR_OUTPUT, PortMuxPinName=EMIF_ADDR[9], RTP_DATA[10], PortMuxPinNumberPackage1=C7, PortMuxPinNumberPackage2=(unset), PortMuxPinRegId=21, PortMuxPinRegPos=24
          Pin_D16: PortMuxPinDirection=PORT_MUX_PIN_DIR_OUTPUT, PortMuxPinName=EMIF_BA[1], NHET2[5], PortMuxPinNumberPackage1=D16, PortMuxPinNumberPackage2=(unset), PortMuxPinRegId=14, PortMuxPinRegPos=24
          Pin_N17: PortMuxPinDirection=PORT_MUX_PIN_DIR_OUTPUT, PortMuxPinName=EMIF_nCS[0], RTP_DATA[15], NHET2[7], PortMuxPinNumberPackage1=N17, PortMuxPinNumberPackage2=(unset), PortMuxPinRegId=10, PortMuxPinRegPos=16
          Pin_K17: PortMuxPinDirection=PORT_MUX_PIN_DIR_OUTPUT, PortMuxPinName=EMIF_nCS[3], RTP_DATA[14], NHET2[9], PortMuxPinNumberPackage1=K17, PortMuxPinNumberPackage2=(unset), PortMuxPinRegId=11, PortMuxPinRegPos=0
          Pin_M17: PortMuxPinDirection=PORT_MUX_PIN_DIR_OUTPUT, PortMuxPinName=EMIF_nCS[4], RTP_DATA[07], PortMuxPinNumberPackage1=M17, PortMuxPinNumberPackage2=(unset), PortMuxPinRegId=11, PortMuxPinRegPos=8
          Pin_D17: PortMuxPinDirection=PORT_MUX_PIN_DIR_OUTPUT, PortMuxPinName=EMIF_nWE, EMIF_RNW, PortMuxPinNumberPackage1=D17, PortMuxPinNumberPackage2=(unset), PortMuxPinRegId=14, PortMuxPinRegPos=16
          Pin_D9: PortMuxPinDirection=PORT_MUX_PIN_DIR_OUTPUT, PortMuxPinName=ETMDATA[08], EMIF_ADDR[5], PortMuxPinNumberPackage1=D9, PortMuxPinNumberPackage2=(unset), PortMuxPinRegId=17, PortMuxPinRegPos=24
          Pin_D8: PortMuxPinDirection=PORT_MUX_PIN_DIR_OUTPUT, PortMuxPinName=ETMDATA[09], EMIF_ADDR[4], PortMuxPinNumberPackage1=D8, PortMuxPinNumberPackage2=(unset), PortMuxPinRegId=19, PortMuxPinRegPos=0
          Pin_D7: PortMuxPinDirection=PORT_MUX_PIN_DIR_OUTPUT, PortMuxPinName=ETMDATA[10], EMIF_ADDR[3], PortMuxPinNumberPackage1=D7, PortMuxPinNumberPackage2=(unset), PortMuxPinRegId=19, PortMuxPinRegPos=24
          Pin_D6: PortMuxPinDirection=PORT_MUX_PIN_DIR_OUTPUT, PortMuxPinName=ETMDATA[11], EMIF_ADDR[2], PortMuxPinNumberPackage1=D6, PortMuxPinNumberPackage2=(unset), PortMuxPinRegId=22, PortMuxPinRegPos=24
          Pin_D13: PortMuxPinDirection=PORT_MUX_PIN_DIR_OUTPUT, PortMuxPinName=ETMDATA[12], EMIF_BA[0], PortMuxPinNumberPackage1=D13, PortMuxPinNumberPackage2=(unset), PortMuxPinRegId=16, PortMuxPinRegPos=0
          Pin_D12: PortMuxPinDirection=PORT_MUX_PIN_DIR_OUTPUT, PortMuxPinName=ETMDATA[13], EMIF_nOE, PortMuxPinNumberPackage1=D12, PortMuxPinNumberPackage2=(unset), PortMuxPinRegId=16, PortMuxPinRegPos=24
          Pin_D11: PortMuxPinDirection=PORT_MUX_PIN_DIR_OUTPUT, PortMuxPinName=ETMDATA[14], EMIF_nDQM[1], PortMuxPinNumberPackage1=D11, PortMuxPinNumberPackage2=(unset), PortMuxPinRegId=17, PortMuxPinRegPos=8
          Pin_D10: PortMuxPinDirection=PORT_MUX_PIN_DIR_OUTPUT, PortMuxPinName=ETMDATA[15], EMIF_nDQM[0], PortMuxPinNumberPackage1=D10, PortMuxPinNumberPackage2=(unset), PortMuxPinRegId=19, PortMuxPinRegPos=16
          Pin_K15: PortMuxPinDirection=PORT_MUX_PIN_DIR_OUTPUT, PortMuxPinName=ETMDATA[16], EMIF_DATA[0], PortMuxPinNumberPackage1=K15, PortMuxPinNumberPackage2=(unset), PortMuxPinRegId=12, PortMuxPinRegPos=8
          Pin_L15: PortMuxPinDirection=PORT_MUX_PIN_DIR_OUTPUT, PortMuxPinName=ETMDATA[17], EMIF_DATA[1], PortMuxPinNumberPackage1=L15, PortMuxPinNumberPackage2=(unset), PortMuxPinRegId=11, PortMuxPinRegPos=16
          Pin_M15: PortMuxPinDirection=PORT_MUX_PIN_DIR_OUTPUT, PortMuxPinName=ETMDATA[18], EMIF_DATA[2], PortMuxPinNumberPackage1=M15, PortMuxPinNumberPackage2=(unset), PortMuxPinRegId=10, PortMuxPinRegPos=24
          Pin_N15: PortMuxPinDirection=PORT_MUX_PIN_DIR_OUTPUT, PortMuxPinName=ETMDATA[19], EMIF_DATA[3], PortMuxPinNumberPackage1=N15, PortMuxPinNumberPackage2=(unset), PortMuxPinRegId=10, PortMuxPinRegPos=8
          Pin_E4: PortMuxPinDirection=PORT_MUX_PIN_DIR_OUTPUT, PortMuxPinName=ETMDATA[20], EMIF_DATA[4], PortMuxPinNumberPackage1=E4, PortMuxPinNumberPackage2=(unset), PortMuxPinRegId=1, PortMuxPinRegPos=16
          Pin_F4: PortMuxPinDirection=PORT_MUX_PIN_DIR_OUTPUT, PortMuxPinName=ETMDATA[21], EMIF_DATA[5], PortMuxPinNumberPackage1=F4, PortMuxPinNumberPackage2=(unset), PortMuxPinRegId=1, PortMuxPinRegPos=24
          Pin_G4: PortMuxPinDirection=PORT_MUX_PIN_DIR_OUTPUT, PortMuxPinName=ETMDATA[22], EMIF_DATA[6], PortMuxPinNumberPackage1=G4, PortMuxPinNumberPackage2=(unset), PortMuxPinRegId=2, PortMuxPinRegPos=8
          Pin_K4: PortMuxPinDirection=PORT_MUX_PIN_DIR_OUTPUT, PortMuxPinName=ETMDATA[23], EMIF_DATA[7], PortMuxPinNumberPackage1=K4, PortMuxPinNumberPackage2=(unset), PortMuxPinRegId=3, PortMuxPinRegPos=0
          Pin_L4: PortMuxPinDirection=PORT_MUX_PIN_DIR_OUTPUT, PortMuxPinName=ETMDATA[24], EMIF_DATA[8], PortMuxPinNumberPackage1=L4, PortMuxPinNumberPackage2=(unset), PortMuxPinRegId=3, PortMuxPinRegPos=24
          Pin_M4: PortMuxPinDirection=PORT_MUX_PIN_DIR_OUTPUT, PortMuxPinName=ETMDATA[25], EMIF_DATA[9], PortMuxPinNumberPackage1=M4, PortMuxPinNumberPackage2=(unset), PortMuxPinRegId=4, PortMuxPinRegPos=8
          Pin_N4: PortMuxPinDirection=PORT_MUX_PIN_DIR_OUTPUT, PortMuxPinName=ETMDATA[26], EMIF_DATA[10], PortMuxPinNumberPackage1=N4, PortMuxPinNumberPackage2=(unset), PortMuxPinRegId=5, PortMuxPinRegPos=24
          Pin_P4: PortMuxPinDirection=PORT_MUX_PIN_DIR_OUTPUT, PortMuxPinName=ETMDATA[27], EMIF_DATA[11], PortMuxPinNumberPackage1=P4, PortMuxPinNumberPackage2=(unset), PortMuxPinRegId=6, PortMuxPinRegPos=8
          Pin_R5: PortMuxPinDirection=PORT_MUX_PIN_DIR_OUTPUT, PortMuxPinName=ETMDATA[28], EMIF_DATA[12], PortMuxPinNumberPackage1=R5, PortMuxPinNumberPackage2=(unset), PortMuxPinRegId=6, PortMuxPinRegPos=24
          Pin_R6: PortMuxPinDirection=PORT_MUX_PIN_DIR_OUTPUT, PortMuxPinName=ETMDATA[29], EMIF_DATA[13], PortMuxPinNumberPackage1=R6, PortMuxPinNumberPackage2=(unset), PortMuxPinRegId=7, PortMuxPinRegPos=0
          Pin_R7: PortMuxPinDirection=PORT_MUX_PIN_DIR_OUTPUT, PortMuxPinName=ETMDATA[30], EMIF_DATA[14], PortMuxPinNumberPackage1=R7, PortMuxPinNumberPackage2=(unset), PortMuxPinRegId=7, PortMuxPinRegPos=24
          Pin_R8: PortMuxPinDirection=PORT_MUX_PIN_DIR_OUTPUT, PortMuxPinName=ETMDATA[31], EMIF_DATA[15], PortMuxPinNumberPackage1=R8, PortMuxPinNumberPackage2=(unset), PortMuxPinRegId=8, PortMuxPinRegPos=24
          Pin_R9: PortMuxPinDirection=PORT_MUX_PIN_DIR_OUTPUT, PortMuxPinName=ETMTRACECLKIN, EXTCLKIN2, PortMuxPinNumberPackage1=R9, PortMuxPinNumberPackage2=(unset), PortMuxPinRegId=9, PortMuxPinRegPos=0
          Pin_C1_9: PortMuxPinDirection=PORT_MUX_PIN_DIR_OUTPUT, PortMuxPinName=GIOA[2], Reserved, Reserved, NHET2[0], PortMuxPinNumberPackage1=C1, PortMuxPinNumberPackage2=9, PortMuxPinRegId=2, PortMuxPinRegPos=0
          Pin_E1: PortMuxPinDirection=PORT_MUX_PIN_DIR_OUTPUT, PortMuxPinName=GIOA[3], NHET2[2], PortMuxPinNumberPackage1=E1, PortMuxPinNumberPackage2=(unset), PortMuxPinRegId=2, PortMuxPinRegPos=16
          Pin_B5_14: PortMuxPinDirection=PORT_MUX_PIN_DIR_OUTPUT, PortMuxPinName=GIOA[5], EXTCLKIN, PortMuxPinNumberPackage1=B5, PortMuxPinNumberPackage2=14, PortMuxPinRegId=2, PortMuxPinRegPos=24
          Pin_H3_16: PortMuxPinDirection=PORT_MUX_PIN_DIR_OUTPUT, PortMuxPinName=GIOA[6], NHET2[4], PortMuxPinNumberPackage1=H3, PortMuxPinNumberPackage2=16, PortMuxPinRegId=3, PortMuxPinRegPos=16
          Pin_M1_22: PortMuxPinDirection=PORT_MUX_PIN_DIR_OUTPUT, PortMuxPinName=GIOA[7], NHET2[6], PortMuxPinNumberPackage1=M1, PortMuxPinNumberPackage2=22, PortMuxPinRegId=4, PortMuxPinRegPos=0
          Pin_R2_105: PortMuxPinDirection=PORT_MUX_PIN_DIR_OUTPUT, PortMuxPinName=MIBSPI1NCS[0], MIBSPI1SOMI[1], MII_TXD[2], PortMuxPinNumberPackage1=R2, PortMuxPinNumberPackage2=105, PortMuxPinRegId=13, PortMuxPinRegPos=24
          Pin_F3_130: PortMuxPinDirection=PORT_MUX_PIN_DIR_OUTPUT, PortMuxPinName=MIBSPI1NCS[1], NHET1[17], MII_COL, PortMuxPinNumberPackage1=F3, PortMuxPinNumberPackage2=130, PortMuxPinRegId=20, PortMuxPinRegPos=16
          Pin_F3_130_IN: PortMuxPinDirection=PORT_MUX_PIN_DIR_INPUT, PortMuxPinName=MIBSPI1NCS[1], NHET1[17], PortMuxPinNumberPackage1=F3, PortMuxPinNumberPackage2=130, PortMuxPinRegId=24, PortMuxPinRegPos=16
          Pin_G3_40: PortMuxPinDirection=PORT_MUX_PIN_DIR_OUTPUT, PortMuxPinName=MIBSPI1NCS[2], NHET1[19], MDIO, PortMuxPinNumberPackage1=G3, PortMuxPinNumberPackage2=40, PortMuxPinRegId=8, PortMuxPinRegPos=8
          Pin_G3_40_IN: PortMuxPinDirection=PORT_MUX_PIN_DIR_INPUT, PortMuxPinName=MIBSPI1NCS[2], NHET1[19], PortMuxPinNumberPackage1=G3, PortMuxPinNumberPackage2=40, PortMuxPinRegId=24, PortMuxPinRegPos=24
          Pin_J3: PortMuxPinDirection=PORT_MUX_PIN_DIR_OUTPUT, PortMuxPinName=MIBSPI1NCS[3], NHET1[21], PortMuxPinNumberPackage1=J3, PortMuxPinNumberPackage2=(unset), PortMuxPinRegId=9, PortMuxPinRegPos=24
          Pin_J3_IN: PortMuxPinDirection=PORT_MUX_PIN_DIR_INPUT, PortMuxPinName=MIBSPI1NCS[3], NHET1[21], PortMuxPinNumberPackage1=J3, PortMuxPinNumberPackage2=(unset), PortMuxPinRegId=25, PortMuxPinRegPos=0
          Pin_G19_96: PortMuxPinDirection=PORT_MUX_PIN_DIR_OUTPUT, PortMuxPinName=MIBSPI1NENA, NHET1[23], MII_RXD[2], PortMuxPinNumberPackage1=G19, PortMuxPinNumberPackage2=96, PortMuxPinRegId=12, PortMuxPinRegPos=16
          Pin_G19_96_IN: PortMuxPinDirection=PORT_MUX_PIN_DIR_INPUT, PortMuxPinName=MIBSPI1NENA, NHET1[23], PortMuxPinNumberPackage1=G19, PortMuxPinNumberPackage2=96, PortMuxPinRegId=25, PortMuxPinRegPos=8
          Pin_V10_55: PortMuxPinDirection=PORT_MUX_PIN_DIR_OUTPUT, PortMuxPinName=MIBSPI3NCS[0], AD2EVT, GIOB[2], PortMuxPinNumberPackage1=V10, PortMuxPinNumberPackage2=55, PortMuxPinRegId=9, PortMuxPinRegPos=16
          Pin_V10_55_IN: PortMuxPinDirection=PORT_MUX_PIN_DIR_INPUT, PortMuxPinName=MIBSPI3NCS[0], GIOB[2], PortMuxPinNumberPackage1=V10, PortMuxPinNumberPackage2=55, PortMuxPinRegId=29, PortMuxPinRegPos=16
          Pin_V5_37: PortMuxPinDirection=PORT_MUX_PIN_DIR_OUTPUT, PortMuxPinName=MIBSPI3NCS[1], NHET1[25], MDCLK, PortMuxPinNumberPackage1=V5, PortMuxPinNumberPackage2=37, PortMuxPinRegId=7, PortMuxPinRegPos=8
          Pin_V5_37_IN: PortMuxPinDirection=PORT_MUX_PIN_DIR_INPUT, PortMuxPinName=MIBSPI3NCS[1], NHET1[25], PortMuxPinNumberPackage1=V5, PortMuxPinNumberPackage2=37, PortMuxPinRegId=25, PortMuxPinRegPos=16
          Pin_B2_4: PortMuxPinDirection=PORT_MUX_PIN_DIR_OUTPUT, PortMuxPinName=MIBSPI3NCS[2], I2C_SDA, NHET1[27], PortMuxPinNumberPackage1=B2, PortMuxPinNumberPackage2=4, PortMuxPinRegId=0, PortMuxPinRegPos=24
          Pin_B2_4_IN: PortMuxPinDirection=PORT_MUX_PIN_DIR_INPUT, PortMuxPinName=MIBSPI3NCS[2], NHET1[27], PortMuxPinNumberPackage1=B2, PortMuxPinNumberPackage2=4, PortMuxPinRegId=25, PortMuxPinRegPos=24
          Pin_C3_3: PortMuxPinDirection=PORT_MUX_PIN_DIR_OUTPUT, PortMuxPinName=MIBSPI3NCS[3], I2C_SCL, NHET1[29], PortMuxPinNumberPackage1=C3, PortMuxPinNumberPackage2=3, PortMuxPinRegId=0, PortMuxPinRegPos=16
          Pin_C3_3_IN: PortMuxPinDirection=PORT_MUX_PIN_DIR_INPUT, PortMuxPinName=MIBSPI3NCS[3], NHET1[29], PortMuxPinNumberPackage1=C3, PortMuxPinNumberPackage2=3, PortMuxPinRegId=26, PortMuxPinRegPos=0
          Pin_W9_54: PortMuxPinDirection=PORT_MUX_PIN_DIR_OUTPUT, PortMuxPinName=MIBSPI3NENA, MIBSPI3NCS[5], NHET1[31], PortMuxPinNumberPackage1=W9, PortMuxPinNumberPackage2=54, PortMuxPinRegId=9, PortMuxPinRegPos=8
          Pin_W9_54_IN: PortMuxPinDirection=PORT_MUX_PIN_DIR_INPUT, PortMuxPinName=MIBSPI3NENA, NHET1[31], PortMuxPinNumberPackage1=W9, PortMuxPinNumberPackage2=54, PortMuxPinRegId=26, PortMuxPinRegPos=8
          Pin_H19_100: PortMuxPinDirection=PORT_MUX_PIN_DIR_OUTPUT, PortMuxPinName=MIBSPI5CLK, DMM_DATA[4], MII_TXEN, RMII_TXEN, PortMuxPinNumberPackage1=H19, PortMuxPinNumberPackage2=100, PortMuxPinRegId=13, PortMuxPinRegPos=16
          Pin_E19_32: PortMuxPinDirection=PORT_MUX_PIN_DIR_OUTPUT, PortMuxPinName=MIBSPI5NCS[0], DMM_DATA[5], PortMuxPinNumberPackage1=E19, PortMuxPinNumberPackage2=32, PortMuxPinRegId=27, PortMuxPinRegPos=0
          Pin_B6: PortMuxPinDirection=PORT_MUX_PIN_DIR_OUTPUT, PortMuxPinName=MIBSPI5NCS[1], DMM_DATA[6], PortMuxPinNumberPackage1=B6, PortMuxPinNumberPackage2=(unset), PortMuxPinRegId=27, PortMuxPinRegPos=8
          Pin_W6: PortMuxPinDirection=PORT_MUX_PIN_DIR_OUTPUT, PortMuxPinName=MIBSPI5NCS[2], DMM_DATA[2], PortMuxPinNumberPackage1=W6, PortMuxPinNumberPackage2=(unset), PortMuxPinRegId=26, PortMuxPinRegPos=16
          Pin_T12: PortMuxPinDirection=PORT_MUX_PIN_DIR_OUTPUT, PortMuxPinName=MIBSPI5NCS[3], DMM_DATA[3], PortMuxPinNumberPackage1=T12, PortMuxPinNumberPackage2=(unset), PortMuxPinRegId=26, PortMuxPinRegPos=24
          Pin_H18_97: PortMuxPinDirection=PORT_MUX_PIN_DIR_OUTPUT, PortMuxPinName=MIBSPI5NENA, DMM_DATA[7], MII_RXD[3], PortMuxPinNumberPackage1=H18, PortMuxPinNumberPackage2=97, PortMuxPinRegId=12, PortMuxPinRegPos=24
          Pin_J19_99: PortMuxPinDirection=PORT_MUX_PIN_DIR_OUTPUT, PortMuxPinName=MIBSPI5SIMO[0], DMM_DATA[8], MII_TXD[1], RMII_TXD[1], PortMuxPinNumberPackage1=J19, PortMuxPinNumberPackage2=99, PortMuxPinRegId=13, PortMuxPinRegPos=8
          Pin_E16: PortMuxPinDirection=PORT_MUX_PIN_DIR_OUTPUT, PortMuxPinName=MIBSPI5SIMO[1], DMM_DATA[9], PortMuxPinNumberPackage1=E16, PortMuxPinNumberPackage2=(unset), PortMuxPinRegId=27, PortMuxPinRegPos=16
          Pin_H17: PortMuxPinDirection=PORT_MUX_PIN_DIR_OUTPUT, PortMuxPinName=MIBSPI5SIMO[2], DMM_DATA[10], PortMuxPinNumberPackage1=H17, PortMuxPinNumberPackage2=(unset), PortMuxPinRegId=27, PortMuxPinRegPos=24
          Pin_G17: PortMuxPinDirection=PORT_MUX_PIN_DIR_OUTPUT, PortMuxPinName=MIBSPI5SIMO[3], DMM_DATA[11], PortMuxPinNumberPackage1=G17, PortMuxPinNumberPackage2=(unset), PortMuxPinRegId=28, PortMuxPinRegPos=0
          Pin_J18_98: PortMuxPinDirection=PORT_MUX_PIN_DIR_OUTPUT, PortMuxPinName=MIBSPI5SOMI[0], DMM_DATA[12], MII_TXD[0], RMII_TXD[0], PortMuxPinNumberPackage1=J18, PortMuxPinNumberPackage2=98, PortMuxPinRegId=13, PortMuxPinRegPos=0
          Pin_E17: PortMuxPinDirection=PORT_MUX_PIN_DIR_OUTPUT, PortMuxPinName=MIBSPI5SOMI[1], DMM_DATA[13], PortMuxPinNumberPackage1=E17, PortMuxPinNumberPackage2=(unset), PortMuxPinRegId=28, PortMuxPinRegPos=8
          Pin_H16: PortMuxPinDirection=PORT_MUX_PIN_DIR_OUTPUT, PortMuxPinName=MIBSPI5SOMI[2], DMM_DATA[14], PortMuxPinNumberPackage1=H16, PortMuxPinNumberPackage2=(unset), PortMuxPinRegId=28, PortMuxPinRegPos=16
          Pin_G16: PortMuxPinDirection=PORT_MUX_PIN_DIR_OUTPUT, PortMuxPinName=MIBSPI5SOMI[3], DMM_DATA[15], PortMuxPinNumberPackage1=G16, PortMuxPinNumberPackage2=(unset), PortMuxPinRegId=28, PortMuxPinRegPos=24
          Pin_K18_25: PortMuxPinDirection=PORT_MUX_PIN_DIR_OUTPUT, PortMuxPinName=NHET1[0], SPI4CLK, PortMuxPinNumberPackage1=K18, PortMuxPinNumberPackage2=25, PortMuxPinRegId=5, PortMuxPinRegPos=0
          Pin_K18_25_IN: PortMuxPinDirection=PORT_MUX_PIN_DIR_INPUT, PortMuxPinName=NHET1[0], SPI4CLK, PortMuxPinNumberPackage1=K18, PortMuxPinNumberPackage2=25, PortMuxPinRegId=23, PortMuxPinRegPos=8
          Pin_V2_23: PortMuxPinDirection=PORT_MUX_PIN_DIR_OUTPUT, PortMuxPinName=NHET1[01], SPI4NENA, NHET2[8], PortMuxPinNumberPackage1=V2, PortMuxPinNumberPackage2=23, PortMuxPinRegId=4, PortMuxPinRegPos=16
          Pin_W5_30: PortMuxPinDirection=PORT_MUX_PIN_DIR_OUTPUT, PortMuxPinName=NHET1[02], SPI4SIMO, PortMuxPinNumberPackage1=W5, PortMuxPinNumberPackage2=30, PortMuxPinRegId=5, PortMuxPinRegPos=8
          Pin_W5_30_IN: PortMuxPinDirection=PORT_MUX_PIN_DIR_INPUT, PortMuxPinName=NHET1[02], SPI4SIMO, PortMuxPinNumberPackage1=W5, PortMuxPinNumberPackage2=30, PortMuxPinRegId=23, PortMuxPinRegPos=16
          Pin_U1_24: PortMuxPinDirection=PORT_MUX_PIN_DIR_OUTPUT, PortMuxPinName=NHET1[03], SPI4NCS[0], NHET2[10], PortMuxPinNumberPackage1=U1, PortMuxPinNumberPackage2=24, PortMuxPinRegId=4, PortMuxPinRegPos=24
          Pin_V6_31: PortMuxPinDirection=PORT_MUX_PIN_DIR_OUTPUT, PortMuxPinName=NHET1[05], SPI4SOMI, NHET2[12], PortMuxPinNumberPackage1=V6, PortMuxPinNumberPackage2=31, PortMuxPinRegId=5, PortMuxPinRegPos=16
          Pin_V6_31_IN: PortMuxPinDirection=PORT_MUX_PIN_DIR_INPUT, PortMuxPinName=NHET1[05], SPI4SOMI, PortMuxPinNumberPackage1=V6, PortMuxPinNumberPackage2=31, PortMuxPinRegId=23, PortMuxPinRegPos=24
          Pin_W3_38: PortMuxPinDirection=PORT_MUX_PIN_DIR_OUTPUT, PortMuxPinName=NHET1[06], SCIRX, PortMuxPinNumberPackage1=W3, PortMuxPinNumberPackage2=38, PortMuxPinRegId=7, PortMuxPinRegPos=16
          Pin_T1_33: PortMuxPinDirection=PORT_MUX_PIN_DIR_OUTPUT, PortMuxPinName=NHET1[07], Reserved, Reserved, NHET2[14], PortMuxPinNumberPackage1=T1, PortMuxPinNumberPackage2=33, PortMuxPinRegId=6, PortMuxPinRegPos=0
          Pin_E18_106: PortMuxPinDirection=PORT_MUX_PIN_DIR_OUTPUT, PortMuxPinName=NHET1[08], MIBSPI1SIMO[1], MII_TXD[3], PortMuxPinNumberPackage1=E18, PortMuxPinNumberPackage2=106, PortMuxPinRegId=14, PortMuxPinRegPos=0
          Pin_V7_35: PortMuxPinDirection=PORT_MUX_PIN_DIR_OUTPUT, PortMuxPinName=NHET1[09], NHET2[16], PortMuxPinNumberPackage1=V7, PortMuxPinNumberPackage2=35, PortMuxPinRegId=6, PortMuxPinRegPos=16
          Pin_D19_118: PortMuxPinDirection=PORT_MUX_PIN_DIR_OUTPUT, PortMuxPinName=NHET1[10], MII_TX_CLK, Reserved, MII_TX_AVCLK4, PortMuxPinNumberPackage1=D19, PortMuxPinNumberPackage2=118, PortMuxPinRegId=17, PortMuxPinRegPos=0
          Pin_E3_6: PortMuxPinDirection=PORT_MUX_PIN_DIR_OUTPUT, PortMuxPinName=NHET1[11], MIBSPI3NCS[4], NHET2[18], PortMuxPinNumberPackage1=E3, PortMuxPinNumberPackage2=6, PortMuxPinRegId=1, PortMuxPinRegPos=8
          Pin_B4_124: PortMuxPinDirection=PORT_MUX_PIN_DIR_OUTPUT, PortMuxPinName=NHET1[12], MII_CRS, RMII_CRS_DV, PortMuxPinNumberPackage1=B4, PortMuxPinNumberPackage2=124, PortMuxPinRegId=17, PortMuxPinRegPos=16
          Pin_N2_39: PortMuxPinDirection=PORT_MUX_PIN_DIR_OUTPUT, PortMuxPinName=NHET1[13], SCITX, PortMuxPinNumberPackage1=N2, PortMuxPinNumberPackage2=39, PortMuxPinRegId=8, PortMuxPinRegPos=0
          Pin_N1_41: PortMuxPinDirection=PORT_MUX_PIN_DIR_OUTPUT, PortMuxPinName=NHET1[15], MIBSPI1NCS[4], PortMuxPinNumberPackage1=N1, PortMuxPinNumberPackage2=41, PortMuxPinRegId=8, PortMuxPinRegPos=16
          Pin_P1_91: PortMuxPinDirection=PORT_MUX_PIN_DIR_OUTPUT, PortMuxPinName=NHET1[24], MIBSPI1NCS[5], MII_RXD[0], RMII_RXD[0], PortMuxPinNumberPackage1=P1, PortMuxPinNumberPackage2=91, PortMuxPinRegId=11, PortMuxPinRegPos=24
          Pin_A14_92: PortMuxPinDirection=PORT_MUX_PIN_DIR_OUTPUT, PortMuxPinName=NHET1[26], MII_RXD[1], RMII_RXD[1], PortMuxPinNumberPackage1=A14, PortMuxPinNumberPackage2=92, PortMuxPinRegId=12, PortMuxPinRegPos=0
          Pin_K19_107: PortMuxPinDirection=PORT_MUX_PIN_DIR_OUTPUT, PortMuxPinName=NHET1[28], MII_RXCLK, RMII_REFCLK, MII_RX_AVCLK4, PortMuxPinNumberPackage1=K19, PortMuxPinNumberPackage2=107, PortMuxPinRegId=14, PortMuxPinRegPos=8
          Pin_B11_127: PortMuxPinDirection=PORT_MUX_PIN_DIR_OUTPUT, PortMuxPinName=NHET1[30], MII_RX_DV, PortMuxPinNumberPackage1=B11, PortMuxPinNumberPackage2=127, PortMuxPinRegId=19, PortMuxPinRegPos=8
          Pin_D3_54: PortMuxPinDirection=PORT_MUX_PIN_DIR_OUTPUT, PortMuxPinName=SPI2NENA, SPI2NCS[1], PortMuxPinNumberPackage1=D3, PortMuxPinNumberPackage2=54, PortMuxPinRegId=29, PortMuxPinRegPos=0
    PortGeneral: PortPackageMapping1=Pin_337, PortPackageMapping2=Pin_144, PortPackageMapping3=NA, PortPackageMapping4=NA, PortPackageMapping0=NA
