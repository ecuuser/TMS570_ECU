AUTOSAR XML (schema 3.1.4)
# COPYRIGHT
# Copyright (c) 2010 by Vector Informatik GmbH. All rights reserved.
# This software is copyright protected and proprietary to Vector Informatik GmbH.
# Vector Informatik GmbH grants to you only those rights as set out in the license conditions.
package /MICROSAR
  module definition Port [0..1]: refined-module-def=Port, variants post-build  # Configuration of the Port module.
    container PortConfigSet: multiple-configuration-container=true  # This container is the base of a multiple configuration set
      container PortContainer [1..*]  # Container collecting the PortPins.
        integer PortNumberOfPortPins: 1..32, set at post-build, default-value=1  # The number of specified PortPins in this PortContainer.
        boolean PortUse: set at post-build, origin=Vector Informatik, default-value=false  # Controls if the register of specific Port are configured by module Port.
        string PortName: set at post-build, origin=Vector Informatik, default-value=PORT  # The name of the port. (Should be set by Pre-Configuration)
        string PortRegPostfix: set at post-build, origin=Vector Informatik, default-value=PORT  # String used as identifier for the port registers.
        boolean PortAvailablePackage{1..4}: set at post-build, origin=Vector Informatik, default-value=true  # Availability of Port in a speciffic chip pin package
        integer PortRegBaseAddr: 0..4294967295, set at post-build, origin=Vector Informatik, default-value=0  # The registers base addres of a specific port.
        enumeration PortRegStructure: set at post-build, origin=Vector Informatik, default-value=PORT_REG_STRUCT_REGULAR_NO_FUNC  # Description how port settings are maped into register.
          PORT_REG_STRUCT_REGULAR  # PortRegStructRegular
          PORT_REG_STRUCT_SHORT  # PortRegStructShort
          PORT_REG_STRUCT_REGULAR_SLEW_1  # PortRegStructRegularSlew1
          PORT_REG_STRUCT_REGULAR_SLEW_2  # PortRegStructRegularSlew2
          PORT_REG_STRUCT_REGULAR_NO_SLEW  # PortRegStructRegularNoSlew
          PORT_REG_STRUCT_REGULAR_NO_FUNC  # PortRegStructRegularNoFunc
          PORT_REG_STRUCT_REGULAR_PERMUTED  # PortRegStructRegularPermuted
          PORT_REG_STRUCT_MUX  # PortRegStructMux
        boolean PortAvailablePackage0: set at post-build, origin=Vector Informatik, default-value=true  # Availability of Port in a speciffic chip pin package
        boolean PortContainsPrivReg: set at pre-compile, origin=Vector Infromatik, default-value=false  # Port Contains Privileged Mode Register | This register have to be set if at least one bit of the registers which are accessed by the Port contains is only writeable when controler is in controllers priveleged mode.
        container PortPin [1..*]  # Configuration of the individual port pins.
          enumeration PortPinDirection: set at post-build, default-value=PORT_PIN_IN  # The initial direction of the pin (IN or OUT). If the direction is not changeable, the value configured here is fixed. The direction must match the pin mode. E.g. a pin used for an ADC must be configured to be an in port. Implementation Type: Port_PinDirectionType
            PORT_PIN_IN  # In
            PORT_PIN_OUT  # Out
          boolean PortPinDirectionChangeable: set at post-build, default-value=false  # Parameter to indicate if the direction is changeable on a port pin during runtime. true: Port Pin direction changeable enabled. false: Port Pin direction changeable disabled. (Not used)
          integer PortPinId: 0..31, set at post-build, symbolic-name-value=true, default-value=0  # Pin Id of the port pin. This value will be assigned to the symbolic name derived from the port pin container short name.
          enumeration PortPinInitialMode: set at post-build, default-value=PORT_PIN_MODE_DIO  # Port pin mode/functionality from mode list for use with Port_Init() function.
            PORT_PIN_MODE_DIO  # DIO
            PORT_PIN_MODE_PWM  # PWM
            PORT_PIN_MODE_ICU  # ICU
            PORT_PIN_MODE_FLEXRAY  # FR
            PORT_PIN_MODE_CAN  # CAN
            PORT_PIN_MODE_LIN  # LIN
            PORT_PIN_MODE_SPI  # SPI
            PORT_PIN_MODE_ADC  # ADC
            PORT_PIN_MODE_ECLK  # ECLK
            PORT_PIN_MODE_RTP  # RTP
            PORT_PIN_MODE_NOT_CONFIGURABLE  # n.a.
            PORT_PIN_MODE_SCI  # SCI
            PORT_PIN_MODE_DMM  # DMM
            PORT_PIN_MODE_USER  # User Def
            PORT_PIN_MODE_IIC  # IIC
          enumeration PortPinLevelValue: set at post-build, default-value=PORT_PIN_LEVEL_LOW  # Port Pin Level value from Port pin list.
            PORT_PIN_LEVEL_HIGH  # 1
            PORT_PIN_LEVEL_LOW  # 0
          enumeration PortPinMode: set at post-build, default-value=PORT_PIN_MODE_DIO  # Port pin mode from mode list. Note that more than one mode is allowed by default. That way it is e.g. possible to combine DIO with another mode such as ICU. More HW specific literals may be added by module implementor. E.g. SPI may be further broken down into SpiCsHw, SpiCsSw, etc. if necessary. (Not used)
            PORT_PIN_MODE_ADC  # ADC
            PORT_PIN_MODE_CAN  # CAN
            PORT_PIN_MODE_DIO  # DIO
            PORT_PIN_MODE_DIO_GPT  # GPT
            PORT_PIN_MODE_DIO_WDG  # WDG
            PORT_PIN_MODE_FLEXRAY  # FR
            PORT_PIN_MODE_ICU  # ICU
            PORT_PIN_MODE_LIN  # LIN
            PORT_PIN_MODE_MEM  # MEM
            PORT_PIN_MODE_PWM  # PWM
            PORT_PIN_MODE_SPI  # SPI
            PORT_PIN_MODE_ECLK  # ECLK
            PORT_PIN_MODE_RTP  # RTP
            PORT_PIN_MODE_DMM  # DMM
            PORT_PIN_MODE_SCI  # SCI
            PORT_PIN_MODE_IIC  # IIC
          enumeration PortPinOpenDrain: set at post-build, origin=Vector Informatik, default-value=PORT_PUSH_PULL  # Selection of port output schematic
            PORT_PUSH_PULL  # Push-Pull
            PORT_OPEN_DRAIN  # Open Drain
          enumeration PortPinPullSelect: set at post-build, origin=Vector Informatik, default-value=PORT_PULL_UP  # Selection of the polarity of the pull resistor
            PORT_PULL_DISABLED  # Disabled
            PORT_PULL_UP  # Pull-Up
            PORT_PULL_DOWN  # Pull-Down
          boolean PortPinRefresh: set at post-build, origin=Vector Informatik, default-value=false  # Controls if pin-direction is updated when Port_RefreshPortDirection() is called.
          string PortPinChannelName: set at post-build, origin=Vector Informatik  # The symbolic name of the Port pin. This name is used by Port_SetPinDirection(). If name is not left empty pin is marked as direction-changable.
          boolean PortPinAvailablePackage{1..4}: set at post-build, origin=Vector Informatik, default-value=true  # Availability of Port Pin in a speciffic chip pin package
          enumeration PortPinSlewRate: set at post-build, origin=Vector Informatik, default-value=PORT_PIN_SLEW_RATE_NA  # Steepness of the edge in case of a level change
            PORT_PIN_SLEW_RATE_NORMAL  # Normal
            PORT_PIN_SLEW_RATE_SLOW  # Slow
            PORT_PIN_SLEW_RATE_NA  # n.a.
          string PortPinName: set at post-build, origin=Vector Informatik, default-value=PIN  # Identifiert of the Port Pin on the chip
          boolean PortPinAvailablePackage0: set at post-build, origin=Vector Informatik, default-value=true  # Availability of Port Pin in a speciffic chip pin package
      container PortDefaultSettings
        boolean PortUseDefaultSettings: set at pre-compile, origin=Vector Informatik, default-value=false  # Activate or deactivate configuration of port pins with default settings for ports that are not configured explicitly.
        enumeration PortDefaultDirection: set at pre-compile, origin=Vector Informatik, default-value=PORT_PIN_IN  # The default direction of the pin (IN or OUT) if not configured otherwise.
          PORT_PIN_IN  # In
          PORT_PIN_OUT  # Out
        enumeration PortDefaultLevelValue: set at pre-compile, origin=Vector Informatik, default-value=PORT_PIN_LEVEL_LOW  # Port Pin Default Level value from Port pin list.
          PORT_PIN_LEVEL_HIGH  # 1
          PORT_PIN_LEVEL_LOW  # 0
        enumeration PortDefaultOpenDrain: set at pre-compile, origin=Vector Informatik, default-value=PORT_PUSH_PULL  # Selection of port output schematic
          PORT_PUSH_PULL  # Push-Pull
          PORT_OPEN_DRAIN  # Open Drain
        enumeration PortDefaultPullSelect: set at pre-compile, origin=Vector Informatik, default-value=PORT_PULL_UP  # Selection of the polarity of the pull resistor
          PORT_PULL_DISABLED  # Disabled
          PORT_PULL_UP  # Pull-Up
          PORT_PULL_DOWN  # Pull-Down
        enumeration PortDefaultSlewRate: set at pre-compile, origin=Vector Informatik, default-value=PORT_PIN_SLEW_RATE_NORMAL  # Steepness of the edge in case of a level change
          PORT_PIN_SLEW_RATE_NORMAL  # Normal
          PORT_PIN_SLEW_RATE_SLOW  # Slow
      container PortMux  # Container collecting the Multiplexed Pins.
        string PortMuxName: set at post-build, origin=Vector Informatik, default-value=Port Multiplexing  # Name of the multiplexer unit.
        integer PortMuxNumberOfPins: 0..30, set at post-build, origin=Vector Informatik, default-value=30  # Number of multiplexed pins.
        string PortMuxRegPostfix: set at post-build, origin=Vector Informatik, default-value=MUX  # Postfix of the register identifer
        integer PortMuxRegBaseAddr: 0..4294967295, set at post-build, origin=Vector Informatik, default-value=0  # The base address of the multiplexing register
        integer PortMuxNumberOfRegs: 0..31, set at post-build, origin=Vector Informatik, default-value=31  # Number of available MUX control registers
        boolean PortUseMux: set at post-build, origin=Vector Informatik, default-value=false  # By activating a selection of Port Pins can be multipelxed. If deactivated the default settings are used by the controller. In this case multiplex control unit registers are not written
        boolean PortMuxEmifClkOutput: set at post-build, origin=Vector Infromatik, default-value=false  # This parameter has to be enabled in order for the EMIF_CLK signal to be output from the device
        boolean PortMuxDisableNhet2OutputByGiob2: set at post-build, origin=Vector Informatik, default-value=false  # The input function of GIOB[2] is multiplexed with MibSPI3NCS[0] / AD2EVT. This signal can be driven in from external monitor circuit to indicate a fault condition, and is internally used to disable the selected PWM outputs from the NHET2 module. This setting also allows this signal to be connected to the GIOB[2] port pin, which allows the application to generate an interrupt when this fault condition is signaled by the external circuit.
        enumeration PortMuxSelMiiOrRmii: set at post-build, origin=Vector Informatik, default-value=PORT_MUX_SEL_RMII  # The Ethernet module supports both the Reudced Media Independent Interface (RMII) and the Media Independent Interface (MII)
          PORT_MUX_SEL_RMII  # RMII
          PORT_MUX_SEL_MII  # MII
        enumeration PortMuxSelAdcTriggerTable: set at post-build, origin=Vector Informatik, default-value=PORT_MUX_SEL_ADC_TRIG_TABLE_1  # The ADC1 and ADC2 modules support two sets of trigger tables, with 8 trigger options defined in each table. This parameter allows to choose between these trigger tables.
          PORT_MUX_SEL_ADC_TRIG_TABLE_1  # Adc Trigger Table 1
          PORT_MUX_SEL_ADC_TRIG_TABLE_2  # Adc Trigger Table 2
        container PortMuxPin [0..200]  # Configuration of the individual multiplexed pins.
          string PortMuxPinName: set at post-build, origin=Vector Informatik, default-value=MUXPIN  # Identifiert of the Port Pin on the chip.
          enumeration PortMuxPinFunc: set at post-build, origin=Vector Informatik, default-value=PORT_PIN_MUX_AD1EVT  # Available pin routing alternativs.
            PORT_PIN_MUX_AD1EVT  # AD1EVT
            PORT_PIN_MUX_MII_RX_ER  # MII_RX_ER
            PORT_PIN_MUX_RMII_RX_ER  # RMII_RX_ER
            PORT_PIN_MUX_EMIF_ADDR_0  # EMIF_ADDR[0]
            PORT_PIN_MUX_NHET2_1  # NHET2[1]
            PORT_PIN_MUX_EMIF_ADDR_1  # EMIF_ADDR[1]
            PORT_PIN_MUX_NHET2_3  # NHET2[3]
            PORT_PIN_MUX_EMIF_ADDR_10  # EMIF_ADDR[10]
            PORT_PIN_MUX_RTP_DATA_09  # RTP_DATA[09]
            PORT_PIN_MUX_EMIF_ADDR_11  # EMIF_ADDR[11]
            PORT_PIN_MUX_RTP_DATA_08  # RTP_DATA[08]
            PORT_PIN_MUX_EMIF_ADDR_12  # EMIF_ADDR[12]
            PORT_PIN_MUX_RTP_DATA_06  # RTP_DATA[06]
            PORT_PIN_MUX_EMIF_ADDR_13  # EMIF_ADDR[13]
            PORT_PIN_MUX_RTP_DATA_05  # RTP_DATA[05]
            PORT_PIN_MUX_EMIF_ADDR_14  # EMIF_ADDR[14]
            PORT_PIN_MUX_RTP_DATA_04  # RTP_DATA[04]
            PORT_PIN_MUX_EMIF_ADDR_15  # EMIF_ADDR[15]
            PORT_PIN_MUX_RTP_DATA_03  # RTP_DATA[03]
            PORT_PIN_MUX_EMIF_ADDR_16  # EMIF_ADDR[16]
            PORT_PIN_MUX_RTP_DATA_02  # RTP_DATA[02]
            PORT_PIN_MUX_EMIF_ADDR_17  # EMIF_ADDR[17]
            PORT_PIN_MUX_RTP_DATA_01  # RTP_DATA[01]
            PORT_PIN_MUX_EMIF_ADDR_18  # EMIF_ADDR[18]
            PORT_PIN_MUX_RTP_DATA_0  # RTP_DATA[0]
            PORT_PIN_MUX_EMIF_ADDR_19  # EMIF_ADDR[19]
            PORT_PIN_MUX_RTP_nENA  # RTP_nENA
            PORT_PIN_MUX_EMIF_ADDR_20  # EMIF_ADDR[20]
            PORT_PIN_MUX_RTP_nSYNC  # RTP_nSYNC
            PORT_PIN_MUX_EMIF_ADDR_21  # EMIF_ADDR[21]
            PORT_PIN_MUX_RTP_CLK  # RTP_CLK
            PORT_PIN_MUX_EMIF_ADDR_6  # EMIF_ADDR[6]
            PORT_PIN_MUX_RTP_DATA_13  # RTP_DATA[13]
            PORT_PIN_MUX_NHET2_11  # NHET2[11]
            PORT_PIN_MUX_EMIF_ADDR_7  # EMIF_ADDR[7]
            PORT_PIN_MUX_RTP_DATA_12  # RTP_DATA[12]
            PORT_PIN_MUX_NHET2_13  # NHET2[13]
            PORT_PIN_MUX_EMIF_ADDR_8  # EMIF_ADDR[8]
            PORT_PIN_MUX_RTP_DATA_11  # RTP_DATA[11]
            PORT_PIN_MUX_NHET2_15  # NHET2[15]
            PORT_PIN_MUX_EMIF_ADDR_9  # EMIF_ADDR[9]
            PORT_PIN_MUX_RTP_DATA_10  # RTP_DATA[10]
            PORT_PIN_MUX_EMIF_BA_1  # EMIF_BA[1]
            PORT_PIN_MUX_NHET2_5  # NHET2[5]
            PORT_PIN_MUX_EMIF_nCS_0  # EMIF_nCS[0]
            PORT_PIN_MUX_RTP_DATA_15  # RTP_DATA[15]
            PORT_PIN_MUX_NHET2_7  # NHET2[7]
            PORT_PIN_MUX_EMIF_nCS_3  # EMIF_nCS[3]
            PORT_PIN_MUX_RTP_DATA_14  # RTP_DATA[14]
            PORT_PIN_MUX_NHET2_9  # NHET2[9]
            PORT_PIN_MUX_EMIF_nCS_4  # EMIF_nCS[4]
            PORT_PIN_MUX_RTP_DATA_07  # RTP_DATA[07]
            PORT_PIN_MUX_EMIF_nWE  # EMIF_nWE
            PORT_PIN_MUX_EMIF_RNW  # EMIF_RNW
            PORT_PIN_MUX_ETMDATA_08  # ETMDATA[08]
            PORT_PIN_MUX_EMIF_ADDR_5  # EMIF_ADDR[5]
            PORT_PIN_MUX_ETMDATA_09  # ETMDATA[09]
            PORT_PIN_MUX_EMIF_ADDR_4  # EMIF_ADDR[4]
            PORT_PIN_MUX_ETMDATA_10  # ETMDATA[10]
            PORT_PIN_MUX_EMIF_ADDR_3  # EMIF_ADDR[3]
            PORT_PIN_MUX_ETMDATA_11  # ETMDATA[11]
            PORT_PIN_MUX_EMIF_ADDR_2  # EMIF_ADDR[2]
            PORT_PIN_MUX_ETMDATA_12  # ETMDATA[12]
            PORT_PIN_MUX_EMIF_BA_0  # EMIF_BA[0]
            PORT_PIN_MUX_ETMDATA_13  # ETMDATA[13]
            PORT_PIN_MUX_EMIF_nOE  # EMIF_nOE
            PORT_PIN_MUX_ETMDATA_14  # ETMDATA[14]
            PORT_PIN_MUX_EMIF_nDQM_1  # EMIF_nDQM[1]
            PORT_PIN_MUX_ETMDATA_15  # ETMDATA[15]
            PORT_PIN_MUX_EMIF_nDQM_0  # EMIF_nDQM[0]
            PORT_PIN_MUX_ETMDATA_16  # ETMDATA[16]
            PORT_PIN_MUX_EMIF_DATA_0  # EMIF_DATA[0]
            PORT_PIN_MUX_ETMDATA_17  # ETMDATA[17]
            PORT_PIN_MUX_EMIF_DATA_1  # EMIF_DATA[1]
            PORT_PIN_MUX_ETMDATA_18  # ETMDATA[18]
            PORT_PIN_MUX_EMIF_DATA_2  # EMIF_DATA[2]
            PORT_PIN_MUX_ETMDATA_19  # ETMDATA[19]
            PORT_PIN_MUX_EMIF_DATA_3  # EMIF_DATA[3]
            PORT_PIN_MUX_ETMDATA_20  # ETMDATA[20]
            PORT_PIN_MUX_EMIF_DATA_4  # EMIF_DATA[4]
            PORT_PIN_MUX_ETMDATA_21  # ETMDATA[21]
            PORT_PIN_MUX_EMIF_DATA_5  # EMIF_DATA[5]
            PORT_PIN_MUX_ETMDATA_22  # ETMDATA[22]
            PORT_PIN_MUX_EMIF_DATA_6  # EMIF_DATA[6]
            PORT_PIN_MUX_ETMDATA_23  # ETMDATA[23]
            PORT_PIN_MUX_EMIF_DATA_7  # EMIF_DATA[7]
            PORT_PIN_MUX_ETMDATA_24  # ETMDATA[24]
            PORT_PIN_MUX_EMIF_DATA_8  # EMIF_DATA[8]
            PORT_PIN_MUX_ETMDATA_25  # ETMDATA[25]
            PORT_PIN_MUX_EMIF_DATA_9  # EMIF_DATA[9]
            PORT_PIN_MUX_ETMDATA_26  # ETMDATA[26]
            PORT_PIN_MUX_EMIF_DATA_10  # EMIF_DATA[10]
            PORT_PIN_MUX_ETMDATA_27  # ETMDATA[27]
            PORT_PIN_MUX_EMIF_DATA_11  # EMIF_DATA[11]
            PORT_PIN_MUX_ETMDATA_28  # ETMDATA[28]
            PORT_PIN_MUX_EMIF_DATA_12  # EMIF_DATA[12]
            PORT_PIN_MUX_ETMDATA_29  # ETMDATA[29]
            PORT_PIN_MUX_EMIF_DATA_13  # EMIF_DATA[13]
            PORT_PIN_MUX_ETMDATA_30  # ETMDATA[30]
            PORT_PIN_MUX_EMIF_DATA_14  # EMIF_DATA[14]
            PORT_PIN_MUX_ETMDATA_31  # ETMDATA[31]
            PORT_PIN_MUX_EMIF_DATA_15  # EMIF_DATA[15]
            PORT_PIN_MUX_ETMTRACECLKIN  # ETMTRACECLKIN
            PORT_PIN_MUX_EXTCLKIN2  # EXTCLKIN2
            PORT_PIN_MUX_GIOA_2  # GIOA[2]
            PORT_PIN_MUX_NHET2_0  # NHET2[0]
            PORT_PIN_MUX_GIOA_3  # GIOA[3]
            PORT_PIN_MUX_NHET2_2  # NHET2[2]
            PORT_PIN_MUX_GIOA_5  # GIOA[5]
            PORT_PIN_MUX_EXTCLKIN  # EXTCLKIN
            PORT_PIN_MUX_GIOA_6  # GIOA[6]
            PORT_PIN_MUX_NHET2_4  # NHET2[4]
            PORT_PIN_MUX_GIOA_7  # GIOA[7]
            PORT_PIN_MUX_NHET2_6  # NHET2[6]
            PORT_PIN_MUX_MIBSPI1NCS_0  # MIBSPI1NCS[0]
            PORT_PIN_MUX_MIBSPI1SOMI_1  # MIBSPI1SOMI[1]
            PORT_PIN_MUX_MII_TXD_2  # MII_TXD[2]
            PORT_PIN_MUX_MIBSPI1NCS_1  # MIBSPI1NCS[1]
            PORT_PIN_MUX_NHET1_17  # NHET1[17]
            PORT_PIN_MUX_MII_COL  # MII_COL
            PORT_PIN_MUX_MIBSPI1NCS_2  # MIBSPI1NCS[2]
            PORT_PIN_MUX_NHET1_19  # NHET1[19]
            PORT_PIN_MUX_MDIO  # MDIO
            PORT_PIN_MUX_MIBSPI1NCS_3  # MIBSPI1NCS[3]
            PORT_PIN_MUX_NHET1_21  # NHET1[21]
            PORT_PIN_MUX_MIBSPI1NENA  # MIBSPI1NENA
            PORT_PIN_MUX_NHET1_23  # NHET1[23]
            PORT_PIN_MUX_MII_RXD_2  # MII_RXD[2]
            PORT_PIN_MUX_MIBSPI3NCS_0  # MIBSPI3NCS[0]
            PORT_PIN_MUX_AD2EVT  # AD2EVT
            PORT_PIN_MUX_GIOB_2  # GIOB[2]
            PORT_PIN_MUX_MIBSPI3NCS_1  # MIBSPI3NCS[1]
            PORT_PIN_MUX_NHET1_25  # NHET1[25]
            PORT_PIN_MUX_MDCLK  # MDCLK
            PORT_PIN_MUX_MIBSPI3NCS_2  # MIBSPI3NCS[2]
            PORT_PIN_MUX_I2C_SDA  # I2C_SDA
            PORT_PIN_MUX_NHET1_27  # NHET1[27]
            PORT_PIN_MUX_MIBSPI3NCS_3  # MIBSPI3NCS[3]
            PORT_PIN_MUX_I2C_SCL  # I2C_SCL
            PORT_PIN_MUX_NHET1_29  # NHET1[29]
            PORT_PIN_MUX_MIBSPI3NENA  # MIBSPI3NENA
            PORT_PIN_MUX_MIBSPI3NCS_5  # MIBSPI3NCS[5]
            PORT_PIN_MUX_NHET1_31  # NHET1[31]
            PORT_PIN_MUX_MIBSPI5CLK  # MIBSPI5CLK
            PORT_PIN_MUX_DMM_DATA_4  # DMM_DATA[4]
            PORT_PIN_MUX_MII_TXEN  # MII_TXEN
            PORT_PIN_MUX_RMII_TXEN  # RMII_TXEN
            PORT_PIN_MUX_MIBSPI5NCS_0  # MIBSPI5NCS[0]
            PORT_PIN_MUX_DMM_DATA_5  # DMM_DATA[5]
            PORT_PIN_MUX_MIBSPI5NCS_1  # MIBSPI5NCS[1]
            PORT_PIN_MUX_DMM_DATA_6  # DMM_DATA[6]
            PORT_PIN_MUX_MIBSPI5NCS_2  # MIBSPI5NCS[2]
            PORT_PIN_MUX_DMM_DATA_2  # DMM_DATA[2]
            PORT_PIN_MUX_MIBSPI5NCS_3  # MIBSPI5NCS[3]
            PORT_PIN_MUX_DMM_DATA_3  # DMM_DATA[3]
            PORT_PIN_MUX_MIBSPI5NENA  # MIBSPI5NENA
            PORT_PIN_MUX_DMM_DATA_7  # DMM_DATA[7]
            PORT_PIN_MUX_MII_RXD_3  # MII_RXD[3]
            PORT_PIN_MUX_MIBSPI5SIMO_0  # MIBSPI5SIMO[0]
            PORT_PIN_MUX_DMM_DATA_8  # DMM_DATA[8]
            PORT_PIN_MUX_MII_TXD_1  # MII_TXD[1]
            PORT_PIN_MUX_RMII_TXD_1  # RMII_TXD[1]
            PORT_PIN_MUX_MIBSPI5SIMO_1  # MIBSPI5SIMO[1]
            PORT_PIN_MUX_DMM_DATA_9  # DMM_DATA[9]
            PORT_PIN_MUX_MIBSPI5SIMO_2  # MIBSPI5SIMO[2]
            PORT_PIN_MUX_DMM_DATA_10  # DMM_DATA[10]
            PORT_PIN_MUX_MIBSPI5SIMO_3  # MIBSPI5SIMO[3]
            PORT_PIN_MUX_DMM_DATA_11  # DMM_DATA[11]
            PORT_PIN_MUX_MIBSPI5SOMI_0  # MIBSPI5SOMI[0]
            PORT_PIN_MUX_DMM_DATA_12  # DMM_DATA[12]
            PORT_PIN_MUX_MII_TXD_0  # MII_TXD[0]
            PORT_PIN_MUX_RMII_TXD_0  # RMII_TXD[0]
            PORT_PIN_MUX_MIBSPI5SOMI_1  # MIBSPI5SOMI[1]
            PORT_PIN_MUX_DMM_DATA_13  # DMM_DATA[13]
            PORT_PIN_MUX_MIBSPI5SOMI_2  # MIBSPI5SOMI[2]
            PORT_PIN_MUX_DMM_DATA_14  # DMM_DATA[14]
            PORT_PIN_MUX_MIBSPI5SOMI_3  # MIBSPI5SOMI[3]
            PORT_PIN_MUX_DMM_DATA_15  # DMM_DATA[15]
            PORT_PIN_MUX_NHET1_0  # NHET1[0]
            PORT_PIN_MUX_SPI4CLK  # SPI4CLK
            PORT_PIN_MUX_NHET1_01  # NHET1[01]
            PORT_PIN_MUX_SPI4NENA  # SPI4NENA
            PORT_PIN_MUX_NHET2_8  # NHET2[8]
            PORT_PIN_MUX_NHET1_02  # NHET1[02]
            PORT_PIN_MUX_SPI4SIMO  # SPI4SIMO
            PORT_PIN_MUX_NHET1_03  # NHET1[03]
            PORT_PIN_MUX_SPI4NCS_0  # SPI4NCS[0]
            PORT_PIN_MUX_NHET2_10  # NHET2[10]
            PORT_PIN_MUX_NHET1_05  # NHET1[05]
            PORT_PIN_MUX_SPI4SOMI  # SPI4SOMI
            PORT_PIN_MUX_NHET2_12  # NHET2[12]
            PORT_PIN_MUX_NHET1_06  # NHET1[06]
            PORT_PIN_MUX_SCIRX  # SCIRX
            PORT_PIN_MUX_NHET1_07  # NHET1[07]
            PORT_PIN_MUX_Reserved  # Reserved
            PORT_PIN_MUX_NHET2_14  # NHET2[14]
            PORT_PIN_MUX_NHET1_08  # NHET1[08]
            PORT_PIN_MUX_MIBSPI1SIMO_1  # MIBSPI1SIMO[1]
            PORT_PIN_MUX_MII_TXD_3  # MII_TXD[3]
            PORT_PIN_MUX_NHET1_09  # NHET1[09]
            PORT_PIN_MUX_NHET2_16  # NHET2[16]
            PORT_PIN_MUX_NHET1_10  # NHET1[10]
            PORT_PIN_MUX_MII_TX_CLK  # MII_TX_CLK
            PORT_PIN_MUX_MII_TX_AVCLK4  # MII_TX_AVCLK4
            PORT_PIN_MUX_NHET1_11  # NHET1[11]
            PORT_PIN_MUX_MIBSPI3NCS_4  # MIBSPI3NCS[4]
            PORT_PIN_MUX_NHET2_18  # NHET2[18]
            PORT_PIN_MUX_NHET1_12  # NHET1[12]
            PORT_PIN_MUX_MII_CRS  # MII_CRS
            PORT_PIN_MUX_RMII_CRS_DV  # RMII_CRS_DV
            PORT_PIN_MUX_NHET1_13  # NHET1[13]
            PORT_PIN_MUX_SCITX  # SCITX
            PORT_PIN_MUX_NHET1_15  # NHET1[15]
            PORT_PIN_MUX_MIBSPI1NCS_4  # MIBSPI1NCS[4]
            PORT_PIN_MUX_NHET1_24  # NHET1[24]
            PORT_PIN_MUX_MIBSPI1NCS_5  # MIBSPI1NCS[5]
            PORT_PIN_MUX_MII_RXD_0  # MII_RXD[0]
            PORT_PIN_MUX_RMII_RXD_0  # RMII_RXD[0]
            PORT_PIN_MUX_NHET1_26  # NHET1[26]
            PORT_PIN_MUX_MII_RXD_1  # MII_RXD[1]
            PORT_PIN_MUX_RMII_RXD_1  # RMII_RXD[1]
            PORT_PIN_MUX_NHET1_28  # NHET1[28]
            PORT_PIN_MUX_MII_RXCLK  # MII_RXCLK
            PORT_PIN_MUX_RMII_REFCLK  # RMII_REFCLK
            PORT_PIN_MUX_MII_RX_AVCLK4  # MII_RX_AVCLK4
            PORT_PIN_MUX_NHET1_30  # NHET1[30]
            PORT_PIN_MUX_MII_RX_DV  # MII_RX_DV
            PORT_PIN_MUX_SPI2NENA  # SPI2NENA
            PORT_PIN_MUX_SPI2NCS_1  # SPI2NCS[1]
          integer PortMuxPinId: 0..31, set at post-build, origin=Vector Informatik, default-value=0  # Register offset of the Mux pin
          integer PortMuxPinRegId: 0..30, set at post-build, origin=Vector Informatik, default-value=0  # This value represents the location of the MUX Pin within the Mux registers. 1st to digests are the number of the MUX register (0 - 30). Last digit os the associated byte within the register (0 - 3).
          derived string PortMuxPinNumberPackage{0..4}: set at pre-compile, origin=Vector Informatik, default-value=-  # Identifer of the physical pin for package {0..4}
          enumeration PortMuxPinDirection: set at post-build, origin=Vector Informatik, default-value=PORT_MUX_PIN_DIR_OUTPUT  # The direction of the MUXed signal line (Input, Output)
            PORT_MUX_PIN_DIR_OUTPUT  # Output
            PORT_MUX_PIN_DIR_INPUT  # Input
          integer PortMuxPinRegPos: 0..24, set at post-build, origin=Vector Informatik, default-value=0  # Start bit of the pin within the corresponding MUX control register
    container PortGeneral  # Module wide configuration parameters of the PORT driver.
      boolean PortDevErrorDetect: set at pre-compile, default-value=true  # Switches the Development Error Detection and Notification on or off. true: Enabled. false: Disabled.
      boolean PortSetPinDirectionApi: set at pre-compile, default-value=true  # Pre-processor switch to enable / disable the use of the function Port_SetPinDirection(). TRUE: Enabled - Function Port_SetPinDirection() is available. FALSE: Disabled - Function Port_SetPinDirection() is not available.
      boolean PortSetPinModeApi: set at pre-compile, default-value=false  # Pre-processor switch to enable / disable the use of the function Port_SetPinMode(). true: Enabled - Function Port_SetPinMode() is available. false: Disabled - Function Port_SetPinMode() is not available.
      boolean PortVersionInfoApi: set at pre-compile, default-value=false  # Pre-processor switch to enable / disable the API to read out the modules version information. true: Version info API enabled. false: Version info API disabled.
      boolean PortRefreshPortDirectionApi: set at pre-compile, origin=Vector Informatik, default-value=true  # Pre-processor switch to enable / disable the API to refresh the port direction.
      boolean PortCfgDoParamChk: set at pre-compile, origin=Vector Informatik, default-value=true  # Preprocessor switch if parameter checking is activated in development mode.
      boolean PortCfgChkUninit: set at pre-compile, origin=Vector Informatik, default-value=true  # Activate/deactivate check if module Port is uninitialized when calling a service.
      boolean PortCfgChkParamPin: set at pre-compile, origin=Vector Informatik, default-value=true  # Switch which enables/disables the checking of the pin parameter of Port_SetPinDirection in development mode.
      boolean PortCfgChkParamVinfo: set at pre-compile, origin=Vector Informatik, default-value=true  # Switch which enables/disables the checking of the parameter of Port_GetVersionInfo in development mode.
      boolean PortCfgChkParamConfig: set at pre-compile, origin=Vector Informatik, default-value=true  # Preprocessor switch if checking of config parameter of Port_Init is activated in development mode.
      function name PortErrorhook: set at pre-compile, origin=Vector Informatik, default-value=Det_ReportError  # Function which is called in case of Development Error
      string PortDetIncludeFile: set at pre-compile, origin=Vector Informatik, default-value=Det.h  # The include file of the Development Error Tracer. Shall be used to specify a special Det module.
      boolean PortCfgDebugReporting: set at pre-compile, origin=Vector Informatik, default-value=true  # Activate or deactivate if recognized development errors are reported to Det
      string PortPackageMapping0: set at pre-compile, origin=Vector Informatik, default-value=Pin_337  # Mapping from Pin Package Name to abstract Pinpackage Identifer
      string PortPackageMapping1: set at pre-compile, origin=Vector Informatik, default-value=Pin_324  # Mapping from Pin Package Name to abstract Pinpackage Identifer
      string PortPackageMapping2: set at pre-compile, origin=Vector Informatik, default-value=Pin_256  # Mapping from Pin Package Name to abstract Pinpackage Identifer
      string PortPackageMapping3: set at pre-compile, origin=Vector Informatik, default-value=Pin_176  # Mapping from Pin Package Name to abstract Pinpackage Identifer
      string PortPackageMapping4: set at pre-compile, origin=Vector Informatik, default-value=Pin_144  # Mapping from Pin Package Name to abstract Pinpackage Identifer
      boolean PortSpecialRegisterAccessEnabled: set at pre-compile, origin=Vector Informatik, default-value=false  # Register Access Via OS Functions | Enables/disables all access to the periphery register via a special function. The special function allows the access to the registers even if they are protected by MPU or supervisor mode. The function shall be provided by the Os.
      boolean PortSpecialRegisterAccessOnlyForWrite: set at pre-compile, origin=Vector Informatik, default-value=true  # Special Register Access Only For Write | This parameter disables the usage of the special function to access the periphery registers for the read access.
      boolean PortSpecialRegisterAccessOnlyForPrivilegedModeRegisters: set at pre-compile, origin=Vector Informatik, default-value=true  # Special Register Access Only For Privileged Mode Registers
      boolean PortSpecialRegisterAccessNotInInit: set at pre-compile, origin=Vector Informatik, default-value=true  # Special Register Access Not During Initialization | This parameter disables the usage of the special function to access the periphery registers during the initialization
      reference PortIrqHandling: set at pre-compile, origin=Vector Informatik, destination=InterruptFunctionSet  # Determines the IRQ function set which is used to protect critical sections.
    container VectorCommonData
      string BswmdVersion: set at published-information, origin=Vector Informatik, default-value=1.03.00  # This parameter specifies the version of this bswmd file.
  bsw implementation Port_Impl: code-generator=cMICROSAR, programming-language=C, sw-major-version=1, sw-minor-version=1, sw-patch-version=0, vendor-id=30, ar-major-version=3, ar-minor-version=0, ar-patch-version=1, preconfigured-configuration=Port_Pre, recommended-configuration=Port_Rec, vendor-specific-module-def=Port
