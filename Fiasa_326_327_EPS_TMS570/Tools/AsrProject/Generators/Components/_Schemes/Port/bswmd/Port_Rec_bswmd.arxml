AUTOSAR XML (schema 3.1.4)
package /MICROSAR
  module config Port_Rec: definition=Port
    PortConfigSet
      PortDefaultSettings:
        PortUseDefaultSettings = false
        PortDefaultMode = PORT_PIN_MODE_DIO
        PortDefaultOpenDrain = PORT_PUSH_PULL
        PortDefaultDirection = PORT_PIN_IN
        PortDefaultLevelValue = PORT_PIN_LEVEL_LOW
        PortDefaultPullSelect = PORT_PULL_UP
        PortDefaultSlewRate = PORT_PIN_SLEW_RATE_NORMAL
      20 x PortContainer:
        GIOA
          8 x PortPin, all with PortPinInitialMode=PORT_PIN_MODE_DIO, PortPinPullSelect=PORT_PULL_DOWN:
            PortPinGioA_{0..7}
        GIOB: PortUse=false
          8 x PortPin, all with PortPinInitialMode=PORT_PIN_MODE_DIO, PortPinPullSelect=PORT_PULL_UP:
            PortPinGioB_{0..7}
        CAN1
          PortPinCan1_0 (PortPin): PortPinInitialMode=PORT_PIN_MODE_DIO, PortPinPullSelect=PORT_PULL_UP
          PortPinCan1_1 (PortPin): PortPinInitialMode=PORT_PIN_MODE_DIO, PortPinPullSelect=PORT_PULL_UP
        CAN2
          PortPinCan2_0 (PortPin): PortPinInitialMode=PORT_PIN_MODE_DIO, PortPinPullSelect=PORT_PULL_UP
          PortPinCan2_1 (PortPin): PortPinPullSelect=PORT_PULL_UP, PortPinInitialMode=PORT_PIN_MODE_DIO
        CAN3
          PortPinCan3_0 (PortPin): PortPinInitialMode=PORT_PIN_MODE_DIO, PortPinPullSelect=PORT_PULL_UP
          PortPinCan3_1 (PortPin): PortPinInitialMode=PORT_PIN_MODE_DIO, PortPinPullSelect=PORT_PULL_UP
        LIN
          PortPinLin1_0 (PortPin): PortPinInitialMode=PORT_PIN_MODE_DIO, PortPinPullSelect=PORT_PULL_UP
          PortPinLin1_1 (PortPin): PortPinPullSelect=PORT_PULL_UP, PortPinInitialMode=PORT_PIN_MODE_DIO
        SCI
          PortPinSci1_0 (PortPin): PortPinInitialMode=PORT_PIN_MODE_DIO, PortPinPullSelect=PORT_PULL_UP
          PortPinSci1_1 (PortPin): PortPinPullSelect=PORT_PULL_UP, PortPinInitialMode=PORT_PIN_MODE_DIO
        I2C
          PortPinIic_0 (PortPin): PortPinInitialMode=PORT_PIN_MODE_DIO, PortPinPullSelect=PORT_PULL_UP
          PortPinIic_1 (PortPin): PortPinPullSelect=PORT_PULL_UP, PortPinInitialMode=PORT_PIN_MODE_DIO
        SPI1: PortUse=false
          12 x PortPin, all with PortPinInitialMode=PORT_PIN_MODE_DIO, PortPinPullSelect=PORT_PULL_UP:
            PortPinSpi1_{0..5}
            PortPinSpi1_7
            PortPinSpi1_6
            PortPinSpi1_{8..11}
        SPI2
          6 x PortPin, all with PortPinInitialMode=PORT_PIN_MODE_DIO, PortPinPullSelect=PORT_PULL_UP:
            PortPinSpi2_{0..2}
            PortPinSpi2_{5..7}
        SPI3: PortUse=false
          10 x PortPin, all with PortPinInitialMode=PORT_PIN_MODE_DIO, PortPinPullSelect=PORT_PULL_UP:
            PortPinSpi3_{0..6}
            PortPinSpi3_10
            PortPinSpi3_7
            PortPinSpi3_8
        SPI4
          5 x PortPin, all with PortPinInitialMode=PORT_PIN_MODE_DIO, PortPinPullSelect=PORT_PULL_UP:
            PortPinSpi4_0
            PortPinSpi4_1
            PortPinSpi4_{5..7}
        SPI5: PortUse=false
          14 x PortPin, all with PortPinPullSelect=PORT_PULL_UP:
            PortPinSpi5_0: PortPinInitialMode=PORT_PIN_MODE_DIO
            PortPinSpi5_1: PortPinLevelValue=PORT_PIN_LEVEL_LOW
            PortPinSpi5_2: PortPinLevelValue=PORT_PIN_LEVEL_LOW
            PortPinSpi5_{3..13}: PortPinInitialMode=PORT_PIN_MODE_DIO
        NHET1
          32 x PortPin, all with PortPinInitialMode=PORT_PIN_MODE_DIO, PortPinPullSelect=PORT_PULL_DOWN:
            PortPinNHet1_{0..31}
        NHET2
          18 x PortPin, all with PortPinInitialMode=PORT_PIN_MODE_DIO:
            PortPinNHet2_{0..15}: PortPinPullSelect=PORT_PULL_DOWN
            PortPinNHet2_16: PortPinSlewRate=PORT_PIN_SLEW_RATE_NA
            PortPinNHet2_18: PortPinPullSelect=PORT_PULL_DOWN
        SYS
          PortPinEcp_0 (PortPin): PortPinInitialMode=PORT_PIN_MODE_DIO, PortPinPullSelect=PORT_PULL_DOWN, PortPinSlewRate=PORT_PIN_SLEW_RATE_SLOW
        ADC1
          PortPinADC1_0 (PortPin): PortPinInitialMode=PORT_PIN_MODE_DIO, PortPinPullSelect=PORT_PULL_DOWN
        ADC2
          PortPinADC2_0 (PortPin): PortPinInitialMode=PORT_PIN_MODE_DIO, PortPinPullSelect=PORT_PULL_DOWN
        RTP
          19 x PortPin, all with PortPinInitialMode=PORT_PIN_MODE_DIO:
            PortPinRtp_{0..16}: PortPinPullSelect=PORT_PULL_UP
            PortPinRtp_17: PortPinSlewRate=PORT_PIN_SLEW_RATE_NA
            PortPinRtp_18: PortPinPullSelect=PORT_PULL_UP
        DMM
          19 x PortPin, all with PortPinInitialMode=PORT_PIN_MODE_DIO:
            PortPinDmm_{0..9}: PortPinPullSelect=PORT_PULL_UP
            PortPinDmm_10: PortPinOpenDrain=PORT_PUSH_PULL
            PortPinDmm_{11..18}: PortPinPullSelect=PORT_PULL_UP
      Multiplexing (PortMux)
        109 x PortMuxPin:
          Pin_N19_86: PortMuxPinFunc=PORT_PIN_MUX_AD1EVT
          Pin_D4: PortMuxPinFunc=PORT_PIN_MUX_EMIF_ADDR_0
          Pin_D5: PortMuxPinFunc=PORT_PIN_MUX_EMIF_ADDR_1
          Pin_C8: PortMuxPinFunc=PORT_PIN_MUX_EMIF_ADDR_10
          Pin_C9: PortMuxPinFunc=PORT_PIN_MUX_EMIF_ADDR_11
          Pin_C10: PortMuxPinFunc=PORT_PIN_MUX_EMIF_ADDR_12
          Pin_C11: PortMuxPinFunc=PORT_PIN_MUX_EMIF_ADDR_13
          Pin_C12: PortMuxPinFunc=PORT_PIN_MUX_EMIF_ADDR_14
          Pin_C13: PortMuxPinFunc=PORT_PIN_MUX_EMIF_ADDR_15
          Pin_D14: PortMuxPinFunc=PORT_PIN_MUX_EMIF_ADDR_16
          Pin_C14: PortMuxPinFunc=PORT_PIN_MUX_EMIF_ADDR_17
          Pin_D15: PortMuxPinFunc=PORT_PIN_MUX_EMIF_ADDR_18
          Pin_C15: PortMuxPinFunc=PORT_PIN_MUX_EMIF_ADDR_19
          Pin_C16: PortMuxPinFunc=PORT_PIN_MUX_EMIF_ADDR_20
          Pin_C17: PortMuxPinFunc=PORT_PIN_MUX_EMIF_ADDR_21
          Pin_C4: PortMuxPinFunc=PORT_PIN_MUX_EMIF_ADDR_6
          Pin_C5: PortMuxPinFunc=PORT_PIN_MUX_EMIF_ADDR_7
          Pin_C6: PortMuxPinFunc=PORT_PIN_MUX_EMIF_ADDR_8
          Pin_C7: PortMuxPinFunc=PORT_PIN_MUX_EMIF_ADDR_9
          Pin_D16: PortMuxPinFunc=PORT_PIN_MUX_EMIF_BA_1
          Pin_N17: PortMuxPinFunc=PORT_PIN_MUX_EMIF_nCS_0
          Pin_K17: PortMuxPinFunc=PORT_PIN_MUX_EMIF_nCS_3
          Pin_M17: PortMuxPinFunc=PORT_PIN_MUX_EMIF_nCS_4
          Pin_D17: PortMuxPinFunc=PORT_PIN_MUX_EMIF_nWE
          Pin_D9: PortMuxPinFunc=PORT_PIN_MUX_ETMDATA_08
          Pin_D8: PortMuxPinFunc=PORT_PIN_MUX_ETMDATA_09
          Pin_D7: PortMuxPinFunc=PORT_PIN_MUX_ETMDATA_10
          Pin_D6: PortMuxPinFunc=PORT_PIN_MUX_ETMDATA_11
          Pin_D13: PortMuxPinFunc=PORT_PIN_MUX_ETMDATA_12
          Pin_D12: PortMuxPinFunc=PORT_PIN_MUX_ETMDATA_13
          Pin_D11: PortMuxPinFunc=PORT_PIN_MUX_ETMDATA_14
          Pin_D10: PortMuxPinFunc=PORT_PIN_MUX_ETMDATA_15
          Pin_K15: PortMuxPinFunc=PORT_PIN_MUX_ETMDATA_16
          Pin_L15: PortMuxPinFunc=PORT_PIN_MUX_ETMDATA_17
          Pin_M15: PortMuxPinFunc=PORT_PIN_MUX_ETMDATA_18
          Pin_N15: PortMuxPinFunc=PORT_PIN_MUX_ETMDATA_19
          Pin_E4: PortMuxPinFunc=PORT_PIN_MUX_ETMDATA_20
          Pin_F4: PortMuxPinFunc=PORT_PIN_MUX_ETMDATA_21
          Pin_G4: PortMuxPinFunc=PORT_PIN_MUX_ETMDATA_22
          Pin_K4: PortMuxPinFunc=PORT_PIN_MUX_ETMDATA_23
          Pin_L4: PortMuxPinFunc=PORT_PIN_MUX_ETMDATA_24
          Pin_M4: PortMuxPinFunc=PORT_PIN_MUX_ETMDATA_25
          Pin_N4: PortMuxPinFunc=PORT_PIN_MUX_ETMDATA_26
          Pin_P4: PortMuxPinFunc=PORT_PIN_MUX_ETMDATA_27
          Pin_R5: PortMuxPinFunc=PORT_PIN_MUX_ETMDATA_28
          Pin_R6: PortMuxPinFunc=PORT_PIN_MUX_ETMDATA_29
          Pin_R7: PortMuxPinFunc=PORT_PIN_MUX_ETMDATA_30
          Pin_R8: PortMuxPinFunc=PORT_PIN_MUX_ETMDATA_31
          Pin_R9: PortMuxPinFunc=PORT_PIN_MUX_ETMTRACECLKIN
          Pin_C1_9: PortMuxPinFunc=PORT_PIN_MUX_GIOA_2
          Pin_E1: PortMuxPinFunc=PORT_PIN_MUX_GIOA_3
          Pin_B5_14: PortMuxPinFunc=PORT_PIN_MUX_GIOA_5
          Pin_H3_16: PortMuxPinFunc=PORT_PIN_MUX_GIOA_6
          Pin_M1_22: PortMuxPinFunc=PORT_PIN_MUX_GIOA_7
          Pin_R2_105: PortMuxPinFunc=PORT_PIN_MUX_MIBSPI1NCS_0
          Pin_F3_130: PortMuxPinFunc=PORT_PIN_MUX_MIBSPI1NCS_1
          Pin_F3_130_IN: PortMuxPinFunc=PORT_PIN_MUX_MIBSPI1NCS_1
          Pin_G3_40: PortMuxPinFunc=PORT_PIN_MUX_MIBSPI1NCS_2
          Pin_G3_40_IN: PortMuxPinFunc=PORT_PIN_MUX_MIBSPI1NCS_2
          Pin_J3: PortMuxPinFunc=PORT_PIN_MUX_MIBSPI1NCS_3
          Pin_J3_IN: PortMuxPinFunc=PORT_PIN_MUX_MIBSPI1NCS_3
          Pin_G19_96: PortMuxPinFunc=PORT_PIN_MUX_MIBSPI1NENA
          Pin_G19_96_IN: PortMuxPinFunc=PORT_PIN_MUX_MIBSPI1NENA
          Pin_V10_55: PortMuxPinFunc=PORT_PIN_MUX_MIBSPI3NCS_0
          Pin_V10_55_IN: PortMuxPinFunc=PORT_PIN_MUX_MIBSPI3NCS_0
          Pin_V5_37: PortMuxPinFunc=PORT_PIN_MUX_MIBSPI3NCS_1
          Pin_V5_37_IN: PortMuxPinFunc=PORT_PIN_MUX_MIBSPI3NCS_1
          Pin_B2_4: PortMuxPinFunc=PORT_PIN_MUX_MIBSPI3NCS_2
          Pin_B2_4_IN: PortMuxPinFunc=PORT_PIN_MUX_MIBSPI3NCS_2
          Pin_C3_3: PortMuxPinFunc=PORT_PIN_MUX_MIBSPI3NCS_3
          Pin_C3_3_IN: PortMuxPinFunc=PORT_PIN_MUX_MIBSPI3NCS_3
          Pin_W9_54: PortMuxPinFunc=PORT_PIN_MUX_MIBSPI3NENA
          Pin_W9_54_IN: PortMuxPinFunc=PORT_PIN_MUX_MIBSPI3NENA
          Pin_H19_100: PortMuxPinFunc=PORT_PIN_MUX_MIBSPI5CLK
          Pin_E19_32: PortMuxPinFunc=PORT_PIN_MUX_MIBSPI5NCS_0
          Pin_B6: PortMuxPinFunc=PORT_PIN_MUX_MIBSPI5NCS_1
          Pin_W6: PortMuxPinFunc=PORT_PIN_MUX_MIBSPI5NCS_2
          Pin_T12: PortMuxPinFunc=PORT_PIN_MUX_MIBSPI5NCS_3
          Pin_H18_97: PortMuxPinFunc=PORT_PIN_MUX_MIBSPI5NENA
          Pin_J19_99: PortMuxPinFunc=PORT_PIN_MUX_MIBSPI5SIMO_0
          Pin_E16: PortMuxPinFunc=PORT_PIN_MUX_MIBSPI5SIMO_1
          Pin_H17: PortMuxPinFunc=PORT_PIN_MUX_MIBSPI5SIMO_2
          Pin_G17: PortMuxPinFunc=PORT_PIN_MUX_MIBSPI5SIMO_3
          Pin_J18_98: PortMuxPinFunc=PORT_PIN_MUX_MIBSPI5SOMI_0
          Pin_E17: PortMuxPinFunc=PORT_PIN_MUX_MIBSPI5SOMI_1
          Pin_H16: PortMuxPinFunc=PORT_PIN_MUX_MIBSPI5SOMI_2
          Pin_G16: PortMuxPinFunc=PORT_PIN_MUX_MIBSPI5SOMI_3
          Pin_K18_25: PortMuxPinFunc=PORT_PIN_MUX_NHET1_0
          Pin_K18_25_IN: PortMuxPinFunc=PORT_PIN_MUX_NHET1_0
          Pin_V2_23: PortMuxPinFunc=PORT_PIN_MUX_NHET1_01
          Pin_W5_30: PortMuxPinFunc=PORT_PIN_MUX_NHET1_02
          Pin_W5_30_IN: PortMuxPinFunc=PORT_PIN_MUX_NHET1_02
          Pin_U1_24: PortMuxPinFunc=PORT_PIN_MUX_NHET1_03
          Pin_V6_31: PortMuxPinFunc=PORT_PIN_MUX_NHET1_05
          Pin_V6_31_IN: PortMuxPinFunc=PORT_PIN_MUX_NHET1_05
          Pin_W3_38: PortMuxPinFunc=PORT_PIN_MUX_NHET1_06
          Pin_T1_33: PortMuxPinFunc=PORT_PIN_MUX_NHET1_07
          Pin_E18_106: PortMuxPinFunc=PORT_PIN_MUX_NHET1_08
          Pin_V7_35: PortMuxPinFunc=PORT_PIN_MUX_NHET1_09
          Pin_D19_118: PortMuxPinFunc=PORT_PIN_MUX_NHET1_10
          Pin_E3_6: PortMuxPinFunc=PORT_PIN_MUX_NHET1_11
          Pin_B4_124: PortMuxPinFunc=PORT_PIN_MUX_NHET1_12
          Pin_N2_39: PortMuxPinFunc=PORT_PIN_MUX_NHET1_13
          Pin_N1_41: PortMuxPinFunc=PORT_PIN_MUX_NHET1_15
          Pin_P1_91: PortMuxPinFunc=PORT_PIN_MUX_NHET1_24
          Pin_A14_92: PortMuxPinFunc=PORT_PIN_MUX_NHET1_26
          Pin_K19_107: PortMuxPinFunc=PORT_PIN_MUX_NHET1_28
          Pin_B11_127: PortMuxPinFunc=PORT_PIN_MUX_NHET1_30
          Pin_D3_54: PortMuxPinFunc=PORT_PIN_MUX_SPI2NENA
