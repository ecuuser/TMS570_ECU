AUTOSAR XML (schema 3.1.4)
package /MICROSAR
  module config Dio_Rec: definition=Dio  # Default values for hardware specific parameters
    MyDioPortGioA (DioPort): DioPortDefRef=DioPortGioA
      DioChannel: DioChannelId=0
      DioChannelGroup: DioChannelGroupIdentification=&DioChannelGroup, DioPortMask=1, DioPortOffset=0
