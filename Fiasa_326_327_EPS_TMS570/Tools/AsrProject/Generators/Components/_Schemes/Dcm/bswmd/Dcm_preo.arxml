AUTOSAR XML (schema 3.0.1)
package /MICROSAR
  module config Dcm_Rec: definition=Dcm
    DcmGeneral: DcmDevErrorDetect=false, DcmUseRte=true, DcmVersionInfoApi=false
  module config Dcm_Pre: definition=Dcm, implementation-config-variant=VARIANT-PRE-COMPILE
    DcmGeneral: DcmPeriodicTxType=Type_I, DcmSupportMultiChannelFBL=false
  module config Dcm_Pre_Class1: definition=Dcm
    DcmPageBufferCfg: DcmPagedBufferEnabled=true
